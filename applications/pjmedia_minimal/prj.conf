## CMakeLists.txt
```
cmake_minimum_required(VERSION 3.20.0)

list(APPEND ZEPHYR_EXTRA_MODULES
  "${CMAKE_CURRENT_LIST_DIR}/../../pjproject"
)

find_package(Zephyr REQUIRED HINTS $ENV{ZEPHYR_BASE})
project(pjmedia_minimal)

target_sources(app PRIVATE src/main.c)
target_sources_ifdef(CONFIG_PJMEDIA_PHASE1_BOUNDARY_TEST app PRIVATE
  src/phase1_boundary.c
)
target_sources_ifdef(CONFIG_PJMEDIA_PHASE2_SDP_TEST app PRIVATE
  src/phase2_sdp.c
)
target_sources_ifdef(CONFIG_PJMEDIA_PHASE3_SDP_NEG_TEST app PRIVATE
  src/phase3_sdp_neg.c
)
target_sources_ifdef(CONFIG_PJMEDIA_PHASE3_LINK_PROBE app PRIVATE
  src/phase3_link_probe.c
)
target_sources_ifdef(CONFIG_PJMEDIA_PHASE4_INVITE_TEST app PRIVATE
  src/phase4_invite.c
)
target_sources_ifdef(CONFIG_PJMEDIA_PHASE5_LOOP_CALL_TEST app PRIVATE
  src/phase5_loop_call.c
)
target_sources_ifdef(CONFIG_PJMEDIA_PHASE6_UDP_CALL_TEST app PRIVATE
  src/phase6_udp_call.c
)
target_sources_ifdef(CONFIG_PJMEDIA_PHASE7_G711_TEST app PRIVATE
  src/phase7_g711.c
)
target_sources_ifdef(CONFIG_PJMEDIA_PHASE7_LINK_PROBE app PRIVATE
  src/phase7_link_probe.c
)
target_sources_ifdef(CONFIG_PJMEDIA_PHASE8_PACKET_TEST app PRIVATE
  src/phase8_packet.c
)
target_sources_ifdef(CONFIG_PJMEDIA_PHASE8_LINK_PROBE app PRIVATE
  src/phase8_link_probe.c
)
target_sources_ifdef(CONFIG_PJMEDIA_PHASE9_TRANSPORT_TEST app PRIVATE
  src/phase9_transport.c
)
target_sources_ifdef(CONFIG_PJMEDIA_PHASE9_LINK_PROBE app PRIVATE
  src/phase9_link_probe.c
)
target_sources_ifdef(CONFIG_PJMEDIA_PHASE11_LINK_PROBE app PRIVATE
  src/phase11_link_probe.c
)
target_sources_ifdef(CONFIG_PJMEDIA_PHASE11_CALL_TEST app PRIVATE
  src/phase11_call.c
  src/phase11_media.c
)
target_sources_ifdef(CONFIG_PJMEDIA_PHASE12_ROBUSTNESS_TEST app PRIVATE
  src/phase12_robustness.c
  src/phase11_media.c
)
target_sources_ifdef(CONFIG_PJMEDIA_SRTP_PRIMITIVE_TEST app PRIVATE
  src/srtp_primitives.c
)
target_sources_ifdef(CONFIG_PJMEDIA_SRTP_TRANSPORT_TEST app PRIVATE
  src/srtp_transport.c
)
target_sources_ifdef(CONFIG_PJMEDIA_SRTP_SDES_TEST app PRIVATE
  src/srtp_sdes.c
)
```

## Kconfig
```
source "Kconfig.zephyr"

# Test-only selectors default to n; each phase overlay enables only its test.
menu "PJMEDIA minimal application validation"

config PJMEDIA_PHASE1_BOUNDARY_TEST
	bool "PJMEDIA Phase 1 configuration/header boundary"
	depends on PJPROJECT && PJMEDIA && PJMEDIA_G711
	help
	  Compile public configuration headers and assert the initial Zephyr media
	  profile. This test links no PJMEDIA implementation and makes no runtime
	  media claim.

config PJMEDIA_PHASE2_SDP_TEST
	bool "PJMEDIA Phase 2 SDP parser validation"
	depends on PJPROJECT && PJLIB_UTIL && PJMEDIA_SDP
	depends on !PJMEDIA_SDP_NEG && !PJMEDIA_ENDPOINT
	help
	  Run deterministic SDP representation, parse, print, clone, comparison,
	  malformed-input, configured-limit, lifecycle, and resource tests. No
	  negotiation, endpoint, codec, RTP, socket, or audio source is selected.

config PJMEDIA_PHASE3_SDP_NEG_TEST
	bool "PJMEDIA Phase 3 SDP offer/answer validation"
	depends on PJPROJECT && PJLIB_UTIL && PJMEDIA_SDP_NEG
	depends on !PJMEDIA_ENDPOINT && !PJMEDIA_G711 && !PJMEDIA_RTP_RTCP
	depends on !PJMEDIA_UDP_TRANSPORT && !PJMEDIA_STREAM && !PJMEDIA_AUDIODEV
	help
	  Run deterministic offer/answer, rejection, state-transition, lifecycle,
	  configured-boundary, stack, and pool tests without a media runtime.

config PJMEDIA_PHASE3_LINK_PROBE
	bool "PJMEDIA Phase 3 whole negotiator API link probe"
	depends on PJPROJECT && PJLIB_UTIL && PJMEDIA_SDP_NEG
	depends on !PJMEDIA_ENDPOINT && !PJMEDIA_G711 && !PJMEDIA_RTP_RTCP
	depends on !PJMEDIA_UDP_TRANSPORT && !PJMEDIA_STREAM && !PJMEDIA_AUDIODEV
	help
	  Retain references to every public SDP-negotiator API in an independent
	  image to expose closure dependencies that normal section garbage
	  collection could otherwise discard.

config PJMEDIA_PHASE4_INVITE_TEST
	bool "PJMEDIA Phase 4 INVITE lifecycle validation"
	depends on PJPROJECT && PJSIP && PJSIP_INVITE && PJMEDIA_SDP_NEG
	depends on !PJMEDIA_ENDPOINT && !PJMEDIA_G711 && !PJMEDIA_RTP_RTCP
	depends on !PJMEDIA_UDP_TRANSPORT && !PJMEDIA_STREAM && !PJMEDIA_AUDIODEV
	help
	  Validate PJSIP INVITE, 100rel, and session-timer module lifecycle and
	  session creation without sockets, media runtime, codecs, or audio.

config PJMEDIA_PHASE5_LOOP_CALL_TEST
	bool "PJMEDIA Phase 5 loop call-control validation"
	depends on PJPROJECT && PJSIP && PJSIP_INVITE && PJMEDIA_SDP_NEG
	depends on !PJSIP_UDP_TRANSPORT && !PJSIP_TCP_TRANSPORT
	depends on !PJMEDIA_ENDPOINT && !PJMEDIA_G711 && !PJMEDIA_RTP_RTCP
	depends on !PJMEDIA_UDP_TRANSPORT && !PJMEDIA_STREAM && !PJMEDIA_AUDIODEV
	help
	  Validate socket-free INVITE call control, CANCEL, rejection, timeout,
	  transport failure, offerless INVITE, re-INVITE, SDP direction changes,
	  and complete teardown over PJSIP's in-memory loop transport. No RTP or
	  audio runtime is selected.

config PJMEDIA_PHASE6_UDP_CALL_TEST
	bool "PJMEDIA Phase 6 IPv4 UDP call-control validation"
	depends on PJPROJECT && PJSIP && PJSIP_INVITE && PJSIP_REGC
	depends on PJSIP_UDP_TRANSPORT && PJMEDIA_SDP_NEG
	depends on NET_SOCKETS && NET_IPV4 && NET_UDP && !NET_IPV6
	depends on !PJSIP_TCP_TRANSPORT
	depends on !PJMEDIA_ENDPOINT && !PJMEDIA_G711 && !PJMEDIA_RTP_RTCP
	depends on !PJMEDIA_UDP_TRANSPORT && !PJMEDIA_STREAM && !PJMEDIA_AUDIODEV
	help
	  Validate INVITE call control, UDP retransmission and failure handling,
	  registration and OPTIONS concurrency, and complete teardown over two
	  IPv4 loopback SIP transports. No RTP or audio runtime is selected.

config PJMEDIA_PHASE7_G711_TEST
	bool "PJMEDIA Phase 7 endpoint and G.711 validation"
	depends on PJPROJECT && PJSIP && PJMEDIA_ENDPOINT && PJMEDIA_G711
	depends on !PJSIP_INVITE && !PJSIP_UDP_TRANSPORT && !PJSIP_TCP_TRANSPORT
	depends on !PJMEDIA_SDP_NEG && !PJMEDIA_RTP_RTCP
	depends on !PJMEDIA_UDP_TRANSPORT && !PJMEDIA_STREAM && !PJMEDIA_AUDIODEV
	help
	  Validate a zero-worker PJMEDIA endpoint sharing the PJSIP ioqueue and
	  deterministic PCMU/PCMA codec conversion, PLC, VAD, and teardown. This
	  does not select RTP, media transport, stream, or audio-device runtime.

config PJMEDIA_PHASE7_LINK_PROBE
	bool "PJMEDIA Phase 7 public API link probe"
	depends on PJPROJECT && PJSIP && PJMEDIA_ENDPOINT && PJMEDIA_G711
	depends on !PJSIP_INVITE && !PJSIP_UDP_TRANSPORT && !PJSIP_TCP_TRANSPORT
	depends on !PJMEDIA_SDP_NEG && !PJMEDIA_RTP_RTCP
	depends on !PJMEDIA_UDP_TRANSPORT && !PJMEDIA_STREAM && !PJMEDIA_AUDIODEV
	help
	  Retain the Phase 7 endpoint, codec manager, G.711, conversion, PLC,
	  VAD, WSOLA, event, format, and port public API closure.

config PJMEDIA_PHASE8_PACKET_TEST
	bool "PJMEDIA Phase 8 RTP/RTCP/jitter-buffer validation"
	depends on PJPROJECT && PJMEDIA_ENDPOINT && PJMEDIA_RTP_RTCP
	depends on !PJMEDIA_G711 && !PJMEDIA_SDP_NEG
	depends on !PJMEDIA_UDP_TRANSPORT && !PJMEDIA_STREAM && !PJMEDIA_AUDIODEV
	depends on !PJSIP
	help
	  Validate deterministic RTP packet bounds and sequence state, RTCP
	  reports/statistics, and jitter-buffer behavior without sockets, media
	  transport, streams, codecs, PJSIP, or audio devices.

config PJMEDIA_PHASE8_LINK_PROBE
	bool "PJMEDIA Phase 8 public API link probe"
	depends on PJPROJECT && PJMEDIA_ENDPOINT && PJMEDIA_RTP_RTCP
	depends on !PJMEDIA_G711 && !PJMEDIA_SDP_NEG
	depends on !PJMEDIA_UDP_TRANSPORT && !PJMEDIA_STREAM && !PJMEDIA_AUDIODEV
	depends on !PJSIP
	help
	  Retain the supported RTP, RTCP, RTCP-feedback, and jitter-buffer public
	  API closure under the normal section garbage-collection policy.

config PJMEDIA_PHASE8_DISABLED_TEST
	bool "PJMEDIA Phase 8 feature-disabled marker"
	depends on PJPROJECT && PJMEDIA_ENDPOINT && !PJMEDIA_RTP_RTCP
	depends on !PJMEDIA_G711 && !PJMEDIA_SDP_NEG
	depends on !PJMEDIA_UDP_TRANSPORT && !PJMEDIA_STREAM && !PJMEDIA_AUDIODEV
	depends on !PJSIP
	help
	  Emit an explicit marker for the like-for-like profile in which the
	  Phase 8 RTP/RTCP/jitter-buffer production gate remains disabled.

config PJMEDIA_PHASE9_TRANSPORT_TEST
	bool "PJMEDIA Phase 9 loop and IPv4 UDP transport validation"
	depends on PJPROJECT && PJSIP && PJSIP_REGC && PJSIP_UDP_TRANSPORT
	depends on PJMEDIA_ENDPOINT && PJMEDIA_RTP_RTCP
	depends on PJMEDIA_LOOP_TRANSPORT && PJMEDIA_UDP_TRANSPORT
	depends on NET_SOCKETS && NET_IPV4 && NET_UDP && !NET_IPV6
	depends on !PJSIP_INVITE && !PJSIP_TCP_TRANSPORT
	depends on !PJMEDIA_G711 && !PJMEDIA_SDP_NEG
	depends on !PJMEDIA_STREAM && !PJMEDIA_AUDIODEV
	help
	  Validate socket-free loop transport first, then deterministic RTP and
	  RTCP callbacks over explicit IPv4 UDP loopback sockets sharing PJSIP's
	  ioqueue. Also validate detach/cancellation/destruction and signaling
	  coexistence without creating a media stream or audio device.

config PJMEDIA_PHASE9_LINK_PROBE
	bool "PJMEDIA Phase 9 public API link probe"
	depends on PJPROJECT && PJSIP && PJMEDIA_ENDPOINT && PJMEDIA_RTP_RTCP
	depends on PJMEDIA_LOOP_TRANSPORT && PJMEDIA_UDP_TRANSPORT
	depends on NET_SOCKETS && NET_IPV4 && NET_UDP && !NET_IPV6
	depends on !PJMEDIA_G711 && !PJMEDIA_SDP_NEG
	depends on !PJMEDIA_STREAM && !PJMEDIA_AUDIODEV
	help
	  Retain the public loop and UDP media transport API closure under the
	  normal section garbage-collection policy.

config PJMEDIA_PHASE9_DISABLED_TEST
	bool "PJMEDIA Phase 9 feature-disabled marker"
	depends on PJPROJECT && PJMEDIA_ENDPOINT && PJMEDIA_RTP_RTCP
	depends on !PJMEDIA_LOOP_TRANSPORT && !PJMEDIA_UDP_TRANSPORT
	depends on !PJMEDIA_G711 && !PJMEDIA_SDP_NEG
	depends on !PJMEDIA_STREAM && !PJMEDIA_AUDIODEV && !PJSIP
	help
	  Emit an explicit marker for the like-for-like profile in which both
	  Phase 9 media transport production gates remain disabled.

config PJMEDIA_PHASE11_LINK_PROBE
	bool "PJMEDIA Phase 11 integrated call/stream link probe"
	depends on PJPROJECT && PJSIP && PJSIP_INVITE && PJSIP_REGC
	depends on PJSIP_UDP_TRANSPORT && PJMEDIA_SDP_NEG
	depends on PJMEDIA_ENDPOINT && PJMEDIA_G711 && PJMEDIA_RTP_RTCP
	depends on PJMEDIA_LOOP_TRANSPORT && PJMEDIA_UDP_TRANSPORT
	depends on PJMEDIA_STREAM && !PJMEDIA_AUDIODEV
	depends on NET_SOCKETS && NET_IPV4 && NET_UDP && !NET_IPV6
	help
	  Compile and retain the stream APIs needed by the integrated Phase 11
	  headless G.711 SIP call. Phase 10 is not exposed as a standalone image.

config PJMEDIA_PHASE11_CALL_TEST
	bool "PJMEDIA Phase 11 integrated headless G.711 SIP call"
	depends on PJPROJECT && PJSIP && PJSIP_INVITE && PJSIP_REGC
	depends on PJSIP_UDP_TRANSPORT && !PJSIP_TCP_TRANSPORT
	depends on PJMEDIA_SDP_NEG && PJMEDIA_ENDPOINT && PJMEDIA_G711
	depends on PJMEDIA_RTP_RTCP && PJMEDIA_LOOP_TRANSPORT
	depends on PJMEDIA_UDP_TRANSPORT && PJMEDIA_STREAM
	depends on !PJMEDIA_AUDIODEV
	depends on NET_SOCKETS && NET_IPV4 && NET_UDP && !NET_IPV6
	help
	  Validate a local SIP-controlled bidirectional G.711 RTP call using
	  deterministic PCM sources and memory sinks. This folds the stream work
	  into Phase 11 instead of publishing a standalone Phase 10 result.

config PJMEDIA_PHASE12_ROBUSTNESS_TEST
	bool "PJMEDIA Phase 12 headless media robustness validation"
	depends on PJPROJECT && PJSIP && PJSIP_INVITE && PJSIP_REGC
	depends on PJSIP_UDP_TRANSPORT && !PJSIP_TCP_TRANSPORT
	depends on PJMEDIA_SDP_NEG && PJMEDIA_ENDPOINT && PJMEDIA_G711
	depends on PJMEDIA_RTP_RTCP && PJMEDIA_LOOP_TRANSPORT
	depends on PJMEDIA_UDP_TRANSPORT && PJMEDIA_STREAM
	depends on !PJMEDIA_AUDIODEV
	depends on NET_SOCKETS && NET_IPV4 && NET_UDP && !NET_IPV6
	help
	  Repeat the complete Phase 11 signaling/media lifecycle with longer active
	  calls, cadence bounds, failure paths, resource accounting, and teardown.
	  The supported profile remains one call with two G.711 streams.

config PJMEDIA_SRTP_PRIMITIVE_TEST
	bool "PJMEDIA bundled SRTP primitive validation"
	depends on PJPROJECT && PJMEDIA_ENDPOINT && PJMEDIA_RTP_RTCP && PJMEDIA_SRTP
	depends on !PJSIP && !PJMEDIA_G711 && !PJMEDIA_UDP_TRANSPORT
	depends on !PJMEDIA_STREAM && !PJMEDIA_AUDIODEV
	help
	  Validate AES_CM_128_HMAC_SHA1_80 RTP/SRTCP protection, authentication,
	  replay rejection, lifecycle, and bounded packets without sockets.

config PJMEDIA_SRTP_TRANSPORT_TEST
	bool "PJMEDIA SRTP transport over IPv4 UDP validation"
	depends on PJPROJECT && PJLIB_UTIL && PJMEDIA_ENDPOINT
	depends on PJMEDIA_RTP_RTCP && PJMEDIA_UDP_TRANSPORT
	depends on PJMEDIA_SRTP && PJMEDIA_SRTP_TRANSPORT
	depends on NET_SOCKETS && NET_IPV4 && NET_UDP && !NET_IPV6
	depends on !PJSIP && !PJMEDIA_G711 && !PJMEDIA_STREAM && !PJMEDIA_AUDIODEV
	help
	  Validate two explicit-key PJMEDIA SRTP adapters carrying authenticated
	  RTP and RTCP over distinct IPv4 UDP transports, including plaintext
	  rejection and complete transport teardown.

config PJMEDIA_SRTP_SDES_TEST
	bool "PJMEDIA strict SRTP SDES negotiation validation"
	depends on PJPROJECT && PJLIB_UTIL && PJMEDIA_ENDPOINT && PJMEDIA_SDP
	depends on PJMEDIA_RTP_RTCP && PJMEDIA_LOOP_TRANSPORT
	depends on PJMEDIA_SRTP && PJMEDIA_SRTP_TRANSPORT && PJMEDIA_SRTP_SDES
	depends on !PJSIP && !PJMEDIA_G711 && !PJMEDIA_STREAM && !PJMEDIA_AUDIODEV
	help
	  Validate mandatory RTP/SAVP and AES_CM_128_HMAC_SHA1_80 SDES
	  offer/answer, malformed and unsupported crypto rejection, downgrade
	  rejection, key containment, and teardown without a media stream.

endmenu
```

## prj.conf
```kconfig
CONFIG_CONSOLE=y
CONFIG_PRINTK=y
CONFIG_SERIAL=y

CONFIG_CPP=y
CONFIG_GLIBCXX_LIBCPP=y
CONFIG_PICOLIBC=y
CONFIG_POSIX_API=y
CONFIG_DYNAMIC_THREAD=y
CONFIG_DYNAMIC_THREAD_POOL_SIZE=5
CONFIG_DYNAMIC_THREAD_STACK_SIZE=8192

# Retain the validated PJLIB socket/POSIX platform boundary even though Phase
# 1 does not create SIP or media sockets.
CONFIG_NETWORKING=y
CONFIG_NET_SOCKETS=y
CONFIG_NET_IPV4=y
CONFIG_NET_IPV6=n
CONFIG_NET_TCP=y
CONFIG_NET_UDP=y
CONFIG_DNS_RESOLVER=y
CONFIG_TEST_RANDOM_GENERATOR=y

CONFIG_NET_QEMU_SLIP=n
CONFIG_NET_SLIP_TAP=n
CONFIG_SLIP=n

# The independent PJMEDIA application defaults to the prior PJLIB-only
# boundary. No PJMEDIA header, source, or configuration is enabled here.
CONFIG_PJPROJECT=y
CONFIG_PJLIB_UTIL=n
CONFIG_PJSIP=n
CONFIG_PJMEDIA=n
```

## phase11_call.conf
```kconfig
CONFIG_PJLIB_UTIL=y
CONFIG_PJMEDIA=y
CONFIG_PJMEDIA_SDP=y
CONFIG_PJMEDIA_SDP_NEG=y
CONFIG_PJMEDIA_ENDPOINT=y
CONFIG_PJMEDIA_G711=y
CONFIG_PJMEDIA_RTP_RTCP=y
CONFIG_PJMEDIA_LOOP_TRANSPORT=y
CONFIG_PJMEDIA_UDP_TRANSPORT=y
CONFIG_PJMEDIA_STREAM=y
CONFIG_PJMEDIA_AUDIODEV=n

CONFIG_PJSIP=y
CONFIG_PJSIP_INVITE=y
CONFIG_PJSIP_REGC=y
CONFIG_PJSIP_UDP_TRANSPORT=y
CONFIG_PJSIP_TCP_TRANSPORT=n

CONFIG_NET_IPV6=n
CONFIG_NET_LOOPBACK=y
CONFIG_NET_MAX_CONTEXTS=40
CONFIG_NET_MAX_CONN=48
CONFIG_ZVFS_OPEN_MAX=56
CONFIG_ZVFS_POLL_MAX=48
CONFIG_NET_BUF_DATA_SIZE=256
CONFIG_NET_BUF_RX_COUNT=64
CONFIG_NET_BUF_TX_COUNT=64
CONFIG_NET_PKT_RX_COUNT=32
CONFIG_NET_PKT_TX_COUNT=32

CONFIG_PJMEDIA_PHASE11_CALL_TEST=y

CONFIG_HEAP_MEM_POOL_SIZE=786432
CONFIG_MAIN_STACK_SIZE=49152
CONFIG_DYNAMIC_THREAD_POOL_SIZE=12
CONFIG_DYNAMIC_THREAD_STACK_SIZE=16384
CONFIG_MAX_PTHREAD_MUTEX_COUNT=96
CONFIG_INIT_STACKS=y
CONFIG_THREAD_STACK_INFO=y
```

## phase11_link_probe.conf
```kconfig
CONFIG_PJLIB_UTIL=y
CONFIG_PJMEDIA=y
CONFIG_PJMEDIA_SDP=y
CONFIG_PJMEDIA_SDP_NEG=y
CONFIG_PJMEDIA_ENDPOINT=y
CONFIG_PJMEDIA_G711=y
CONFIG_PJMEDIA_RTP_RTCP=y
CONFIG_PJMEDIA_LOOP_TRANSPORT=y
CONFIG_PJMEDIA_UDP_TRANSPORT=y
CONFIG_PJMEDIA_STREAM=y
CONFIG_PJMEDIA_AUDIODEV=n

CONFIG_PJSIP=y
CONFIG_PJSIP_INVITE=y
CONFIG_PJSIP_REGC=y
CONFIG_PJSIP_UDP_TRANSPORT=y
CONFIG_PJSIP_TCP_TRANSPORT=n

CONFIG_NET_IPV6=n
CONFIG_NET_LOOPBACK=y
CONFIG_PJMEDIA_PHASE11_LINK_PROBE=y

CONFIG_HEAP_MEM_POOL_SIZE=524288
CONFIG_MAIN_STACK_SIZE=32768
CONFIG_DYNAMIC_THREAD_POOL_SIZE=10
CONFIG_DYNAMIC_THREAD_STACK_SIZE=8192
CONFIG_MAX_PTHREAD_MUTEX_COUNT=64
```

## phase12_robustness.conf
```kconfig
CONFIG_PJMEDIA_PHASE12_ROBUSTNESS_TEST=y

CONFIG_PJLIB_UTIL=y
CONFIG_PJMEDIA=y
CONFIG_PJMEDIA_SDP=y
CONFIG_PJMEDIA_SDP_NEG=y
CONFIG_PJMEDIA_ENDPOINT=y
CONFIG_PJMEDIA_G711=y
CONFIG_PJMEDIA_RTP_RTCP=y
CONFIG_PJMEDIA_LOOP_TRANSPORT=y
CONFIG_PJMEDIA_UDP_TRANSPORT=y
CONFIG_PJMEDIA_STREAM=y
CONFIG_PJMEDIA_AUDIODEV=n

CONFIG_PJSIP=y
CONFIG_PJSIP_INVITE=y
CONFIG_PJSIP_REGC=y
CONFIG_PJSIP_UDP_TRANSPORT=y
CONFIG_PJSIP_TCP_TRANSPORT=n

CONFIG_NET_IPV6=n
CONFIG_NET_LOOPBACK=y
CONFIG_NET_MAX_CONTEXTS=40
CONFIG_NET_MAX_CONN=48
CONFIG_ZVFS_OPEN_MAX=56
CONFIG_ZVFS_POLL_MAX=48
CONFIG_NET_BUF_DATA_SIZE=256
CONFIG_NET_BUF_RX_COUNT=64
CONFIG_NET_BUF_TX_COUNT=64
CONFIG_NET_PKT_RX_COUNT=32
CONFIG_NET_PKT_TX_COUNT=32

CONFIG_HEAP_MEM_POOL_SIZE=786432
CONFIG_MAIN_STACK_SIZE=49152
CONFIG_DYNAMIC_THREAD_POOL_SIZE=12
CONFIG_DYNAMIC_THREAD_STACK_SIZE=16384
CONFIG_MAX_PTHREAD_MUTEX_COUNT=96
CONFIG_INIT_STACKS=y
CONFIG_THREAD_STACK_INFO=y
```

## phase1_boundary.conf
```kconfig
CONFIG_PJLIB_UTIL=y
CONFIG_PJMEDIA=y
CONFIG_PJMEDIA_SDP=y
CONFIG_PJMEDIA_SDP_NEG=n
CONFIG_PJMEDIA_ENDPOINT=y
CONFIG_PJMEDIA_G711=y
CONFIG_PJMEDIA_RTP_RTCP=n
CONFIG_PJMEDIA_UDP_TRANSPORT=n
CONFIG_PJMEDIA_STREAM=n
CONFIG_PJMEDIA_AUDIODEV=n
CONFIG_PJSIP_INVITE=n

CONFIG_PJMEDIA_PHASE1_BOUNDARY_TEST=y
```

## phase2_sdp.conf
```kconfig
CONFIG_PJLIB_UTIL=y
CONFIG_PJMEDIA=y
CONFIG_PJMEDIA_SDP=y
CONFIG_PJMEDIA_SDP_NEG=n
CONFIG_PJMEDIA_ENDPOINT=n
CONFIG_PJMEDIA_G711=n
CONFIG_PJMEDIA_RTP_RTCP=n
CONFIG_PJMEDIA_UDP_TRANSPORT=n
CONFIG_PJMEDIA_STREAM=n
CONFIG_PJMEDIA_AUDIODEV=n
CONFIG_PJSIP=n
CONFIG_PJSIP_INVITE=n

CONFIG_PJMEDIA_PHASE2_SDP_TEST=y

CONFIG_HEAP_MEM_POOL_SIZE=131072
CONFIG_MAIN_STACK_SIZE=24576
CONFIG_INIT_STACKS=y
CONFIG_THREAD_STACK_INFO=y
```

## phase3_link_probe.conf
```kconfig
CONFIG_PJLIB_UTIL=y
CONFIG_PJMEDIA=y
CONFIG_PJMEDIA_SDP=y
CONFIG_PJMEDIA_SDP_NEG=y
CONFIG_PJMEDIA_ENDPOINT=n
CONFIG_PJMEDIA_G711=n
CONFIG_PJMEDIA_RTP_RTCP=n
CONFIG_PJMEDIA_UDP_TRANSPORT=n
CONFIG_PJMEDIA_STREAM=n
CONFIG_PJMEDIA_AUDIODEV=n
CONFIG_PJSIP=n
CONFIG_PJSIP_INVITE=n

CONFIG_PJMEDIA_PHASE3_LINK_PROBE=y

CONFIG_HEAP_MEM_POOL_SIZE=131072
CONFIG_MAIN_STACK_SIZE=24576
```

## src/main.c
```c
#include <zephyr/sys/printk.h>

#if defined(CONFIG_PJLIB)
#include <pjlib.h>
#endif

#if defined(CONFIG_PJMEDIA_PHASE1_BOUNDARY_TEST)
int phase1_boundary_run(void);
#endif

#if defined(CONFIG_PJMEDIA_PHASE2_SDP_TEST)
int phase2_sdp_run(void);
#endif

#if defined(CONFIG_PJMEDIA_PHASE3_SDP_NEG_TEST)
int phase3_sdp_neg_run(void);
#endif

#if defined(CONFIG_PJMEDIA_PHASE3_LINK_PROBE)
int phase3_link_probe_run(void);
#endif

#if defined(CONFIG_PJMEDIA_PHASE4_INVITE_TEST)
int phase4_invite_run(void);
#endif

#if defined(CONFIG_PJMEDIA_PHASE5_LOOP_CALL_TEST)
int phase5_loop_call_run(void);
#endif

#if defined(CONFIG_PJMEDIA_PHASE6_UDP_CALL_TEST)
int phase6_udp_call_run(void);
#endif

#if defined(CONFIG_PJMEDIA_PHASE7_G711_TEST)
int phase7_g711_run(void);
#endif

#if defined(CONFIG_PJMEDIA_PHASE7_LINK_PROBE)
int phase7_link_probe_run(void);
#endif

#if defined(CONFIG_PJMEDIA_PHASE8_PACKET_TEST)
int phase8_packet_run(void);
#endif

#if defined(CONFIG_PJMEDIA_PHASE8_LINK_PROBE)
int phase8_link_probe_run(void);
#endif

#if defined(CONFIG_PJMEDIA_PHASE9_TRANSPORT_TEST)
int phase9_transport_run(void);
#endif

#if defined(CONFIG_PJMEDIA_PHASE9_LINK_PROBE)
int phase9_link_probe_run(void);
#endif

#if defined(CONFIG_PJMEDIA_PHASE11_LINK_PROBE)
int phase11_link_probe_run(void);
#endif

#if defined(CONFIG_PJMEDIA_PHASE11_CALL_TEST)
int phase11_call_run(void);
#endif

#if defined(CONFIG_PJMEDIA_PHASE12_ROBUSTNESS_TEST)
int phase12_robustness_run(void);
#endif

#if defined(CONFIG_PJMEDIA_SRTP_PRIMITIVE_TEST)
int srtp_primitives_run(void);
#endif

#if defined(CONFIG_PJMEDIA_SRTP_TRANSPORT_TEST)
int srtp_transport_run(void);
#endif

#if defined(CONFIG_PJMEDIA_SRTP_SDES_TEST)
int srtp_sdes_run(void);
#endif

int main(void)
{
	printk("PJMEDIA minimal Zephyr application\n");

#if defined(CONFIG_PJMEDIA_SRTP_SDES_TEST)
	return srtp_sdes_run();
#elif defined(CONFIG_PJMEDIA_SRTP_TRANSPORT_TEST)
	return srtp_transport_run();
#elif defined(CONFIG_PJMEDIA_SRTP_PRIMITIVE_TEST)
	return srtp_primitives_run();
#elif defined(CONFIG_PJMEDIA_PHASE12_ROBUSTNESS_TEST)
	return phase12_robustness_run();
#elif defined(CONFIG_PJMEDIA_PHASE11_CALL_TEST)
	return phase11_call_run();
#elif defined(CONFIG_PJMEDIA_PHASE11_LINK_PROBE)
	return phase11_link_probe_run();
#elif defined(CONFIG_PJMEDIA_PHASE9_LINK_PROBE)
	return phase9_link_probe_run();
#elif defined(CONFIG_PJMEDIA_PHASE9_TRANSPORT_TEST)
	return phase9_transport_run();
#elif defined(CONFIG_PJMEDIA_PHASE9_DISABLED_TEST)
	{
		pj_status_t status = pj_init();

		if (status != PJ_SUCCESS) {
			printk("Phase 9 disabled profile: PJLIB init failed: %d\n",
			       status);
			return 1;
		}
		pj_shutdown();
		printk("PHASE 9 DISABLED: PASSED (no media transport objects)\n");
		return 0;
	}
#elif defined(CONFIG_PJMEDIA_PHASE8_LINK_PROBE)
	return phase8_link_probe_run();
#elif defined(CONFIG_PJMEDIA_PHASE8_PACKET_TEST)
	return phase8_packet_run();
#elif defined(CONFIG_PJMEDIA_PHASE8_DISABLED_TEST)
	{
		pj_status_t status = pj_init();

		if (status != PJ_SUCCESS) {
			printk("Phase 8 disabled profile: PJLIB init failed: %d\n",
			       status);
			return 1;
		}
		pj_shutdown();
		printk("PHASE 8 DISABLED: PASSED (no RTP/RTCP/jitter objects)\n");
		return 0;
	}
#elif defined(CONFIG_PJMEDIA_PHASE7_LINK_PROBE)
	return phase7_link_probe_run();
#elif defined(CONFIG_PJMEDIA_PHASE7_G711_TEST)
	return phase7_g711_run();
#elif defined(CONFIG_PJMEDIA_PHASE6_UDP_CALL_TEST)
	return phase6_udp_call_run();
#elif defined(CONFIG_PJMEDIA_PHASE5_LOOP_CALL_TEST)
	return phase5_loop_call_run();
#elif defined(CONFIG_PJMEDIA_PHASE3_LINK_PROBE)
	return phase3_link_probe_run();
#elif defined(CONFIG_PJMEDIA_PHASE4_INVITE_TEST)
	return phase4_invite_run();
#elif defined(CONFIG_PJMEDIA_PHASE3_SDP_NEG_TEST)
	return phase3_sdp_neg_run();
#elif defined(CONFIG_PJMEDIA_PHASE2_SDP_TEST)
	return phase2_sdp_run();
#elif defined(CONFIG_PJMEDIA_PHASE1_BOUNDARY_TEST)
	return phase1_boundary_run();
#elif defined(CONFIG_PJLIB)
	pj_status_t status = pj_init();

	if (status != PJ_SUCCESS) {
		printk("PJLIB initialization failed: %d\n", status);
		return 1;
	}

	printk("PJMEDIA disabled; PJLIB boundary initialized\n");
	pj_shutdown();
#else
	printk("PJPROJECT disabled\n");
#endif

	return 0;
}
```

## src/phase11_call.c
```c
#define phase6_udp_call_run phase11_signaling_run
#include "phase6_udp_call.c"

int phase11_call_run(void)
{
	int result = phase11_signaling_run();

	if (result == 0)
		printk("PHASE 11 RESULT: PASSED (integrated SIP-controlled headless G.711 media)\n");
	else
		printk("PHASE 11 RESULT: FAILED\n");
	return result;
}
```

## src/phase11_link_probe.c
```c
#include <zephyr/sys/printk.h>

#include <pjlib.h>
#include <pjmedia/stream.h>

static volatile pj_bool_t invoke_probe_calls;

int phase11_link_probe_run(void)
{
	pjmedia_stream *stream = NULL;
	pjmedia_stream_info info;
	pjmedia_port *port = NULL;
	pjmedia_rtcp_stat stat;
	pjmedia_jb_state jb;
	pj_str_t digits = pj_str("5");
	pj_status_t status = pj_init();

	pj_bzero(&info, sizeof(info));
	if (status == PJ_SUCCESS && invoke_probe_calls) {
		(void)pjmedia_stream_create(NULL, NULL, &info, NULL, NULL, &stream);
		(void)pjmedia_stream_get_port(stream, &port);
		(void)pjmedia_stream_get_info(stream, &info);
		(void)pjmedia_stream_get_stat(stream, &stat);
		(void)pjmedia_stream_get_stat_jbuf(stream, &jb);
		(void)pjmedia_stream_start(stream);
		(void)pjmedia_stream_pause(stream, PJMEDIA_DIR_ENCODING_DECODING);
		(void)pjmedia_stream_resume(stream, PJMEDIA_DIR_ENCODING_DECODING);
		(void)pjmedia_stream_dial_dtmf(stream, &digits);
		(void)pjmedia_stream_destroy(stream);
	}
	pj_shutdown();
	if (status != PJ_SUCCESS)
		return 1;
	printk("PHASE 11 LINK PROBE: PASSED (integrated G.711 stream closure retained)\n");
	return 0;
}
```

## src/phase11_media.c
```c
#include "phase11_media.h"

#include <zephyr/kernel.h>
#include <zephyr/sys/printk.h>

#include <pjmedia/endpoint.h>
#include <pjmedia/event.h>
#include <pjmedia/g711.h>
#include <pjmedia/stream.h>
#include <pjmedia/transport_udp.h>

#define PHASE11_FRAME_SAMPLES 160
#define PHASE11_FRAME_BYTES (PHASE11_FRAME_SAMPLES * sizeof(pj_int16_t))
#if defined(CONFIG_PJMEDIA_PHASE12_ROBUSTNESS_TEST)
#define PHASE11_MEDIA_FRAMES 120
#else
#define PHASE11_MEDIA_FRAMES 36
#endif

struct phase11_media_context {
	pj_pool_factory *factory;
	pjmedia_endpt *endpt;
	pj_pool_t *event_pool;
	pjmedia_event_mgr *event_mgr;
	pj_pool_t *pool;
	pjmedia_transport *uac_transport;
	pjmedia_transport *uas_transport;
	pjmedia_stream *uac_stream;
	pjmedia_stream *uas_stream;
	pjmedia_port *uac_port;
	pjmedia_port *uas_port;
	unsigned uac_rtp_port;
	unsigned uas_rtp_port;
	pj_uint32_t uac_hash;
	pj_uint32_t uas_hash;
	unsigned uac_frames;
	unsigned uas_frames;
	unsigned max_lateness_ms;
	pj_bool_t codec_initialized;
};

static struct phase11_media_context media;

static pj_status_t make_bound_socket(pj_sock_t *socket, pj_sockaddr *address)
{
	pj_sockaddr_in bind_address;
	pj_str_t loopback = pj_str("127.0.0.1");
	int address_length = sizeof(*address);
	pj_status_t status;

	*socket = PJ_INVALID_SOCKET;
	status = pj_sock_socket(pj_AF_INET(), pj_SOCK_DGRAM() | pj_SOCK_CLOEXEC(),
				0, socket);
	if (status == PJ_SUCCESS)
		status = pj_sockaddr_in_init(&bind_address, &loopback, 0);
	if (status == PJ_SUCCESS)
		status = pj_sock_bind(*socket, &bind_address,
				      sizeof(bind_address));
	if (status == PJ_SUCCESS)
		status = pj_sock_getsockname(*socket, address, &address_length);
	if (status != PJ_SUCCESS && *socket != PJ_INVALID_SOCKET) {
		pj_sock_close(*socket);
		*socket = PJ_INVALID_SOCKET;
	}
	return status;
}

static pj_status_t create_udp_transport(const char *name,
					pjmedia_transport **transport,
					unsigned *rtp_port)
{
	pjmedia_sock_info socket_info;
	pj_status_t status;
	pj_bool_t attach_attempted = PJ_FALSE;

	pj_bzero(&socket_info, sizeof(socket_info));
	socket_info.rtp_sock = socket_info.rtcp_sock = PJ_INVALID_SOCKET;
	status = make_bound_socket(&socket_info.rtp_sock,
				   &socket_info.rtp_addr_name);
	if (status == PJ_SUCCESS)
		status = make_bound_socket(&socket_info.rtcp_sock,
					   &socket_info.rtcp_addr_name);
	if (status == PJ_SUCCESS) {
		*rtp_port = pj_sockaddr_get_port(&socket_info.rtp_addr_name);
		attach_attempted = PJ_TRUE;
		status = pjmedia_transport_udp_attach(
			media.endpt, name, &socket_info,
			PJMEDIA_UDP_NO_SRC_ADDR_CHECKING, transport);
	}
	if (attach_attempted)
		socket_info.rtp_sock = socket_info.rtcp_sock = PJ_INVALID_SOCKET;
	if (status != PJ_SUCCESS) {
		if (socket_info.rtp_sock != PJ_INVALID_SOCKET)
			pj_sock_close(socket_info.rtp_sock);
		if (socket_info.rtcp_sock != PJ_INVALID_SOCKET)
			pj_sock_close(socket_info.rtcp_sock);
	}
	return status;
}

static pj_uint32_t hash_frame(pj_uint32_t hash, const pjmedia_frame *frame)
{
	const pj_uint8_t *bytes = frame->buf;

	for (pj_size_t i = 0; i < frame->size; ++i) {
		hash ^= bytes[i];
		hash *= 16777619u;
	}
	return hash;
}

static pj_status_t create_stream(pjsip_inv_session *inv,
				 pjmedia_transport *transport,
				 pjmedia_stream **stream,
				 pjmedia_port **port)
{
	const pjmedia_sdp_session *local = NULL;
	const pjmedia_sdp_session *remote = NULL;
	pjmedia_stream_info info;
	pj_status_t status;

	status = pjmedia_sdp_neg_get_active_local(inv->neg, &local);
	if (status == PJ_SUCCESS)
		status = pjmedia_sdp_neg_get_active_remote(inv->neg, &remote);
	if (status == PJ_SUCCESS)
		status = pjmedia_stream_info_from_sdp(&info, media.pool, media.endpt,
						      local, remote, 0);
	/* Bind each stream to the peer port allocated before SDP.  This also makes
	 * the signaling/media agreement explicit in the synthetic loopback call. */
	if (status == PJ_SUCCESS) {
		pj_str_t loopback = pj_str("127.0.0.1");
		unsigned port = (transport == media.uac_transport) ?
			media.uas_rtp_port : media.uac_rtp_port;
		pj_sockaddr_in_init((pj_sockaddr_in *)&info.rem_addr, &loopback, port);
		if (!info.rtcp_mux)
			pj_sockaddr_in_init((pj_sockaddr_in *)&info.rem_rtcp, &loopback,
					    port + 1);
	}
	if (status == PJ_SUCCESS)
		status = pjmedia_transport_media_start(transport, media.pool, local,
						       remote, 0);
	if (status == PJ_SUCCESS)
		status = pjmedia_stream_create(media.endpt, media.pool, &info,
					       transport, NULL, stream);
	if (status == PJ_SUCCESS)
		status = pjmedia_stream_get_port(*stream, port);
	if (status == PJ_SUCCESS)
		status = pjmedia_stream_start(*stream);
	return status;
}

pj_status_t phase11_media_lifecycle_init(pj_pool_factory *factory,
					 pjsip_endpoint *sip_endpt)
{
	pj_status_t status;

	pj_bzero(&media, sizeof(media));
	media.factory = factory;
	status = pjmedia_endpt_create2(factory, pjsip_endpt_get_ioqueue(sip_endpt),
				       0, &media.endpt);
	if (status == PJ_SUCCESS) {
		media.event_pool = pj_pool_create(factory, "phase11-events", 4096,
						 4096, NULL);
		if (media.event_pool == NULL)
			status = PJ_ENOMEM;
	}
	if (status == PJ_SUCCESS)
		status = pjmedia_event_mgr_create(media.event_pool,
						  PJMEDIA_EVENT_MGR_NO_THREAD,
						  &media.event_mgr);
	if (status == PJ_SUCCESS)
		status = pjmedia_codec_g711_init(media.endpt);
	if (status == PJ_SUCCESS)
		media.codec_initialized = PJ_TRUE;
	return status;
}

pj_status_t phase11_media_prepare_call(void)
{
	pj_status_t status;

	if (media.pool != NULL)
		return PJ_EINVALIDOP;
	media.pool = pj_pool_create(media.factory, "phase11-media", 65536, 32768,
				    NULL);
	if (media.pool == NULL)
		return PJ_ENOMEM;
	status = create_udp_transport("p11-uac", &media.uac_transport,
				      &media.uac_rtp_port);
	if (status == PJ_SUCCESS)
		status = create_udp_transport("p11-uas", &media.uas_transport,
					      &media.uas_rtp_port);
	if (status == PJ_SUCCESS)
		printk("[Phase 11] media allocated before SDP: UAC RTP=%u, UAS RTP=%u\n",
		       media.uac_rtp_port, media.uas_rtp_port);
	return status;
}

unsigned phase11_media_sdp_port(pj_bool_t uas)
{
	return uas ? media.uas_rtp_port : media.uac_rtp_port;
}

pj_status_t phase11_media_start_call(pjsip_inv_session *uac,
				     pjsip_inv_session *uas)
{
	pj_status_t status;

	status = create_stream(uac, media.uac_transport, &media.uac_stream,
			       &media.uac_port);
	if (status == PJ_SUCCESS)
		status = create_stream(uas, media.uas_transport, &media.uas_stream,
				       &media.uas_port);
	if (status == PJ_SUCCESS)
		printk("[Phase 11] negotiated G.711 streams started after call confirmation\n");
	return status;
}

pj_status_t phase11_media_exercise_call(void)
{
	pj_int16_t uac_tx[PHASE11_FRAME_SAMPLES];
	pj_int16_t uas_tx[PHASE11_FRAME_SAMPLES];
	pj_int16_t uac_rx[PHASE11_FRAME_SAMPLES];
	pj_int16_t uas_rx[PHASE11_FRAME_SAMPLES];
	pjmedia_rtcp_stat uac_stat;
	pjmedia_rtcp_stat uas_stat;
	pjmedia_jb_state jb;
	pj_str_t digit = pj_str("5");
	pj_status_t status = PJ_SUCCESS;

	media.uac_hash = media.uas_hash = 2166136261u;
	media.uac_frames = media.uas_frames = 0;
	media.max_lateness_ms = 0;
	for (unsigned frame_no = 0; frame_no < PHASE11_MEDIA_FRAMES; ++frame_no) {
		pjmedia_frame tx;
		pjmedia_frame rx;
		int64_t cadence_deadline = k_uptime_get() + 20;

		for (unsigned i = 0; i < PHASE11_FRAME_SAMPLES; ++i) {
			uac_tx[i] = (pj_int16_t)(((frame_no * 97 + i * 31) & 0x3fff) - 8192);
			uas_tx[i] = (pj_int16_t)(((frame_no * 53 + i * 19) & 0x3fff) - 8192);
		}
		pj_bzero(&tx, sizeof(tx));
		tx.type = PJMEDIA_FRAME_TYPE_AUDIO;
		tx.buf = uac_tx;
		tx.size = sizeof(uac_tx);
		tx.timestamp.u64 = (pj_uint64_t)frame_no * PHASE11_FRAME_SAMPLES;
		status = pjmedia_port_put_frame(media.uac_port, &tx);
		if (status != PJ_SUCCESS)
			return status;
		tx.buf = uas_tx;
		status = pjmedia_port_put_frame(media.uas_port, &tx);
		if (status != PJ_SUCCESS)
			return status;
		if (frame_no == 4) {
			status = pjmedia_stream_dial_dtmf(media.uac_stream, &digit);
			if (status != PJ_SUCCESS)
				return status;
		}
		if (frame_no == 18) {
			status = pjmedia_stream_pause(media.uac_stream,
						      PJMEDIA_DIR_ENCODING);
			if (status != PJ_SUCCESS)
				return status;
		}
		if (frame_no == 20) {
			status = pjmedia_stream_resume(media.uac_stream,
						       PJMEDIA_DIR_ENCODING);
			if (status != PJ_SUCCESS)
				return status;
		}
		pj_thread_sleep(20);
		{
			int64_t late = k_uptime_get() - cadence_deadline;

			if (late > (int64_t)media.max_lateness_ms)
				media.max_lateness_ms = (unsigned)late;
		}
		pj_bzero(&rx, sizeof(rx));
		rx.buf = uac_rx;
		rx.size = sizeof(uac_rx);
		status = pjmedia_port_get_frame(media.uac_port, &rx);
		if (status != PJ_SUCCESS)
			return status;
		if (rx.type == PJMEDIA_FRAME_TYPE_AUDIO) {
			media.uac_hash = hash_frame(media.uac_hash, &rx);
			++media.uac_frames;
		}
		rx.buf = uas_rx;
		rx.size = sizeof(uas_rx);
		status = pjmedia_port_get_frame(media.uas_port, &rx);
		if (status != PJ_SUCCESS)
			return status;
		if (rx.type == PJMEDIA_FRAME_TYPE_AUDIO) {
			media.uas_hash = hash_frame(media.uas_hash, &rx);
			++media.uas_frames;
		}
	}
	status = pjmedia_stream_get_stat(media.uac_stream, &uac_stat);
	if (status == PJ_SUCCESS)
		status = pjmedia_stream_get_stat(media.uas_stream, &uas_stat);
	if (status == PJ_SUCCESS)
		status = pjmedia_stream_get_stat_jbuf(media.uas_stream, &jb);
	if (status != PJ_SUCCESS)
		return status;
	printk("[Phase 11] acceptance: frames=%u/%u RTP uac=%u/%u uas=%u/%u dtmf=%u\n",
	       media.uac_frames, media.uas_frames, uac_stat.tx.pkt,
	       uac_stat.rx.pkt, uas_stat.tx.pkt, uas_stat.rx.pkt,
	       pjmedia_stream_check_dtmf(media.uas_stream));
	if (media.uac_frames < PHASE11_MEDIA_FRAMES - 12 ||
	    media.uas_frames < PHASE11_MEDIA_FRAMES - 12 ||
	    uac_stat.tx.pkt < PHASE11_MEDIA_FRAMES - 12 ||
	    uac_stat.rx.pkt < PHASE11_MEDIA_FRAMES - 12 ||
	    uas_stat.tx.pkt < PHASE11_MEDIA_FRAMES - 12 ||
	    uas_stat.rx.pkt < PHASE11_MEDIA_FRAMES - 12 ||
	    media.max_lateness_ms > 20 ||
	    !pjmedia_stream_check_dtmf(media.uas_stream))
		return PJ_EUNKNOWN;
	{
		char received[2];
		unsigned count = sizeof(received);

		status = pjmedia_stream_get_dtmf(media.uas_stream, received, &count);
		if (status != PJ_SUCCESS || count != 1 || received[0] != '5')
			return status != PJ_SUCCESS ? status : PJ_EUNKNOWN;
	}
	printk("[Phase 11] bidirectional PCM: UAC frames=%u hash=%08x, UAS frames=%u hash=%08x; RTP tx/rx=%u/%u,%u/%u; JB=%u: PASSED\n",
	       media.uac_frames, media.uac_hash, media.uas_frames, media.uas_hash,
	       uac_stat.tx.pkt, uac_stat.rx.pkt, uas_stat.tx.pkt, uas_stat.rx.pkt,
	       jb.size);
	printk("[Phase 11] 20 ms cadence, telephone-event, pause, and resume: PASSED\n");
#if defined(CONFIG_PJMEDIA_PHASE12_ROBUSTNESS_TEST)
	printk("[Phase 12] cadence max lateness=%u ms across %u frames: PASSED\n",
	       media.max_lateness_ms, PHASE11_MEDIA_FRAMES);
#endif
	return PJ_SUCCESS;
}

pj_status_t phase11_media_stop_call(void)
{
	pj_status_t result = PJ_SUCCESS;
	pj_status_t status;

	if (media.uac_stream != NULL) {
		status = pjmedia_stream_destroy(media.uac_stream);
		if (status != PJ_SUCCESS)
			result = status;
		media.uac_stream = NULL;
		media.uac_port = NULL;
	}
	if (media.uas_stream != NULL) {
		status = pjmedia_stream_destroy(media.uas_stream);
		if (status != PJ_SUCCESS)
			result = status;
		media.uas_stream = NULL;
		media.uas_port = NULL;
	}
	if (media.uac_transport != NULL) {
		status = pjmedia_transport_media_stop(media.uac_transport);
		if (status != PJ_SUCCESS)
			result = status;
	}
	if (media.uas_transport != NULL) {
		status = pjmedia_transport_media_stop(media.uas_transport);
		if (status != PJ_SUCCESS)
			result = status;
	}
	if (media.uac_transport != NULL) {
		status = pjmedia_transport_close(media.uac_transport);
		if (status != PJ_SUCCESS)
			result = status;
		media.uac_transport = NULL;
	}
	if (media.uas_transport != NULL) {
		status = pjmedia_transport_close(media.uas_transport);
		if (status != PJ_SUCCESS)
			result = status;
		media.uas_transport = NULL;
	}
	if (media.pool != NULL) {
		pj_pool_release(media.pool);
		media.pool = NULL;
	}
	media.uac_rtp_port = media.uas_rtp_port = 0;
	return result;
}

pj_status_t phase11_media_lifecycle_destroy(void)
{
	pj_status_t result = phase11_media_stop_call();
	pj_status_t status;

	if (media.codec_initialized) {
		status = pjmedia_codec_g711_deinit();
		if (status != PJ_SUCCESS)
			result = status;
		media.codec_initialized = PJ_FALSE;
	}
	if (media.event_mgr != NULL) {
		pjmedia_event_mgr_destroy(media.event_mgr);
		media.event_mgr = NULL;
	}
	if (media.event_pool != NULL) {
		pj_pool_release(media.event_pool);
		media.event_pool = NULL;
	}
	if (media.endpt != NULL) {
		status = pjmedia_endpt_destroy2(media.endpt);
		if (status != PJ_SUCCESS)
			result = status;
		media.endpt = NULL;
	}
	return result;
}
```

## src/phase11_media.h
```c
#ifndef PHASE11_MEDIA_H
#define PHASE11_MEDIA_H

#include <pjlib.h>
#include <pjsip.h>
#include <pjsip-ua/sip_inv.h>

pj_status_t phase11_media_lifecycle_init(pj_pool_factory *factory,
					 pjsip_endpoint *sip_endpt);
pj_status_t phase11_media_prepare_call(void);
unsigned phase11_media_sdp_port(pj_bool_t uas);
pj_status_t phase11_media_start_call(pjsip_inv_session *uac,
				     pjsip_inv_session *uas);
pj_status_t phase11_media_exercise_call(void);
pj_status_t phase11_media_stop_call(void);
pj_status_t phase11_media_lifecycle_destroy(void);

#endif
```

## src/phase12_robustness.c
```c
#define PHASE6_LIFECYCLES 1
#define PHASE6_WAIT_MS 5000
#define phase6_udp_call_run phase12_signaling_run
#include "phase6_udp_call.c"

int phase12_robustness_run(void)
{
	int result = phase12_signaling_run();

	if (result == 0) {
		printk("[Phase 12] supported limit: one call, two G.711 streams\n");
		printk("[Phase 12] repeated setup, BYE/CANCEL, malformed SDP, timeout, "
		       "resource and callback checks: PASSED\n");
		printk("PHASE 12 ROBUSTNESS PROFILE: PASSED (extended lifecycle)\n");
	} else {
		printk("PHASE 12 ROBUSTNESS PROFILE: FAILED\n");
	}
	return result;
}
```

## src/phase1_boundary.c
```c
#include <zephyr/sys/printk.h>

#include <pjmedia/config.h>
#include <pjmedia/sdp.h>
#include <pjmedia-codec/config.h>
#include <pjmedia-audiodev/config.h>

_Static_assert(PJMEDIA_HAS_VIDEO == 0, "video must remain disabled");
_Static_assert(PJMEDIA_HAS_SRTP == 0, "SRTP must remain disabled");
_Static_assert(PJMEDIA_HAS_RTCP_XR == 0, "RTCP XR must remain disabled");
_Static_assert(PJMEDIA_STREAM_ENABLE_XR == 0,
	       "stream RTCP XR must remain disabled");
_Static_assert(PJMEDIA_HAS_LEGACY_SOUND_API == 0,
	       "legacy sound API must remain disabled");
_Static_assert(PJMEDIA_RESAMPLE_IMP == PJMEDIA_RESAMPLE_NONE,
	       "resampling must remain disabled");
_Static_assert(PJMEDIA_HAS_SPEEX_AEC == 0, "Speex AEC must remain disabled");
_Static_assert(PJMEDIA_HAS_WEBRTC_AEC == 0,
	       "WebRTC AEC must remain disabled");
_Static_assert(PJMEDIA_HAS_WEBRTC_AEC3 == 0,
	       "WebRTC AEC3 must remain disabled");
_Static_assert(PJMEDIA_HAS_G711_CODEC == 1,
	       "G.711 must be the selected initial codec");
_Static_assert(PJMEDIA_HAS_L16_CODEC == 0, "L16 must remain disabled");
_Static_assert(PJMEDIA_HAS_GSM_CODEC == 0, "GSM must remain disabled");
_Static_assert(PJMEDIA_HAS_SPEEX_CODEC == 0, "Speex must remain disabled");
_Static_assert(PJMEDIA_HAS_ILBC_CODEC == 0, "iLBC must remain disabled");
_Static_assert(PJMEDIA_HAS_G722_CODEC == 0, "G.722 must remain disabled");
_Static_assert(PJMEDIA_HAS_PASSTHROUGH_CODECS == 0,
	       "passthrough codecs must remain disabled");
_Static_assert(PJMEDIA_MAX_SDP_MEDIA == 4, "unexpected SDP media limit");
_Static_assert(PJMEDIA_MAX_SDP_FMT == 16, "unexpected SDP format limit");
_Static_assert(PJMEDIA_SDP_NEG_MAX_CUSTOM_FMT_NEG_CB == 4,
	       "unexpected SDP negotiation callback limit");
_Static_assert(PJMEDIA_AUDIO_DEV_HAS_PORTAUDIO == 0,
	       "PortAudio must remain disabled");
_Static_assert(PJMEDIA_AUDIO_DEV_HAS_ANDROID_JNI == 0,
	       "Android audio must remain disabled");
_Static_assert(PJMEDIA_AUDIO_DEV_HAS_ALSA == 0,
	       "ALSA must remain disabled");
_Static_assert(PJMEDIA_AUDIO_DEV_HAS_WMME == 0,
	       "WMME must remain disabled");
_Static_assert(PJMEDIA_AUDIO_DEV_HAS_NULL_AUDIO == 0,
	       "null audio is deferred");

int phase1_boundary_run(void)
{
	printk("PJMEDIA Phase 1 configuration/header boundary: PASSED\n");
	printk("No PJMEDIA production object is linked in Phase 1\n");
	return 0;
}
```

## src/phase3_link_probe.c
```c
#include <zephyr/sys/printk.h>

#include <pjlib.h>
#include <pjmedia/sdp_neg.h>

/* Volatile keeps the calls reachable so --gc-sections cannot turn this into
 * a partial-API probe. The branch is deliberately false at runtime. */
static volatile pj_bool_t invoke_probe_calls;

int phase3_link_probe_run(void)
{
	pjmedia_sdp_neg *neg = NULL;
	pjmedia_sdp_session *session = NULL;
	pjmedia_sdp_media *media = NULL;
	const pjmedia_sdp_session *result = NULL;
	pj_pool_t *pool = NULL;
	pj_str_t fmt = { NULL, 0 };

	if (invoke_probe_calls) {
		(void)pjmedia_sdp_neg_state_str(PJMEDIA_SDP_NEG_STATE_NULL);
		(void)pjmedia_sdp_neg_create_w_local_offer(pool, session, &neg);
		(void)pjmedia_sdp_neg_create_w_remote_offer(pool, session, session,
						      &neg);
		(void)pjmedia_sdp_neg_set_prefer_remote_codec_order(neg, PJ_FALSE);
		(void)pjmedia_sdp_neg_set_answer_multiple_codecs(neg, PJ_FALSE);
		(void)pjmedia_sdp_neg_get_state(neg);
		(void)pjmedia_sdp_neg_get_active_local(neg, &result);
		(void)pjmedia_sdp_neg_get_active_remote(neg, &result);
		(void)pjmedia_sdp_neg_was_answer_remote(neg);
		(void)pjmedia_sdp_neg_get_neg_remote(neg, &result);
		(void)pjmedia_sdp_neg_get_neg_local(neg, &result);
		(void)pjmedia_sdp_neg_modify_local_offer(pool, neg, session);
		(void)pjmedia_sdp_neg_modify_local_offer2(pool, neg, 0, session);
		(void)pjmedia_sdp_neg_send_local_offer(pool, neg, &result);
		(void)pjmedia_sdp_neg_set_remote_answer(pool, neg, session);
		(void)pjmedia_sdp_neg_set_remote_offer(pool, neg, session);
		(void)pjmedia_sdp_neg_set_local_answer(pool, neg, session);
		(void)pjmedia_sdp_neg_has_local_answer(neg);
		(void)pjmedia_sdp_neg_cancel_offer(neg);
		(void)pjmedia_sdp_neg_negotiate(pool, neg, PJ_FALSE);
		(void)pjmedia_sdp_neg_register_fmt_match_cb(&fmt, NULL);
		(void)pjmedia_sdp_neg_fmt_match(pool, media, 0, media, 0, 0);
	}

	printk("PHASE 3 LINK PROBE: PASSED (all public negotiator APIs retained)\n");
	return 0;
}
```
