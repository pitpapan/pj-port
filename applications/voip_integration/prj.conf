## CMakeLists.txt
```
cmake_minimum_required(VERSION 3.20.0)

list(APPEND ZEPHYR_EXTRA_MODULES
  "${CMAKE_CURRENT_LIST_DIR}/../../voip"
  "${CMAKE_CURRENT_LIST_DIR}/../../pjproject"
)

find_package(Zephyr REQUIRED HINTS $ENV{ZEPHYR_BASE})
project(voip_integration)

if(CONFIG_VOIP_PJSUA_PLAN3_COMPONENT_TEST)
  target_include_directories(app PRIVATE ../../voip/include)
  target_compile_options(app PRIVATE -std=c++17)
  # The component profile compiles the production-selected service against a
  # fake PJSUA function table.  This deliberately does not enable the module
  # library, so the direct component sources below have no duplicate symbols.
  target_compile_definitions(app PRIVATE CONFIG_VOIP_PJSUA
    CONFIG_VOIP_CORE_ACTOR_STACK_SIZE=8192)
endif()

if(CONFIG_VOIP_PJSUA_PLAN4_COMPONENT_TEST)
  target_include_directories(app PRIVATE ../../voip/include)
  target_compile_options(app PRIVATE -std=c++17)
endif()

if(CONFIG_VOIP_PJSUA_PLAN5_COMPONENT_TEST)
  target_include_directories(app PRIVATE ../../voip/include)
  target_compile_options(app PRIVATE -std=c++17)
  target_sources(app PRIVATE
    ../../voip/tests/pjsua/PjsuaPlan5TestMain.cpp
    ../../voip/tests/pjsua/PjsuaAudioPortTest.cpp
    ../../voip/tests/pjsua/PjsuaMediaClockTest.cpp
    ../../voip/tests/pjsua/PjsuaConferenceClockTest.cpp
    ../../voip/tests/pjsua/PjsuaMediaBridgeTest.cpp
    ../../voip/tests/pjsua/PjsuaMediaDirectionTest.cpp
    ../../voip/tests/pjsua/PjsuaMediaControlReconciliationTest.cpp
    ../../voip/tests/pjsua/PjsuaNativeBridgeTest.cpp
    ../../voip/tests/pjsua/PjsuaMediaManagerTest.cpp
    ../../voip/tests/pjsua/PjsuaMediaOwnershipTest.cpp
    ../../voip/src/pjsua/PjsuaMediaManager.cpp
    ../../voip/src/core/AgentRegistry.cpp
    ../../voip/src/pjsua/PjsuaAccountManager.cpp
    ../../voip/src/pjsua/PjsuaCallManager.cpp
    ../../voip/src/pjsua/PjsuaCallbackRouter.cpp
    ../../voip/src/pjsua/PjsuaRuntimeAdapter.cpp
    ../../voip/src/pjsua/PjsuaTransportManager.cpp
    ../../voip/src/pjsua/PjsuaMediaBridge.cpp
    ../../voip/src/pjsua/PjsuaAudioPort.cpp
    ../../voip/src/pjsua/PjsuaMediaClock.cpp
    ../../voip/src/pjsua/PjsuaRuntime.cpp
    ../../voip/src/pjsua/PjsuaApi.cpp
  )
endif()

target_sources_ifdef(CONFIG_VOIP_SDK_CONTRACT_TEST app PRIVATE
  src/sdk_contract.cpp
)
target_sources_ifdef(CONFIG_VOIP_PHASE1_TEST app PRIVATE src/main.cpp)
target_sources_ifdef(CONFIG_VOIP_PHASE2_RUNTIME_TEST app PRIVATE
  src/phase2_runtime.cpp
)
target_sources_ifdef(CONFIG_VOIP_PHASE3_ACCOUNT_TEST app PRIVATE
  src/phase3_account.cpp
)
target_sources_ifdef(CONFIG_VOIP_PHASE4_REGISTRATION_TEST app PRIVATE
  src/phase4_registration.cpp
)
target_sources_ifdef(CONFIG_VOIP_PHASE5_CALL_TEST app PRIVATE
  src/phase5_call.cpp
)
target_sources_ifdef(CONFIG_VOIP_PHASE6_MEDIA_TEST app PRIVATE
  src/phase6_media.cpp
)
target_sources_ifdef(CONFIG_VOIP_PHASE7_SIP_MEDIA_TEST app PRIVATE
  src/phase5_call.cpp
)
target_sources_ifdef(CONFIG_VOIP_PHASE8_HOLD_RECOVERY_TEST app PRIVATE
  src/phase5_call.cpp
)
target_sources_ifdef(CONFIG_VOIP_PHASE9_ROBUSTNESS_TEST app PRIVATE
  src/phase5_call.cpp
)
target_sources_ifdef(CONFIG_VOIP_SRTP_KEY_TEST app PRIVATE
  src/srtp_key_lifecycle.cpp
)
target_sources_ifdef(CONFIG_VOIP_SRTP_CALL_TEST app PRIVATE
  src/phase5_call.cpp
)
target_sources_ifdef(CONFIG_VOIP_PJSUA_LINK_TEST app PRIVATE
  src/pjsua_link.c
)
target_sources_ifdef(CONFIG_VOIP_PJSUA_ARENA_TEST app PRIVATE
  src/pjsua_arena_test.c
)
target_sources_ifdef(CONFIG_VOIP_PJSUA_CAPACITY_TEST app PRIVATE
  src/pjsua_capacity.c
  test_support/PjsuaCapacityDeclineDrain.c
)
target_sources_ifdef(CONFIG_VOIP_PJSUA_PLAN3_COMPONENT_TEST app PRIVATE
  ../../voip/src/pjsua/PjsuaAudioPort.cpp
  ../../voip/src/pjsua/PjsuaMediaBridge.cpp
  ../../voip/src/pjsua/PjsuaMediaManager.cpp
  ../../voip/tests/pjsua/PjsuaPlan3TestMain.cpp
  ../../voip/tests/pjsua/PjsuaRuntimeTest.cpp
  ../../voip/tests/pjsua/PjsuaCallbackRouterTest.cpp
  ../../voip/tests/pjsua/PjsuaAccountManagerTest.cpp
  ../../voip/tests/pjsua/PjsuaRegistrationStateTest.cpp
  ../../voip/tests/pjsua/PjsuaRuntimeAdapterTest.cpp
  ../../voip/tests/pjsua/PjsuaPublicServiceTest.cpp
  ../../voip/src/pjsua/PjsuaApi.cpp
  ../../voip/src/pjsua/PjsuaRuntime.cpp
  ../../voip/src/pjsua/PjsuaMediaClock.cpp
  ../../voip/src/pjsua/PjsuaTransportManager.cpp
  ../../voip/src/pjsua/PjsuaCallbackRouter.cpp
  ../../voip/src/pjsua/PjsuaAccountManager.cpp
  ../../voip/src/pjsua/PjsuaCallManager.cpp
  ../../voip/src/pjsua/PjsuaRuntimeAdapter.cpp
  ../../voip/src/core/AgentRegistry.cpp
  ../../voip/src/VoipService.cpp
  ../../voip/src/core/CallStateMachine.cpp
  ../../voip/src/core/CallScheduler.cpp
  ../../voip/src/core/CommandMailbox.cpp
  ../../voip/src/core/OperationTable.cpp
  ../../voip/src/core/VoipEventQueue.cpp
  ../../voip/src/core/CoreActor.cpp
  ../../voip/src/core/VoipRuntime.cpp
  ../../voip/src/core/VoipResourceGuard.cpp
)
target_sources_ifdef(CONFIG_VOIP_PJSUA_PLAN4_COMPONENT_TEST app PRIVATE
  ../../voip/src/pjsua/PjsuaAudioPort.cpp
  ../../voip/src/pjsua/PjsuaMediaBridge.cpp
  ../../voip/src/pjsua/PjsuaMediaManager.cpp
  ../../voip/tests/pjsua/PjsuaPlan4TestMain.cpp
  ../../voip/tests/pjsua/PjsuaCallApiTest.cpp
  ../../voip/tests/pjsua/PjsuaCallContextTest.cpp
  ../../voip/tests/pjsua/PjsuaIncomingAdmissionTest.cpp
  ../../voip/tests/pjsua/PjsuaOutgoingPromotionTest.cpp
  ../../voip/tests/pjsua/PjsuaCallControlTest.cpp
  ../../voip/tests/pjsua/PjsuaCallStateTest.cpp
  ../../voip/src/pjsua/PjsuaApi.cpp
  ../../voip/src/pjsua/PjsuaRuntime.cpp
  ../../voip/src/pjsua/PjsuaMediaClock.cpp
  ../../voip/src/pjsua/PjsuaTransportManager.cpp
  ../../voip/src/pjsua/PjsuaCallbackRouter.cpp
  ../../voip/src/pjsua/PjsuaAccountManager.cpp
  ../../voip/src/pjsua/PjsuaCallManager.cpp
  ../../voip/src/pjsua/PjsuaRuntimeAdapter.cpp
  ../../voip/src/core/AgentRegistry.cpp
)
if(CONFIG_VOIP_PJSUA_REGISTRATION_TEST AND NOT CONFIG_VOIP_PJSUA_TWO_CALL_TEST)
  target_sources(app PRIVATE
    src/pjsua_registration.cpp
    test_support/GeneralHeapTracker.cpp
    test_support/ScriptedRegistrar.cpp
  )
  target_compile_definitions(app PRIVATE VOIP_GENERAL_HEAP_WRAP_ENABLED=1)
  target_link_options(app INTERFACE
    -Wl,--wrap=malloc
    -Wl,--wrap=calloc
    -Wl,--wrap=realloc
    -Wl,--wrap=aligned_alloc
    -Wl,--wrap=k_malloc
    -Wl,--wrap=k_calloc
    -Wl,--wrap=k_realloc
    -Wl,--wrap=k_aligned_alloc
    -Wl,--wrap=sys_heap_alloc
    -Wl,--wrap=sys_heap_noalign_alloc
    -Wl,--wrap=sys_heap_realloc
    -Wl,--wrap=sys_heap_aligned_alloc
    -Wl,--wrap=sys_heap_aligned_realloc
  )
endif()
if(CONFIG_VOIP_PJSUA_TWO_CALL_TEST)
  target_link_options(app INTERFACE -Wl,--wrap=pjsua_init
    -Wl,--wrap=_ZN4voip13AgentRegistry5ResetEv -Wl,--wrap=pj_zephyr_pool_arena_reset)
  target_compile_definitions(app PRIVATE VOIP_GENERAL_HEAP_WRAP_ENABLED=1)
  target_link_options(app INTERFACE
    -Wl,--wrap=malloc -Wl,--wrap=calloc -Wl,--wrap=realloc
    -Wl,--wrap=aligned_alloc -Wl,--wrap=k_malloc -Wl,--wrap=k_calloc
    -Wl,--wrap=k_realloc -Wl,--wrap=k_aligned_alloc
    -Wl,--wrap=sys_heap_alloc -Wl,--wrap=sys_heap_noalign_alloc
    -Wl,--wrap=sys_heap_realloc -Wl,--wrap=sys_heap_aligned_alloc
    -Wl,--wrap=sys_heap_aligned_realloc
  )
  # Reuse the deliberately test-only listener-port hook so incoming TCP SIP
  # reaches a deterministic PJSUA transport without exposing it publicly.
  target_compile_definitions(app PRIVATE CONFIG_VOIP_PJSUA_REGISTRATION_TEST=1)
  target_sources(app PRIVATE
    src/multi_call_scheduler.cpp
    test_support/ScriptedSipPeer.cpp
    test_support/GeneralHeapTracker.cpp
  )
endif()
target_sources_ifdef(CONFIG_VOIP_CORE_SERVICE_TEST app PRIVATE
  src/core_service.cpp
)
```

## Kconfig
```
source "Kconfig.zephyr"

menu "VoIP integration validation"

config VOIP_CORE_SERVICE_TEST
	bool "PJ-independent core service validation"
	depends on VOIP_SERVICE && VOIP_SERVICE_FAKE_ADAPTER
	default n

config VOIP_SDK_CONTRACT_TEST
	bool "Production SDK contract validation"
	depends on VOIP_SDK && VOIP_FAKE_BACKEND

config VOIP_PHASE1_TEST
	bool "Phase 1 facade validation"
	depends on VOIP_FACADE && VOIP_FAKE_BACKEND

config VOIP_PHASE2_RUNTIME_TEST
	bool "Phase 2 shared runtime validation"
	depends on VOIP_FACADE && VOIP_PJ_BACKEND

config VOIP_PHASE3_ACCOUNT_TEST
	bool "Phase 3 single-account validation"
	depends on VOIP_FACADE && VOIP_PJ_BACKEND && PJSIP_REGC

config VOIP_PHASE4_REGISTRATION_TEST
	bool "Phase 4 TCP registration validation"
	depends on VOIP_FACADE && VOIP_PJ_BACKEND && PJSIP_REGC && PJSIP_TCP_TRANSPORT

config VOIP_PHASE5_CALL_TEST
	bool "Phase 5 one-call TCP validation"
	depends on VOIP_PJ_CALL_CONTROL

config VOIP_PHASE6_MEDIA_TEST
	bool "Phase 6 headless G.711 media validation"
	depends on VOIP_PJ_HEADLESS_MEDIA

config VOIP_PHASE7_SIP_MEDIA_TEST
	bool "Phase 7 SIP-controlled headless media validation"
	depends on VOIP_PJ_CALL_CONTROL && VOIP_PJ_HEADLESS_MEDIA

config VOIP_PHASE8_HOLD_RECOVERY_TEST
	bool "Phase 8 hold and recovery validation"
	depends on VOIP_PJ_CALL_CONTROL && VOIP_PJ_HEADLESS_MEDIA

config VOIP_PHASE9_ROBUSTNESS_TEST
	bool "Phase 9 robustness and resource qualification"
	depends on VOIP_PJ_CALL_CONTROL && VOIP_PJ_HEADLESS_MEDIA

config VOIP_SRTP_KEY_TEST
	bool "SRTP per-call key lifecycle validation"
	depends on VOIP_PJ_SRTP_KEY_LIFECYCLE

config VOIP_SRTP_CALL_TEST
	bool "SIP-controlled mandatory SRTP/SDES call validation"
	depends on VOIP_PJ_SRTP_SIGNALING

config VOIP_PJSUA_LINK_TEST
	bool "PJSUA-LIB link closure validation"
	depends on PJSUA

config VOIP_PJSUA_ARENA_TEST
	bool "PJSUA bounded pool arena validation"
	depends on PJSUA

config VOIP_PJSUA_CAPACITY_TEST
	bool "PJSUA account and call capacity validation"
	depends on PJSUA && PJSIP_INVITE && PJSIP_TCP_TRANSPORT

config VOIP_PJSUA_PLAN3_COMPONENT_TEST
	bool "PJSUA Plan 3 native runtime component validation"
	depends on PJSUA && PJSIP_TCP_TRANSPORT

config VOIP_PJSUA_PLAN4_COMPONENT_TEST
	bool "PJSUA Plan 4 call API component validation"
	depends on PJSUA && PJSIP_TCP_TRANSPORT

config VOIP_PJSUA_PLAN5_COMPONENT_TEST
	bool "PJSUA Plan 5 audio component validation"
	depends on PJSUA && PJMEDIA

config VOIP_PJSUA_REGISTRATION_TEST
	bool "PJSUA Plan 3 five-account TCP Digest registration validation"
	depends on VOIP_SERVICE && VOIP_PJSUA && PJSUA && PJSIP_REGC && PJSIP_TCP_TRANSPORT

config VOIP_PJSUA_TWO_CALL_TEST
	bool "PJSUA two-call scripted SIP peer validation"
	depends on VOIP_SERVICE && VOIP_PJSUA && PJSUA && PJSIP_INVITE && PJSIP_TCP_TRANSPORT

endmenu
```

## prj.conf
```kconfig
CONFIG_CONSOLE=y
CONFIG_PRINTK=y
CONFIG_SERIAL=y
CONFIG_CPP=y
CONFIG_GLIBCXX_LIBCPP=y
CONFIG_PICOLIBC=y
CONFIG_VOIP_FACADE=y
CONFIG_VOIP_FAKE_BACKEND=y
CONFIG_VOIP_PHASE1_TEST=y
CONFIG_VOIP_PHASE2_RUNTIME_TEST=n
CONFIG_VOIP_PHASE3_ACCOUNT_TEST=n
CONFIG_MAIN_STACK_SIZE=16384
```

## core_service.conf
```kconfig
CONFIG_CPP=y
CONFIG_PRINTK=y
CONFIG_SERIAL=y
CONFIG_VOIP_FACADE=n
CONFIG_VOIP_SERVICE=y
CONFIG_VOIP_SERVICE_FAKE_ADAPTER=y
CONFIG_VOIP_CORE_SERVICE_TEST=y
CONFIG_VOIP_FAKE_BACKEND=n
CONFIG_VOIP_PHASE1_TEST=n
CONFIG_MAIN_STACK_SIZE=16384
```

## multi_call_scheduler.conf
```kconfig
CONFIG_VOIP_PJSUA_TWO_CALL_TEST=y
CONFIG_VOIP_PJSUA_REGISTRATION_TEST=y
CONFIG_VOIP_PJSUA=y
CONFIG_VOIP_SERVICE=y
CONFIG_VOIP_FACADE=n
CONFIG_VOIP_FAKE_BACKEND=n
CONFIG_VOIP_SERVICE_FAKE_ADAPTER=n
CONFIG_CPP=y
CONFIG_VOIP_PHASE1_TEST=n
CONFIG_VOIP_PJSUA_PLAN3_COMPONENT_TEST=n
CONFIG_VOIP_PJSUA_ARENA_TEST=n
CONFIG_VOIP_PJSUA_LINK_TEST=n
CONFIG_VOIP_PJSUA_CAPACITY_TEST=n
CONFIG_VOIP_SIP_TLS=n
CONFIG_VOIP_SRTP=n
CONFIG_CONSOLE=y
CONFIG_STD_CPP17=y
CONFIG_PRINTK=y
CONFIG_SERIAL=y
CONFIG_POSIX_API=y
CONFIG_MAX_PTHREAD_MUTEX_COUNT=128
CONFIG_NETWORKING=y
CONFIG_NET_SOCKETS=y
CONFIG_NET_IPV4=y
CONFIG_NET_IPV6=n
CONFIG_NET_TCP=y
CONFIG_NET_UDP=y
CONFIG_NET_LOOPBACK=y
CONFIG_NET_QEMU_SLIP=n
CONFIG_NET_SLIP_TAP=n
CONFIG_SLIP=n
CONFIG_TEST_RANDOM_GENERATOR=y
CONFIG_ZVFS_OPEN_MAX=32
CONFIG_ZVFS_POLL_MAX=24
CONFIG_HEAP_MEM_POOL_SIZE=262144
CONFIG_COMMON_LIBC_MALLOC_ARENA_SIZE=1048576
CONFIG_MAIN_STACK_SIZE=65536
CONFIG_DYNAMIC_THREAD=y
CONFIG_DYNAMIC_THREAD_STACK_SIZE=32768
CONFIG_INIT_STACKS=y
CONFIG_THREAD_STACK_INFO=y
CONFIG_PJPROJECT=y
CONFIG_PJLIB=y
CONFIG_PJLIB_UTIL=y
CONFIG_PJSIP=y
CONFIG_PJSIP_TCP_TRANSPORT=y
CONFIG_PJSIP_UDP_TRANSPORT=y
CONFIG_PJSIP_MAX_TRANSPORTS=32
CONFIG_PJSIP_INVITE=y
CONFIG_PJSIP_REGC=y
CONFIG_PJMEDIA=y
CONFIG_PJMEDIA_SDP=y
CONFIG_PJMEDIA_SDP_NEG=y
CONFIG_PJMEDIA_ENDPOINT=y
CONFIG_PJMEDIA_G711=y
CONFIG_PJMEDIA_RTP_RTCP=y
CONFIG_PJMEDIA_LOOP_TRANSPORT=y
CONFIG_PJMEDIA_UDP_TRANSPORT=y
CONFIG_PJMEDIA_STREAM=y
CONFIG_PJMEDIA_AUDIODEV=y
CONFIG_PJMEDIA_AUDIODEV_NULL=y
CONFIG_PJMEDIA_SRTP=n
CONFIG_PJMEDIA_SRTP_TRANSPORT=n
CONFIG_PJMEDIA_SRTP_SDES=n
CONFIG_PJNATH=y
CONFIG_PJSIP_SIMPLE=y
CONFIG_PJSIP_UA=y
CONFIG_PJSUA=y
CONFIG_PJSUA_MAX_ACCOUNTS=5
CONFIG_PJSUA_MAX_CALLS=7
CONFIG_PJSUA_MAX_CONF_PORTS=12
CONFIG_PJSUA_ARENA_BYTES=2097152
CONFIG_NET_MAX_CONN=48
CONFIG_NET_MAX_CONTEXTS=48
CONFIG_NET_BUF_TX_COUNT=32
```

## phase2_runtime.conf
```kconfig
CONFIG_VOIP_FAKE_BACKEND=n
CONFIG_VOIP_PJ_BACKEND=y
CONFIG_VOIP_PHASE1_TEST=n
CONFIG_VOIP_PHASE2_RUNTIME_TEST=y

CONFIG_POSIX_API=y
CONFIG_DYNAMIC_THREAD=y
CONFIG_DYNAMIC_THREAD_POOL_SIZE=8
CONFIG_DYNAMIC_THREAD_STACK_SIZE=8192
CONFIG_MAX_PTHREAD_MUTEX_COUNT=64

CONFIG_NETWORKING=y
CONFIG_NET_SOCKETS=y
CONFIG_NET_IPV4=y
CONFIG_NET_IPV6=n
CONFIG_NET_TCP=y
CONFIG_NET_UDP=y
CONFIG_NET_LOOPBACK=y
CONFIG_TEST_RANDOM_GENERATOR=y
CONFIG_NET_QEMU_SLIP=n
CONFIG_NET_SLIP_TAP=n
CONFIG_SLIP=n

CONFIG_NET_MAX_CONTEXTS=24
CONFIG_NET_MAX_CONN=24
CONFIG_ZVFS_OPEN_MAX=32
CONFIG_ZVFS_POLL_MAX=24
CONFIG_NET_BUF_DATA_SIZE=256
CONFIG_NET_BUF_RX_COUNT=32
CONFIG_NET_BUF_TX_COUNT=32
CONFIG_NET_PKT_RX_COUNT=16
CONFIG_NET_PKT_TX_COUNT=16

CONFIG_PJPROJECT=y
CONFIG_PJLIB=y
CONFIG_PJLIB_UTIL=y
CONFIG_PJSIP=y
CONFIG_PJSIP_TCP_TRANSPORT=y
CONFIG_PJSIP_UDP_TRANSPORT=n
CONFIG_PJSIP_INVITE=n
CONFIG_PJMEDIA=y
CONFIG_PJMEDIA_SDP=y
CONFIG_PJMEDIA_SDP_NEG=n
CONFIG_PJMEDIA_ENDPOINT=y
CONFIG_PJMEDIA_G711=n
CONFIG_PJMEDIA_RTP_RTCP=n
CONFIG_PJMEDIA_LOOP_TRANSPORT=n
CONFIG_PJMEDIA_UDP_TRANSPORT=n
CONFIG_PJMEDIA_STREAM=n
CONFIG_PJMEDIA_AUDIODEV=n

CONFIG_HEAP_MEM_POOL_SIZE=393216
CONFIG_MAIN_STACK_SIZE=24576
CONFIG_INIT_STACKS=y
CONFIG_THREAD_STACK_INFO=y
```

## phase3_account.conf
```kconfig
CONFIG_VOIP_FAKE_BACKEND=n
CONFIG_VOIP_PJ_BACKEND=y
CONFIG_VOIP_PHASE1_TEST=n
CONFIG_VOIP_PHASE2_RUNTIME_TEST=n
CONFIG_VOIP_PHASE3_ACCOUNT_TEST=y

CONFIG_POSIX_API=y
CONFIG_DYNAMIC_THREAD=y
CONFIG_DYNAMIC_THREAD_POOL_SIZE=8
CONFIG_DYNAMIC_THREAD_STACK_SIZE=8192
CONFIG_MAX_PTHREAD_MUTEX_COUNT=64

CONFIG_NETWORKING=y
CONFIG_NET_SOCKETS=y
CONFIG_NET_IPV4=y
CONFIG_NET_IPV6=n
CONFIG_NET_TCP=y
CONFIG_NET_UDP=y
CONFIG_NET_LOOPBACK=y
CONFIG_TEST_RANDOM_GENERATOR=y
CONFIG_NET_QEMU_SLIP=n
CONFIG_NET_SLIP_TAP=n
CONFIG_SLIP=n
CONFIG_NET_MAX_CONTEXTS=24
CONFIG_NET_MAX_CONN=24
CONFIG_ZVFS_OPEN_MAX=32
CONFIG_ZVFS_POLL_MAX=24
CONFIG_NET_BUF_DATA_SIZE=256
CONFIG_NET_BUF_RX_COUNT=32
CONFIG_NET_BUF_TX_COUNT=32
CONFIG_NET_PKT_RX_COUNT=16
CONFIG_NET_PKT_TX_COUNT=16

CONFIG_PJPROJECT=y
CONFIG_PJLIB=y
CONFIG_PJLIB_UTIL=y
CONFIG_PJSIP=y
CONFIG_PJSIP_TCP_TRANSPORT=y
CONFIG_PJSIP_UDP_TRANSPORT=n
CONFIG_PJSIP_REGC=y
CONFIG_PJSIP_INVITE=n
CONFIG_PJMEDIA=y
CONFIG_PJMEDIA_SDP=y
CONFIG_PJMEDIA_SDP_NEG=n
CONFIG_PJMEDIA_ENDPOINT=y
CONFIG_PJMEDIA_G711=n
CONFIG_PJMEDIA_RTP_RTCP=n
CONFIG_PJMEDIA_LOOP_TRANSPORT=n
CONFIG_PJMEDIA_UDP_TRANSPORT=n
CONFIG_PJMEDIA_STREAM=n
CONFIG_PJMEDIA_AUDIODEV=n

CONFIG_HEAP_MEM_POOL_SIZE=393216
CONFIG_MAIN_STACK_SIZE=24576
CONFIG_INIT_STACKS=y
CONFIG_THREAD_STACK_INFO=y
```

## phase4_registration.conf
```kconfig
CONFIG_VOIP_FAKE_BACKEND=n
CONFIG_VOIP_PJ_BACKEND=y
CONFIG_VOIP_PJ_REGISTRATION_NETWORK=y
CONFIG_VOIP_PHASE1_TEST=n
CONFIG_VOIP_PHASE2_RUNTIME_TEST=n
CONFIG_VOIP_PHASE3_ACCOUNT_TEST=n
CONFIG_VOIP_PHASE4_REGISTRATION_TEST=y

CONFIG_POSIX_API=y
CONFIG_DYNAMIC_THREAD=y
CONFIG_DYNAMIC_THREAD_POOL_SIZE=8
CONFIG_DYNAMIC_THREAD_STACK_SIZE=8192
CONFIG_MAX_PTHREAD_MUTEX_COUNT=64

CONFIG_NETWORKING=y
CONFIG_NET_SOCKETS=y
CONFIG_NET_IPV4=y
CONFIG_NET_IPV6=n
CONFIG_NET_TCP=y
CONFIG_NET_UDP=n
CONFIG_NET_LOOPBACK=y
CONFIG_TEST_RANDOM_GENERATOR=y
CONFIG_NET_QEMU_SLIP=n
CONFIG_NET_SLIP_TAP=n
CONFIG_SLIP=n
CONFIG_NET_MAX_CONTEXTS=24
CONFIG_NET_MAX_CONN=24
CONFIG_ZVFS_OPEN_MAX=32
CONFIG_ZVFS_POLL_MAX=24
CONFIG_NET_BUF_DATA_SIZE=256
CONFIG_NET_BUF_RX_COUNT=32
CONFIG_NET_BUF_TX_COUNT=32
CONFIG_NET_PKT_RX_COUNT=16
CONFIG_NET_PKT_TX_COUNT=16

CONFIG_PJPROJECT=y
CONFIG_PJLIB=y
CONFIG_PJLIB_UTIL=y
CONFIG_PJSIP=y
CONFIG_PJSIP_TCP_TRANSPORT=y
CONFIG_PJSIP_UDP_TRANSPORT=n
CONFIG_PJSIP_REGC=y
CONFIG_PJSIP_INVITE=n
CONFIG_PJMEDIA=y
CONFIG_PJMEDIA_SDP=y
CONFIG_PJMEDIA_SDP_NEG=n
CONFIG_PJMEDIA_ENDPOINT=y
CONFIG_PJMEDIA_G711=n
CONFIG_PJMEDIA_RTP_RTCP=n
CONFIG_PJMEDIA_LOOP_TRANSPORT=n
CONFIG_PJMEDIA_UDP_TRANSPORT=n
CONFIG_PJMEDIA_STREAM=n
CONFIG_PJMEDIA_AUDIODEV=n

CONFIG_HEAP_MEM_POOL_SIZE=393216
CONFIG_MAIN_STACK_SIZE=24576
CONFIG_INIT_STACKS=y
CONFIG_THREAD_STACK_INFO=y
```

## phase5_call.conf
```kconfig
CONFIG_VOIP_FAKE_BACKEND=n
CONFIG_VOIP_PJ_BACKEND=y
CONFIG_VOIP_PJ_REGISTRATION_NETWORK=y
CONFIG_VOIP_PJ_CALL_CONTROL=y
CONFIG_VOIP_PHASE1_TEST=n
CONFIG_VOIP_PHASE2_RUNTIME_TEST=n
CONFIG_VOIP_PHASE3_ACCOUNT_TEST=n
CONFIG_VOIP_PHASE4_REGISTRATION_TEST=n
CONFIG_VOIP_PHASE5_CALL_TEST=y

CONFIG_POSIX_API=y
CONFIG_DYNAMIC_THREAD=y
CONFIG_DYNAMIC_THREAD_POOL_SIZE=8
CONFIG_DYNAMIC_THREAD_STACK_SIZE=8192
CONFIG_MAX_PTHREAD_MUTEX_COUNT=64
CONFIG_NETWORKING=y
CONFIG_NET_SOCKETS=y
CONFIG_NET_IPV4=y
CONFIG_NET_IPV6=n
CONFIG_NET_TCP=y
CONFIG_NET_UDP=n
CONFIG_NET_LOOPBACK=y
CONFIG_TEST_RANDOM_GENERATOR=y
CONFIG_NET_QEMU_SLIP=n
CONFIG_NET_SLIP_TAP=n
CONFIG_SLIP=n
CONFIG_NET_MAX_CONTEXTS=28
CONFIG_NET_MAX_CONN=28
CONFIG_ZVFS_OPEN_MAX=36
CONFIG_ZVFS_POLL_MAX=28
CONFIG_NET_BUF_DATA_SIZE=256
CONFIG_NET_BUF_RX_COUNT=36
CONFIG_NET_BUF_TX_COUNT=36
CONFIG_NET_PKT_RX_COUNT=20
CONFIG_NET_PKT_TX_COUNT=20

CONFIG_PJPROJECT=y
CONFIG_PJLIB=y
CONFIG_PJLIB_UTIL=y
CONFIG_PJSIP=y
CONFIG_PJSIP_TCP_TRANSPORT=y
CONFIG_PJSIP_UDP_TRANSPORT=n
CONFIG_PJSIP_REGC=y
CONFIG_PJSIP_INVITE=y
CONFIG_PJMEDIA=y
CONFIG_PJMEDIA_SDP=y
CONFIG_PJMEDIA_SDP_NEG=y
CONFIG_PJMEDIA_ENDPOINT=y
CONFIG_PJMEDIA_G711=n
CONFIG_PJMEDIA_RTP_RTCP=n
CONFIG_PJMEDIA_UDP_TRANSPORT=n
CONFIG_PJMEDIA_STREAM=n
CONFIG_PJMEDIA_AUDIODEV=n

CONFIG_HEAP_MEM_POOL_SIZE=458752
CONFIG_MAIN_STACK_SIZE=32768
CONFIG_INIT_STACKS=y
CONFIG_THREAD_STACK_INFO=y
```

## src/main.cpp
```c
#include <voip/FakeVoipBackend.hpp>

#include <zephyr/sys/printk.h>

#include <cstring>

namespace {

int failures;

#define CHECK(condition) do { if (!(condition)) { ++failures; } } while (false)

class TestObserver final : public voip::Observer {
public:
    unsigned registration_events{};
    unsigned incoming_events{};
    unsigned call_events{};
    unsigned media_events{};
    voip::CallInfo last_call{};

    void OnRegistrationState(voip::RegistrationState,
                             const voip::Status &) override {
        ++registration_events;
    }
    void OnIncomingCall(const voip::CallInfo &call) override {
        ++incoming_events;
        last_call = call;
    }
    void OnCallState(const voip::CallInfo &call,
                     const voip::Status &) override {
        ++call_events;
        last_call = call;
    }
    void OnMediaState(const voip::CallInfo &call,
                      const voip::Status &) override {
        ++media_events;
        last_call = call;
    }
};

void RunLifecycle(unsigned lifecycle) {
    voip::FakeVoipBackend backend;
    voip::VoipManager manager(backend);
    TestObserver observer;
    const voip::AccountConfig account{
        "sip:alice@127.0.0.1", "sip:127.0.0.1;transport=tcp",
        "alice", "phase1-secret", 300};

    CHECK(manager.RegisterAccount() == voip::Error::not_initialized);
    CHECK(manager.Initialize(&observer) == voip::Error::ok);
    CHECK(manager.Initialize(&observer) == voip::Error::invalid_state);
    CHECK(manager.ConfigureAccount(account) == voip::Error::ok);
    CHECK(manager.RegisterAccount() == voip::Error::ok);
    CHECK(manager.GetRegistrationState() == voip::RegistrationState::registered);

    CHECK(manager.StartOutgoingCall("sip:bob@127.0.0.1") == voip::Error::ok);
    CHECK(manager.StartOutgoingCall("sip:busy@127.0.0.1") == voip::Error::busy);
    CHECK(backend.EstablishCall(voip::Codec::pcmu) == voip::Error::ok);
    CHECK(manager.SetHeld(true) == voip::Error::ok);
    CHECK(manager.SetHeld(false) == voip::Error::ok);
    CHECK(manager.EndCall() == voip::Error::ok);

    CHECK(backend.InjectIncomingCall("sip:carol@127.0.0.1") == voip::Error::ok);
    CHECK(manager.AcceptCall() == voip::Error::ok);
    CHECK(backend.EstablishCall(voip::Codec::pcma) == voip::Error::ok);
    CHECK(manager.EndCall() == voip::Error::ok);
    CHECK(manager.UnregisterAccount() == voip::Error::ok);

    CHECK(observer.registration_events == 4);
    CHECK(observer.incoming_events == 1);
    CHECK(observer.media_events == 2);
    CHECK(std::strcmp(observer.last_call.remote_uri, "sip:carol@127.0.0.1") == 0);
    CHECK(manager.Shutdown() == voip::Error::ok);
    CHECK(manager.Shutdown() == voip::Error::ok);
    CHECK(manager.StartOutgoingCall("sip:none@127.0.0.1") ==
          voip::Error::not_initialized);

    printk("[Phase 1] lifecycle %u facade/fake teardown: %s\n", lifecycle,
           failures == 0 ? "PASSED" : "FAILED");
}

} // namespace

int main() {
    printk("VoIP integration Phase 1 facade validation\n");
    for (unsigned lifecycle = 1; lifecycle <= 5; ++lifecycle) {
        RunLifecycle(lifecycle);
    }
    if (failures == 0) {
        printk("VOIP INTEGRATION PHASE 1 RESULT: PASSED (5 facade lifecycles)\n");
    } else {
        printk("VOIP INTEGRATION PHASE 1 RESULT: FAILED (%d checks)\n", failures);
    }
    return failures == 0 ? 0 : 1;
}
```

## src/core_service.cpp
```c
#include <voip/VoipService.hpp>

#include <zephyr/kernel.h>
#include <zephyr/sys/printk.h>

#include <array>
#include <cstdint>

static_assert(CONFIG_VOIP_MAX_AGENTS == 5);
static_assert(CONFIG_VOIP_MAX_LOGICAL_CALLS == 7);
static_assert(CONFIG_VOIP_MAX_PROMOTED_CALLS == 2);
static_assert(CONFIG_VOIP_PENDING_CALL_CAPACITY == 5);
static_assert(CONFIG_VOIP_COMMAND_CAPACITY == 16);
static_assert(CONFIG_VOIP_OPERATION_CAPACITY == 16);
static_assert(CONFIG_VOIP_EVENT_CAPACITY == 32);

namespace {

class SentinelSource final : public voip::PcmSource {
public:
    voip::PcmFormat Format() const noexcept override {
        return {8000, 160, 1, voip::SampleFormat::signed_16};
    }
    voip::Error Read(std::int16_t *, std::size_t,
                     std::uint64_t) noexcept override {
        return voip::Error::ok;
    }
};

class SentinelSink final : public voip::PcmSink {
public:
    voip::PcmFormat Format() const noexcept override {
        return {8000, 160, 1, voip::SampleFormat::signed_16};
    }
    voip::Error Write(const std::int16_t *, std::size_t,
                      std::uint64_t) noexcept override {
        return voip::Error::ok;
    }
    void Flush() noexcept override {}
};

voip::ServiceConfig MakeConfig(std::array<voip::AgentConfig, 5> &agents,
                               std::array<SentinelSource, 5> &sources,
                               std::array<SentinelSink, 5> &sinks) {
    static constexpr const char *const identities[5] = {
        "sip:core0@example.test", "sip:core1@example.test",
        "sip:core2@example.test", "sip:core3@example.test",
        "sip:core4@example.test",
    };
    for (std::size_t i = 0; i < agents.size(); ++i) {
        agents[i] = {{identities[i], "sip:example.test", "core", "secret"},
                     {&sources[i], &sinks[i]}, true};
    }
    return {agents.data(), static_cast<std::uint8_t>(agents.size()), 1000, 1000,
            {8000, 160, 1, voip::SampleFormat::signed_16},
            {voip::SignalingSecurity::none, voip::MediaSecurity::none}};
}

bool GetCallEvent(voip::VoipService &service, voip::OperationId operation,
                  voip::CallHandle *call) {
    voip::Event event{};
    for (unsigned attempt = 0; attempt < 100; ++attempt) {
        if (service.WaitForEvent(&event, 20) != voip::Error::ok) continue;
        if (event.type == voip::EventType::call_state &&
            event.operation == operation) {
            *call = event.call;
            return true;
        }
    }
    return false;
}

bool WaitForOperation(voip::VoipService &service, voip::OperationId operation,
                      voip::Error expected) {
    voip::Event event{};
    for (unsigned attempt = 0; attempt < 100; ++attempt) {
        if (service.WaitForEvent(&event, 20) != voip::Error::ok) continue;
        if (event.type == voip::EventType::operation_terminal &&
            event.operation == operation)
            return event.status.error == expected;
    }
    return false;
}

bool WaitForTimedOut(voip::VoipService &service, voip::OperationId operation) {
    voip::Event event{};
    for (unsigned attempt = 0; attempt < 150; ++attempt) {
        if (service.WaitForEvent(&event, 20) != voip::Error::ok) continue;
        if (event.type == voip::EventType::operation_terminal &&
            event.operation == operation)
            return event.status.error == voip::Error::timed_out;
    }
    return false;
}

bool WaitForEstablished(voip::VoipService &service, voip::CallHandle call) {
    voip::Event event{};
    for (unsigned attempt = 0; attempt < 100; ++attempt) {
        if (service.WaitForEvent(&event, 20) != voip::Error::ok) continue;
        if (event.type == voip::EventType::call_state &&
            event.call.slot == call.slot &&
            event.call.generation == call.generation &&
            event.destination_state == voip::CallState::established)
            return true;
        voip::CallSnapshot snapshot{};
        if (service.GetCallSnapshot(call, &snapshot) == voip::Error::ok &&
            snapshot.state == voip::CallState::established)
            return true;
    }
    return false;
}

bool RunProof() {
    std::array<SentinelSource, 5> sources;
    std::array<SentinelSink, 5> sinks;
    std::array<voip::AgentConfig, 5> agents{};
    const voip::ServiceConfig config = MakeConfig(agents, sources, sinks);
    static voip::VoipService service;
    if (service.Initialize(config) != voip::Error::ok) return false;

    std::array<voip::AgentHandle, 5> handles{};
    for (std::uint8_t i = 0; i < handles.size(); ++i)
        if (service.GetAgentHandle(i, &handles[i]) != voip::Error::ok)
            return false;

    // The first two calls occupy distinct agents. The next five are ordered
    // so the agent-0 head is blocked by call 0, proving strict HOL behavior.
    const std::array<std::uint8_t, 7> call_agents = {0, 1, 0, 2, 3, 4, 1};
    std::array<voip::CallHandle, 7> calls{};
    std::array<voip::OperationId, 7> dial_operations{};
    for (std::size_t i = 0; i < calls.size(); ++i) {
        voip::OperationId &operation = dial_operations[i];
        if (service.Dial(handles[call_agents[i]], {"sip:peer@example.test"},
                         &operation) != voip::Error::ok ||
            !GetCallEvent(service, operation, &calls[i]))
            return false;
    }

    voip::ResourceSnapshot full = service.GetResourceSnapshot();
    if (full.active_calls != 7 || full.promoted_calls != 2 ||
        full.queued_calls != 5 || full.available_fifo_entries != 0 ||
        full.available_logical_calls != 0 || full.available_promoted_calls != 0)
        return false;

    // Releasing agent 1 leaves one global slot idle, but the agent-0 FIFO head
    // remains blocked. A later eligible entry must not bypass that head.
    voip::OperationId cancel = 0;
    if (service.Cancel(calls[1], &cancel) != voip::Error::ok ||
        !WaitForOperation(service, cancel, voip::Error::cancelled) ||
        service.GetResourceSnapshot().promoted_calls != 1 ||
        service.GetResourceSnapshot().queued_calls != 5 ||
        service.GetResourceSnapshot().available_promoted_calls != 1)
        return false;
    voip::CallSnapshot head{};
    voip::CallSnapshot behind_head{};
    if (service.GetCallSnapshot(calls[2], &head) != voip::Error::ok ||
        head.state != voip::CallState::hold ||
        head.hold_reason != voip::HoldReason::waiting ||
        service.GetCallSnapshot(calls[3], &behind_head) != voip::Error::ok ||
        behind_head.state != voip::CallState::hold ||
        behind_head.hold_reason != voip::HoldReason::waiting)
        return false;

    // Releasing agent 0 makes the head eligible; both available global slots
    // are then consumed by the head and the next eligible FIFO entry.
    if (service.Cancel(calls[0], &cancel) != voip::Error::ok ||
        !WaitForOperation(service, cancel, voip::Error::cancelled) ||
        !WaitForEstablished(service, calls[2]) ||
        !WaitForEstablished(service, calls[3]))
        return false;
    voip::ResourceSnapshot after_heads = service.GetResourceSnapshot();
    if (after_heads.promoted_calls != 2 || after_heads.queued_calls != 3)
        return false;

    // Cancel the promoted head; call 4 advances, leaving call 5 queued as the
    // deterministic timeout witness before shutdown.
    if (service.Cancel(calls[2], &cancel) != voip::Error::ok ||
        !WaitForOperation(service, cancel, voip::Error::cancelled))
        return false;
    // Call 4 remains queued after the second cancellation. Its retained dial
    // operation must time out and its public handle must be stale before
    // shutdown begins.
    if (!WaitForTimedOut(service, dial_operations[5])) return false;
    voip::CallSnapshot timed_out{};
    if (service.GetCallSnapshot(calls[5], &timed_out) !=
        voip::Error::invalid_handle)
        return false;
    if (service.Shutdown() != voip::Error::ok) return false;
    if (service.Shutdown() != voip::Error::ok) return false;
    return true;
}

} // namespace

int main() {
    if (RunProof()) {
        printk("VOIP CORE SERVICE RESULT: PASSED\n");
        return 0;
    }
    return 1;
}
```

## src/phase2_runtime.cpp
```c
#include <voip/PjVoipBackend.hpp>

#include <zephyr/kernel.h>
#include <zephyr/sys/printk.h>

namespace {

int failures;

#define CHECK(condition) do {                                                   \
    if (!(condition)) {                                                         \
        printk("[Phase 2] FAIL line %d: %s\n", __LINE__, #condition);          \
        ++failures;                                                             \
    }                                                                           \
} while (false)

void TestInjectedFailures() {
    const voip::RuntimeFailurePoint points[] = {
        voip::RuntimeFailurePoint::after_pjlib,
        voip::RuntimeFailurePoint::after_pjlib_util,
        voip::RuntimeFailurePoint::after_pool_factory,
        voip::RuntimeFailurePoint::after_sip_endpoint,
        voip::RuntimeFailurePoint::after_media_endpoint,
        voip::RuntimeFailurePoint::after_tcp_factory,
        voip::RuntimeFailurePoint::after_event_thread,
    };
    for (unsigned index = 0; index < sizeof(points) / sizeof(points[0]); ++index) {
        voip::PjVoipBackend backend(points[index]);
        CHECK(backend.Initialize(nullptr) == voip::Error::internal_failure);
        CHECK(!backend.HasLiveResources());
        CHECK(backend.Shutdown() == voip::Error::ok);
        printk("[Phase 2] initialization stop %u cleanup: %s\n", index + 1,
               failures == 0 ? "PASSED" : "FAILED");
    }
}

void TestLifecycle(unsigned lifecycle) {
    voip::PjVoipBackend backend;
    voip::VoipManager manager(backend);

    CHECK(manager.Initialize(nullptr) == voip::Error::ok);
    CHECK(backend.IsRunning());
    CHECK(backend.TcpPort() != 0);

    backend.SetProbeProcessingPaused(true);
    k_sleep(K_MSEC(5));
    for (std::uint32_t value = 1; value <= 8; ++value) {
        CHECK(backend.SubmitProbe(value) == voip::Error::ok);
    }
    CHECK(backend.SubmitProbe(9) == voip::Error::queue_full);
    backend.SetProbeProcessingPaused(false);
    for (unsigned wait = 0; wait < 500 && backend.ProcessedProbeCount() != 8; ++wait) {
        k_sleep(K_MSEC(1));
    }
    CHECK(backend.ProcessedProbeCount() == 8);
    CHECK(backend.LastProbeValue() == 8);

    CHECK(backend.BeginShutdown() == voip::Error::ok);
    CHECK(backend.SubmitProbe(10) == voip::Error::shutting_down);
    CHECK(manager.Shutdown() == voip::Error::ok);
    CHECK(!backend.HasLiveResources());
    CHECK(backend.SubmitProbe(11) == voip::Error::not_initialized);

    printk("[Phase 2] lifecycle %u shared runtime teardown: %s\n", lifecycle,
           failures == 0 ? "PASSED" : "FAILED");
}

} // namespace

int main() {
    printk("VoIP integration Phase 2 shared runtime validation\n");
    TestInjectedFailures();
    for (unsigned lifecycle = 1; lifecycle <= 5; ++lifecycle) {
        TestLifecycle(lifecycle);
    }
    if (failures == 0) {
        printk("VOIP INTEGRATION PHASE 2 RESULT: PASSED (5 runtime lifecycles)\n");
    } else {
        printk("VOIP INTEGRATION PHASE 2 RESULT: FAILED (%d checks)\n", failures);
    }
    return failures == 0 ? 0 : 1;
}
```

## src/phase3_account.cpp
```c
#include <voip/PjVoipBackend.hpp>

#include <zephyr/sys/printk.h>

#include <cstring>

namespace {

int failures;

#define CHECK(condition) do {                                                   \
    if (!(condition)) {                                                         \
        printk("[Phase 3] FAIL line %d: %s\n", __LINE__, #condition);          \
        ++failures;                                                             \
    }                                                                           \
} while (false)

const voip::AccountConfig account_a{
    "<sip:alice@127.0.0.1>", "sip:127.0.0.1;transport=tcp",
    "alice", "account-a-secret", 300};
const voip::AccountConfig account_b{
    "<sip:bob@127.0.0.1>", "sip:127.0.0.1;transport=tcp",
    "bob", "account-b-secret", 600};

class RemovingObserver final : public voip::Observer {
public:
    explicit RemovingObserver(voip::PjVoipBackend &backend) : backend_(backend) {}
    unsigned callbacks{};
    voip::RegistrationState last{voip::RegistrationState::disabled};

    void OnRegistrationState(voip::RegistrationState state,
                             const voip::Status &) override {
        ++callbacks;
        last = state;
        backend_.SetObserver(nullptr);
    }

private:
    voip::PjVoipBackend &backend_;
};

class RecordingObserver final : public voip::Observer {
public:
    unsigned callbacks{};
    voip::RegistrationState last{voip::RegistrationState::disabled};
    void OnRegistrationState(voip::RegistrationState state,
                             const voip::Status &) override {
        ++callbacks;
        last = state;
    }
};

void TestLifecycle(unsigned lifecycle) {
    voip::PjVoipBackend backend;
    voip::VoipManager manager(backend);
    RecordingObserver observer;
    char oversized[voip::max_uri_length + 2];
    std::memset(oversized, 'x', sizeof(oversized));
    oversized[sizeof(oversized) - 1] = '\0';

    CHECK(manager.Initialize(&observer) == voip::Error::ok);
    CHECK(!backend.HasRegistrationClient());

    const voip::AccountConfig missing{nullptr, account_a.registrar_uri,
                                      account_a.username, account_a.password, 300};
    const voip::AccountConfig zero_expiry{account_a.account_uri,
                                          account_a.registrar_uri,
                                          account_a.username,
                                          account_a.password, 0};
    const voip::AccountConfig too_long{oversized, account_a.registrar_uri,
                                       account_a.username, account_a.password, 300};
    CHECK(manager.ConfigureAccount(missing) == voip::Error::invalid_argument);
    CHECK(manager.ConfigureAccount(zero_expiry) == voip::Error::invalid_argument);
    CHECK(manager.ConfigureAccount(too_long) == voip::Error::value_too_long);
    CHECK(!backend.HasRegistrationClient());

    CHECK(manager.ConfigureAccount(account_a) == voip::Error::ok);
    CHECK(backend.HasRegistrationClient());
    CHECK(manager.RegisterAccount() == voip::Error::invalid_state);

    const voip::RegistrationState states[] = {
        voip::RegistrationState::disabled,
        voip::RegistrationState::registering,
        voip::RegistrationState::registered,
        voip::RegistrationState::unregistering,
    };
    for (const auto state : states) {
        CHECK(backend.InjectRegistrationState(state, state ==
              voip::RegistrationState::registered ? 200 : 0) == voip::Error::ok);
        CHECK(observer.last == state);
        CHECK(manager.ConfigureAccount(account_b) == voip::Error::ok);
        CHECK(backend.HasRegistrationClient());
    }

    RemovingObserver removing(backend);
    backend.SetObserver(&removing);
    CHECK(backend.InjectRegistrationState(voip::RegistrationState::registering) ==
          voip::Error::ok);
    CHECK(backend.InjectRegistrationState(voip::RegistrationState::registered, 200) ==
          voip::Error::ok);
    CHECK(removing.callbacks == 1);
    CHECK(removing.last == voip::RegistrationState::registering);

    backend.SetObserver(&observer);
    CHECK(manager.Shutdown() == voip::Error::ok);
    CHECK(!backend.HasLiveResources());
    CHECK(!backend.HasRegistrationClient());
    CHECK(observer.callbacks == 4);

    printk("[Phase 3] lifecycle %u account/regc teardown: %s\n", lifecycle,
           failures == 0 ? "PASSED" : "FAILED");
}

} // namespace

int main() {
    printk("VoIP integration Phase 3 single-account validation\n");
    for (unsigned lifecycle = 1; lifecycle <= 3; ++lifecycle) {
        TestLifecycle(lifecycle);
    }
    if (failures == 0) {
        printk("VOIP INTEGRATION PHASE 3 RESULT: PASSED (3 account lifecycles)\n");
    } else {
        printk("VOIP INTEGRATION PHASE 3 RESULT: FAILED (%d checks)\n", failures);
    }
    return failures == 0 ? 0 : 1;
}
```

## src/phase6_media.cpp
```c
#include <voip/PjVoipBackend.hpp>

#include <zephyr/kernel.h>
#include <zephyr/sys/atomic.h>
#include <zephyr/sys/printk.h>

namespace {

int failures;

#define CHECK(condition) do {                                                   \
    if (!(condition)) {                                                         \
        printk("[Phase 6] FAIL line %d: %s\n", __LINE__, #condition);          \
        ++failures;                                                             \
    }                                                                           \
} while (false)

class RecordingObserver final : public voip::Observer {
public:
    atomic_t media_callbacks{};
    voip::MediaDirection last_direction{voip::MediaDirection::inactive};

    void OnMediaState(const voip::CallInfo &info,
                      const voip::Status &status) override {
        if (status.error != voip::Error::ok) ++failures;
        last_direction = info.direction;
        atomic_inc(&media_callbacks);
    }
};

bool WaitFrames(voip::VoipManager &manager, std::uint32_t minimum) {
    for (unsigned elapsed = 0; elapsed < 5000; elapsed += 20) {
        if (manager.GetMediaStats().received_frames >= minimum) return true;
        k_msleep(20);
    }
    return false;
}

void ExerciseCodec(voip::VoipManager &manager, RecordingObserver &observer,
                   voip::Codec codec, atomic_val_t callback_base) {
    CHECK(manager.StartHeadlessMedia(codec) == voip::Error::ok);
    CHECK(manager.StartHeadlessMedia(codec) == voip::Error::busy);
    CHECK(WaitFrames(manager, 24));
    voip::MediaStats active = manager.GetMediaStats();
    CHECK(active.generated_frames >= 24);
    CHECK(active.received_frames >= 24);
    CHECK(active.rtp_packets_sent >= 24);
    CHECK(active.rtp_packets_received >= 20);
    CHECK(active.sink_hash != 2166136261U);
    CHECK(active.sink_capacity_frames == 8);
    CHECK(active.sink_peak_frames == active.sink_capacity_frames);

    CHECK(manager.SetMediaPaused(true) == voip::Error::ok);
    const std::uint32_t paused_frames = manager.GetMediaStats().generated_frames;
    k_msleep(80);
    CHECK(manager.GetMediaStats().generated_frames <= paused_frames + 1);
    CHECK(observer.last_direction == voip::MediaDirection::inactive);
    CHECK(manager.SetMediaPaused(false) == voip::Error::ok);
    CHECK(observer.last_direction == voip::MediaDirection::send_receive);
    CHECK(WaitFrames(manager, active.received_frames + 12));
    CHECK(manager.StopMedia() == voip::Error::ok);
    CHECK(manager.StopMedia() == voip::Error::invalid_state);
    CHECK(observer.last_direction == voip::MediaDirection::inactive);
    CHECK(atomic_get(&observer.media_callbacks) >= callback_base + 4);
}

void Lifecycle(unsigned number) {
    voip::PjVoipBackend backend;
    voip::VoipManager manager(backend);
    RecordingObserver observer;
    CHECK(manager.Initialize(&observer) == voip::Error::ok);
    ExerciseCodec(manager, observer, voip::Codec::pcmu, 0);
    ExerciseCodec(manager, observer, voip::Codec::pcma, 4);
    CHECK(manager.StartHeadlessMedia(voip::Codec::pcmu) == voip::Error::ok);
    CHECK(WaitFrames(manager, 12));
    CHECK(backend.InjectMediaTransportFailureForValidation() == voip::Error::ok);
    CHECK(manager.StopMedia() == voip::Error::ok);
    CHECK(manager.Shutdown() == voip::Error::ok);
    CHECK(!backend.HasLiveResources());
    printk("[Phase 6] lifecycle %u PCMU/PCMA headless media: %s\n", number,
           failures == 0 ? "PASSED" : "FAILED");
}

} // namespace

int main() {
    printk("VoIP integration Phase 6 headless G.711 RTP validation\n");
    for (unsigned lifecycle = 1; lifecycle <= 3; ++lifecycle) Lifecycle(lifecycle);
    if (failures == 0)
        printk("VOIP INTEGRATION PHASE 6 RESULT: PASSED (3 media lifecycles)\n");
    else
        printk("VOIP INTEGRATION PHASE 6 RESULT: FAILED (%d checks)\n", failures);
    return failures == 0 ? 0 : 1;
}
```

## src/pjsua_link.c
```c
#include <pjsua-lib/pjsua.h>
#include <pj_zephyr_pool_arena.h>

#include <zephyr/kernel.h>
#include <zephyr/sys/atomic.h>
#include <zephyr/sys/printk.h>

#include <stdbool.h>

_Static_assert(PJSUA_MAX_ACC == 5, "PJSUA_MAX_ACC must be five");
_Static_assert(PJSUA_MAX_CALLS == 7, "PJSUA_MAX_CALLS must be seven");
_Static_assert(PJSUA_MAX_CONF_PORTS == 12,
	       "PJSUA_MAX_CONF_PORTS must be twelve");
_Static_assert(PJMEDIA_HAS_SRTP == 0, "PJMEDIA SRTP must remain disabled");
_Static_assert(PJSIP_HAS_TLS_TRANSPORT == 0,
	       "PJSIP TLS transport must remain disabled");

#define PJSUA_LIFECYCLES 5
#ifndef PJSUA_EVENT_POLL_LIMIT
#define PJSUA_EVENT_POLL_LIMIT 100
#endif

static k_tid_t actor_thread;
static atomic_t callback_count;
static atomic_t callback_affinity_ok;

static int expect(int condition, const char *message)
{
	if (!condition) {
		printk("PJSUA LINK CHECK FAILED: %s\n", message);
		return -1;
	}
	return 0;
}

static void record_callback(void)
{
	atomic_inc(&callback_count);
	if (k_current_get() != actor_thread)
		atomic_set(&callback_affinity_ok, 0);
}

static void on_call_state(pjsua_call_id call_id, pjsip_event *event)
{
	PJ_UNUSED_ARG(call_id);
	PJ_UNUSED_ARG(event);
	record_callback();
}

static void on_timer(void *user_data)
{
	PJ_UNUSED_ARG(user_data);
	record_callback();
}

static int destroy_and_audit(struct pj_zephyr_pool_arena_stats *stats,
			     bool require_peak)
{
	const pj_status_t status = pjsua_destroy();

	pj_zephyr_pool_arena_get_stats(stats);
	if (expect(status == PJ_SUCCESS, "pjsua destroy") != 0)
		return -1;
	if (expect(stats->capacity_bytes == CONFIG_PJSUA_ARENA_BYTES &&
		   stats->used_bytes == 0 && stats->live_blocks == 0 &&
		   (!require_peak || (stats->peak_bytes > 0 &&
				      stats->peak_bytes <= stats->capacity_bytes)),
		   "arena is clean after destroy") != 0)
		return -1;
	return 0;
}

static int poll_until_callback(void)
{
	unsigned polls;

	for (polls = 0; polls < PJSUA_EVENT_POLL_LIMIT &&
		     atomic_get(&callback_count) == 0; ++polls) {
		if (pjsua_handle_events(10) < 0)
			return -1;
	}
	return atomic_get(&callback_count) == 0 ? -1 : 0;
}

static int run_lifecycle(void)
{
	pj_status_t status;
	pjsua_config ua_cfg;
	pjsua_logging_config log_cfg;
	pjsua_media_config media_cfg;
	struct pj_zephyr_pool_arena_stats before;
	struct pj_zephyr_pool_arena_stats after_start;
	struct pj_zephyr_pool_arena_stats after_destroy;
	unsigned lifecycle;

	actor_thread = k_current_get();
	atomic_set(&callback_affinity_ok, 1);
	status = pj_zephyr_pool_arena_install();
	if (expect(status == PJ_SUCCESS, "arena install") != 0)
		return -1;

	for (lifecycle = 0; lifecycle < PJSUA_LIFECYCLES; ++lifecycle) {
		atomic_set(&callback_count, 0);
		status = pj_zephyr_pool_arena_reset();
		if (expect(status == PJ_SUCCESS, "arena reset before lifecycle") != 0)
			return -1;
		pj_zephyr_pool_arena_get_stats(&before);
		if (expect(before.capacity_bytes == CONFIG_PJSUA_ARENA_BYTES &&
			   before.used_bytes == 0 && before.live_blocks == 0,
			   "arena starts without live blocks") != 0)
			return -1;

		status = pjsua_create();
		if (status != PJ_SUCCESS) {
			(void)destroy_and_audit(&after_destroy, false);
			return -1;
		}

		pjsua_config_default(&ua_cfg);
		pjsua_logging_config_default(&log_cfg);
		pjsua_media_config_default(&media_cfg);
		log_cfg.level = 6;
		ua_cfg.thread_cnt = 0;
		ua_cfg.max_calls = PJSUA_MAX_CALLS;
		ua_cfg.enable_unsolicited_mwi = PJ_FALSE;
		ua_cfg.stun_srv_cnt = 0;
		ua_cfg.enable_upnp = PJ_FALSE;
		ua_cfg.cb.on_call_state = &on_call_state;
		media_cfg.thread_cnt = 0;
		media_cfg.max_media_ports = PJSUA_MAX_CONF_PORTS;
		media_cfg.has_ioqueue = PJ_FALSE;
		media_cfg.conf_threads = 1;
		media_cfg.enable_ice = PJ_FALSE;
		media_cfg.enable_turn = PJ_FALSE;

		if (ua_cfg.max_calls != PJSUA_MAX_CALLS ||
		    media_cfg.max_media_ports != PJSUA_MAX_CONF_PORTS) {
			(void)destroy_and_audit(&after_destroy, true);
			return -1;
		}

		status = pjsua_init(&ua_cfg, &log_cfg, &media_cfg);
		if (status == PJ_SUCCESS && pjsua_set_no_snd_dev() == NULL)
			status = PJ_ENOTFOUND;
		if (status == PJ_SUCCESS)
			status = pjsua_start();
		pj_zephyr_pool_arena_get_stats(&after_start);
		if (expect(after_start.peak_bytes > 0 &&
			   after_start.peak_bytes <= after_start.capacity_bytes,
			   "arena peak is bounded and non-zero") != 0)
			status = PJ_EUNKNOWN;

		/* First poll the bare lifecycle; use a timer only if it was quiet. */
		if (status == PJ_SUCCESS && pjsua_handle_events(10) < 0)
			status = PJ_EUNKNOWN;
		if (status == PJ_SUCCESS && atomic_get(&callback_count) == 0 &&
		    pjsua_schedule_timer2(&on_timer, NULL, 0) != PJ_SUCCESS)
			status = PJ_EUNKNOWN;
		if (status == PJ_SUCCESS && atomic_get(&callback_count) == 0 &&
		    poll_until_callback() != 0) {
			printk("PJSUA LINK CHECK FAILED: callback dispatch timeout\n");
			status = PJ_ETIMEDOUT;
		}

		if (atomic_get(&callback_count) == 0 ||
		    atomic_get(&callback_affinity_ok) == 0)
			status = PJ_EUNKNOWN;
		if (destroy_and_audit(&after_destroy, true) != 0)
			status = PJ_EUNKNOWN;
		/* Destruction may dispatch a late callback, so check affinity again. */
		if (atomic_get(&callback_affinity_ok) == 0)
			status = PJ_EUNKNOWN;
		if (status == PJ_SUCCESS)
			printk("PJSUA LINK lifecycle %u: callbacks=%u actor-affine\n",
			       lifecycle + 1, (unsigned)atomic_get(&callback_count));
		if (status != PJ_SUCCESS)
			return -1;
	}

	return 0;
}

int main(void)
{
	const int result = run_lifecycle();

	printk("PJSUA LINK RESULT: %s\n",
	       result == 0 ? "PASSED (5 lifecycles, arena clean)" : "FAILED");
	return result;
}
```

## src/sdk_contract.cpp
```c
#include <voip/FakeVoipBackend.hpp>
#include <voip/VoipService.hpp>

#include <zephyr/kernel.h>
#include <zephyr/sys/printk.h>

#include <cstring>

namespace {

K_THREAD_STACK_DEFINE(event_stack, 2048);
struct k_work_q event_queue;
int failures;

#define CHECK(condition) do { if (!(condition)) ++failures; } while (false)

class Events final : public voip::EventHandler {
public:
    unsigned registration_events{};
    unsigned call_events{};

    void OnEvent(const voip::Event &event) noexcept override {
        if (event.type == voip::EventType::account_state)
            ++registration_events;
        if (event.type == voip::EventType::call_state)
            ++call_events;
    }
};

class Source final : public voip::PcmSource {
public:
    voip::Error Read(std::int16_t *, std::size_t,
                     std::uint64_t) noexcept override {
        return voip::Error::ok;
    }
};

class Sink final : public voip::PcmSink {
public:
    voip::Error Write(const std::int16_t *, std::size_t,
                      std::uint64_t) noexcept override {
        return voip::Error::ok;
    }
};

} // namespace

int main() {
    k_work_queue_start(&event_queue, event_stack,
                       K_THREAD_STACK_SIZEOF(event_stack), 5, nullptr);

    voip::FakeVoipBackend backend;
    voip::VoipService service(backend);
    Events events;
    const voip::ServiceConfig config{&event_queue, 8, 8};
    CHECK(service.Initialize(config, &events) == voip::Error::ok);

    const voip::AccountConfig account{
        "sip:alice@127.0.0.1", "sip:127.0.0.1;transport=tcp",
        "alice", "sdk-contract-secret", 300};
    voip::AccountHandle account_handle{};
    CHECK(service.AddAccount(account, &account_handle) == voip::Error::ok);

    voip::OperationId operation = 0;
    CHECK(service.SetRegistration(account_handle, true, &operation) ==
          voip::Error::ok);
    k_sleep(K_MSEC(20));
    CHECK(events.registration_events == 2);

    Source source;
    Sink sink;
    const voip::CallConfig call{
        "sip:bob@127.0.0.1", voip::Codec::pcmu, &source, &sink};
    voip::CallHandle call_handle{};
    CHECK(service.Dial(account_handle, call, &call_handle, &operation) ==
          voip::Error::ok);
    k_sleep(K_MSEC(20));
    CHECK(events.call_events == 1);
    CHECK(service.RemoveAccount(account_handle) == voip::Error::busy);
    CHECK(service.Hangup(call_handle, &operation) == voip::Error::ok);
    k_sleep(K_MSEC(20));
    CHECK(service.Shutdown() == voip::Error::ok);

    printk("VOIP SDK CONTRACT RESULT: %s\n",
           failures == 0 ? "PASSED" : "FAILED");
    return failures == 0 ? 0 : 1;
}
```
