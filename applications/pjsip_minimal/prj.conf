## CMakeLists.txt
```
cmake_minimum_required(VERSION 3.20.0)

list(APPEND ZEPHYR_EXTRA_MODULES
  "${CMAKE_CURRENT_LIST_DIR}/../../pjproject"
)

find_package(Zephyr REQUIRED HINTS $ENV{ZEPHYR_BASE})
project(pjsip_minimal)

target_sources(app PRIVATE src/main.c)
target_sources_ifdef(CONFIG_PJSIP_PHASE3_TEST app PRIVATE src/phase3_util.c)
target_sources_ifdef(CONFIG_PJSIP_PHASE4_TEST app PRIVATE src/phase4_core.c)
target_sources_ifdef(CONFIG_PJSIP_PHASE5_TEST app PRIVATE src/phase5_core.c)
target_sources_ifdef(CONFIG_PJSIP_PHASE6_TEST app PRIVATE src/phase6_loop.c)
target_sources_ifdef(CONFIG_PJSIP_PHASE7_TEST app PRIVATE src/phase7_udp.c)
target_sources_ifdef(CONFIG_PJSIP_PHASE8_TEST app PRIVATE src/phase8_tcp.c)
target_sources_ifdef(CONFIG_PJSIP_PHASE9_TEST app PRIVATE src/phase9_resolver.c)
target_sources_ifdef(CONFIG_PJSIP_PHASE10_TEST app PRIVATE src/phase10_signaling.c)
target_sources_ifdef(CONFIG_PJSIP_PHASE11_TEST app PRIVATE
  src/phase7_udp.c
  src/phase10_signaling.c
  src/phase11_robustness.c
)
```

## Kconfig
```
source "Kconfig.zephyr"

# Test-only selectors default to n; each phase overlay enables only its test.
menu "PJSIP minimal application validation"

config PJSIP_PHASE3_TEST
	bool "PJSIP Phase 3 PJLIB-UTIL validation"
	depends on PJPROJECT && PJLIB_UTIL
	depends on !PJSIP
	help
	  Build the focused initialization, scanner, string escaping, and MD5
	  validation for the initial four-source PJLIB-UTIL subset. PJSIP remains
	  disabled so this test cannot accidentally cross the Phase 4 boundary.

config PJSIP_PHASE4_TEST
	bool "PJSIP Phase 4 core compile/link validation"
	depends on PJPROJECT && PJSIP
	help
	  Include the public PJSIP umbrella header and validate the explicit
	  Zephyr core configuration. Endpoint creation and transport runtime tests
	  remain outside this compile/link-only phase.

config PJSIP_PHASE5_TEST
	bool "PJSIP Phase 5 parser/message/endpoint validation"
	depends on PJPROJECT && PJSIP
	help
	  Run deterministic URI, message, multipart, authentication, transmit-data,
	  module, and repeated endpoint lifecycle tests without socket transports.

config PJSIP_PHASE6_TEST
	bool "PJSIP Phase 6 event loop/loop transport/transaction validation"
	depends on PJPROJECT && PJSIP
	help
	  Run deterministic endpoint polling, timer, loop-datagram transport, and
	  UAC/UAS transaction state-machine tests without socket transports.

config PJSIP_PHASE7_TEST
	bool "PJSIP Phase 7 IPv4 UDP transport validation"
	depends on PJPROJECT && PJSIP && PJSIP_UDP_TRANSPORT
	help
	  Run deterministic IPv4 UDP-loopback transport, malformed datagram,
	  ioqueue-capacity, and UAC/UAS transaction tests without Internet access.

config PJSIP_PHASE8_TEST
	bool "PJSIP Phase 8 IPv4 TCP transport validation"
	depends on PJPROJECT && PJSIP && PJSIP_TCP_TRANSPORT
	depends on PJSIP_UDP_TRANSPORT
	help
	  Run deterministic IPv4 TCP-loopback listener, framing, connection,
	  reconnect, and UAC/UAS transaction tests alongside UDP transport.

config PJSIP_PHASE9_TEST
	bool "PJSIP Phase 9 deterministic SIP resolution validation"
	depends on PJPROJECT && PJSIP && PJSIP_UDP_TRANSPORT
	depends on PJLIB_UTIL_DNS_RESOLVER
	help
	  Run deterministic IPv4 A and SIP SRV resolution, failure, timeout,
	  cancellation, resolver destruction, and resolved-transport tests against
	  an application-local DNS responder without Internet access.

config PJSIP_PHASE10_TEST
	bool "PJSIP Phase 10 usable signaling and registration validation"
	depends on PJPROJECT && PJSIP && PJSIP_REGC
	depends on PJSIP_UDP_TRANSPORT
	help
	  Register with an application-local registrar, complete Digest challenge
	  handling, refresh and unregister, validate invalid credentials and
	  timeout recovery, exchange OPTIONS, and shut down cleanly.

config PJSIP_PHASE11_TEST
	bool "PJSIP Phase 11 robustness and resource validation"
	depends on PJPROJECT && PJSIP && PJSIP_REGC
	depends on PJSIP_UDP_TRANSPORT
	help
	  Re-run the UDP and usable-signaling gates, then validate concurrent
	  transactions, a sustained event-loop soak, malformed and boundary-size
	  datagrams, fixed-pool exhaustion, cancellation during transport
	  shutdown, resource high-water marks, and leak-free teardown.

endmenu
```

## prj.conf
```kconfig
CONFIG_CONSOLE=y
CONFIG_PRINTK=y
CONFIG_SERIAL=y

# Preserve the validated PJLIB Zephyr platform baseline while the PJSIP layers
# are introduced one component at a time.
CONFIG_CPP=y
CONFIG_GLIBCXX_LIBCPP=y
CONFIG_PICOLIBC=y
CONFIG_POSIX_API=y
CONFIG_DYNAMIC_THREAD=y
CONFIG_DYNAMIC_THREAD_POOL_SIZE=5
CONFIG_DYNAMIC_THREAD_STACK_SIZE=8192

CONFIG_NETWORKING=y
CONFIG_NET_SOCKETS=y
CONFIG_NET_IPV4=y
CONFIG_NET_IPV6=n
CONFIG_NET_TCP=y
CONFIG_NET_UDP=y
CONFIG_DNS_RESOLVER=y
CONFIG_TEST_RANDOM_GENERATOR=y

CONFIG_NET_QEMU_SLIP=n
CONFIG_NET_SLIP_TAP=n
CONFIG_SLIP=n

# The default application stays at the validated PJLIB-only boundary. Phase
# overlays opt into exactly one later validation boundary at a time.
CONFIG_PJPROJECT=y
CONFIG_PJLIB_UTIL=n
CONFIG_PJSIP=n
```

## phase10_signaling.conf
```kconfig
# Phase 10 validates the initial usable IPv4 SIP signaling profile against an
# application-local registrar. No public registrar or DNS service is used.
CONFIG_PJLIB_UTIL=y
CONFIG_PJLIB_UTIL_DNS_RESOLVER=y
CONFIG_PJSIP=y
CONFIG_PJSIP_REGC=y
CONFIG_PJSIP_UDP_TRANSPORT=y
CONFIG_PJSIP_TCP_TRANSPORT=n
CONFIG_PJSIP_PHASE10_TEST=y

CONFIG_NET_IPV6=n
CONFIG_NET_LOOPBACK=y

# Two SIP UDP transports and the endpoint ioqueue remain below these explicit
# application limits. The resolver sources are linked as part of the usable
# profile, but numeric loopback addressing keeps this test self-contained.
CONFIG_NET_MAX_CONTEXTS=40
CONFIG_NET_MAX_CONN=40
CONFIG_ZVFS_OPEN_MAX=48
CONFIG_ZVFS_POLL_MAX=40
CONFIG_NET_BUF_DATA_SIZE=256
CONFIG_NET_BUF_RX_COUNT=32
CONFIG_NET_BUF_TX_COUNT=32
CONFIG_NET_PKT_RX_COUNT=16
CONFIG_NET_PKT_TX_COUNT=16

CONFIG_MAIN_STACK_SIZE=24576
CONFIG_HEAP_MEM_POOL_SIZE=393216
CONFIG_DYNAMIC_THREAD_POOL_SIZE=10
CONFIG_DYNAMIC_THREAD_STACK_SIZE=8192
CONFIG_MAX_PTHREAD_MUTEX_COUNT=64
```

## phase11_robustness.conf
```kconfig
# Phase 11 validates robustness and resource behavior for the usable IPv4
# UDP signaling profile. It uses only QEMU loopback services.
CONFIG_PJLIB_UTIL=y
CONFIG_PJLIB_UTIL_DNS_RESOLVER=y
CONFIG_PJSIP=y
CONFIG_PJSIP_REGC=y
CONFIG_PJSIP_UDP_TRANSPORT=y
CONFIG_PJSIP_TCP_TRANSPORT=n
CONFIG_PJSIP_PHASE11_TEST=y

CONFIG_NET_IPV6=n
CONFIG_NET_LOOPBACK=y

# Keep platform limits above PJSIP's tested 16-handle endpoint ceiling so the
# ioqueue, rather than an earlier Zephyr descriptor ceiling, reports overflow.
CONFIG_NET_MAX_CONTEXTS=40
CONFIG_NET_MAX_CONN=40
CONFIG_ZVFS_OPEN_MAX=48
CONFIG_ZVFS_POLL_MAX=40
CONFIG_NET_BUF_DATA_SIZE=256
CONFIG_NET_BUF_RX_COUNT=40
CONFIG_NET_BUF_TX_COUNT=40
CONFIG_NET_PKT_RX_COUNT=20
CONFIG_NET_PKT_TX_COUNT=20
CONFIG_NET_IPV4_FRAGMENT=y
CONFIG_NET_IPV4_FRAGMENT_MAX_COUNT=4

CONFIG_MAIN_STACK_SIZE=24576
CONFIG_HEAP_MEM_POOL_SIZE=393216
CONFIG_DYNAMIC_THREAD_POOL_SIZE=10
CONFIG_DYNAMIC_THREAD_STACK_SIZE=8192
CONFIG_MAX_PTHREAD_MUTEX_COUNT=64

# Required by the documented k_thread_stack_space_get() watermark API.
CONFIG_THREAD_STACK_INFO=y
CONFIG_INIT_STACKS=y
CONFIG_ASSERT=y
```

## phase2_none.conf
```kconfig
# Source-boundary check: keep the module discoverable but compile no PJPROJECT
# component library.
CONFIG_PJLIB=n
```

## phase2_pjsip.conf
```kconfig
# Dependency-boundary check only. PJSIP production sources begin in Phase 4.
CONFIG_PJLIB_UTIL=y
CONFIG_PJSIP=y
```

## phase2_util.conf
```kconfig
# Source-boundary check: add exactly the initial four-source PJLIB-UTIL subset.
CONFIG_PJLIB_UTIL=y
```

## phase3_util.conf
```kconfig
# Phase 3 validates only the four-source PJLIB-UTIL subset selected by the
# Phase 1 dependency analysis. PJSIP production sources remain disabled.
CONFIG_PJLIB_UTIL=y
CONFIG_PJSIP=n
CONFIG_PJSIP_PHASE3_TEST=y

# The optimized validation harness has a 2,964-byte static frame because its
# scanner canaries and character-set exhaustion test coexist. Keep additional
# headroom for PJLIB calls and printk; this is test-harness sizing, not the
# later PJSIP production-thread stack decision.
CONFIG_MAIN_STACK_SIZE=8192
```

## src/main.c
```c
#include <zephyr/sys/printk.h>

#if defined(CONFIG_PJLIB)
#include <pjlib.h>
#endif

#if defined(CONFIG_PJSIP_PHASE3_TEST)
int phase3_util_run(void);
#endif

#if defined(CONFIG_PJSIP_PHASE4_TEST)
int phase4_core_run(void);
#endif

#if defined(CONFIG_PJSIP_PHASE5_TEST)
int phase5_core_run(void);
#endif

#if defined(CONFIG_PJSIP_PHASE6_TEST)
int phase6_loop_run(void);
#endif

#if defined(CONFIG_PJSIP_PHASE7_TEST)
int phase7_udp_run(void);
#endif

#if defined(CONFIG_PJSIP_PHASE8_TEST)
int phase8_tcp_run(void);
#endif

#if defined(CONFIG_PJSIP_PHASE9_TEST)
int phase9_resolver_run(void);
#endif

#if defined(CONFIG_PJSIP_PHASE10_TEST)
int phase10_signaling_run(void);
#endif

#if defined(CONFIG_PJSIP_PHASE11_TEST)
int phase11_robustness_run(void);
#endif

int main(void)
{
	printk("PJSIP minimal Zephyr application\n");
#if defined(CONFIG_PJSIP_PHASE11_TEST)
	return phase11_robustness_run();
#elif defined(CONFIG_PJSIP_PHASE10_TEST)
	return phase10_signaling_run();
#elif defined(CONFIG_PJSIP_PHASE9_TEST)
	return phase9_resolver_run();
#elif defined(CONFIG_PJSIP_PHASE8_TEST)
	return phase8_tcp_run();
#elif defined(CONFIG_PJSIP_PHASE7_TEST)
	return phase7_udp_run();
#elif defined(CONFIG_PJSIP_PHASE6_TEST)
	return phase6_loop_run();
#elif defined(CONFIG_PJSIP_PHASE5_TEST)
	return phase5_core_run();
#elif defined(CONFIG_PJSIP_PHASE4_TEST)
	return phase4_core_run();
#elif defined(CONFIG_PJSIP_PHASE3_TEST)
	return phase3_util_run();
#endif

#if defined(CONFIG_PJLIB)
	pj_status_t status = pj_init();

	if (status != PJ_SUCCESS) {
		printk("PJLIB initialization failed: %d\n", status);
		return 1;
	}

	printk("PJLIB initialization successful\n");
	pj_shutdown();
	printk("PJLIB shutdown successful\n");
#else
	printk("PJLIB disabled for component source-boundary validation\n");
#endif

	return 0;
}
```

## src/phase3_util.c
```c
#include <pjlib.h>
#include <pjlib-util.h>

#include <stdint.h>
#include <string.h>

#include <zephyr/sys/printk.h>

#define PHASE3_LIFECYCLES 3
#define PHASE3_INIT_REPEATS 3
#define GUARD_WORD UINT32_C(0x51A7C0DE)
#define GUARD_BYTE UINT8_C(0xA5)

static int scanner_error_count;

static int fail_status(const char *test, int line, pj_status_t status)
{
	char text[PJ_ERR_MSG_SIZE];

	pj_strerror(status, text, sizeof(text));
	printk("[Phase 3] FAIL %s:%d status=%d (%s)\n",
	       test, line, status, text);
	return -1;
}

static int fail_value(const char *test, int line, const char *condition)
{
	printk("[Phase 3] FAIL %s:%d condition=%s\n",
	       test, line, condition);
	return -1;
}

#define CHECK_STATUS(test_name, expression)                                  \
	do {                                                                     \
		pj_status_t check_status_ = (expression);                           \
		if (check_status_ != PJ_SUCCESS)                                    \
			return fail_status((test_name), __LINE__, check_status_);      \
	} while (0)

#define CHECK_TRUE(test_name, condition)                                     \
	do {                                                                     \
		if (!(condition))                                                  \
			return fail_value((test_name), __LINE__, #condition);         \
	} while (0)

static pj_bool_t str_equals(const pj_str_t *value, const char *expected)
{
	pj_size_t expected_len = strlen(expected);

	return value->slen == (pj_ssize_t)expected_len &&
	       memcmp(value->ptr, expected, expected_len) == 0;
}

static pj_bool_t str_starts_with(const pj_str_t *value, const char *prefix)
{
	pj_size_t prefix_len = strlen(prefix);

	return value->slen >= (pj_ssize_t)prefix_len &&
	       memcmp(value->ptr, prefix, prefix_len) == 0;
}

static pj_bool_t bytes_are(const uint8_t *bytes, pj_size_t count, uint8_t value)
{
	pj_size_t i;

	for (i = 0; i < count; ++i) {
		if (bytes[i] != value)
			return PJ_FALSE;
	}
	return PJ_TRUE;
}

static void scanner_error(pj_scanner *scanner)
{
	PJ_UNUSED_ARG(scanner);
	++scanner_error_count;
}

static int test_error_registration(void)
{
	const char *test = "error registration";
	char text[PJ_ERR_MSG_SIZE];
	pj_str_t result;

	result = pj_strerror(PJLIB_UTIL_EINXML, text, sizeof(text));
	/* PJ_BUILD_ERR appends the symbolic error name in the default profile. */
	CHECK_TRUE(test, str_starts_with(&result, "Invalid XML message"));
	CHECK_TRUE(test, text[result.slen] == '\0');
	return 0;
}

static int test_scanner(void)
{
	const char *test = "scanner";
	pj_cis_buf_t cis_buffer;
	pj_cis_buf_t exhaustion_buffer;
	pj_cis_t token;
	pj_cis_t slots[PJ_CIS_MAX_INDEX + 1];
	pj_scanner scanner;
	pj_scan_state state;
	pj_str_t value;
	unsigned i;
	char request[] = "  INVITE sip:user@example.com SIP/2.0\r\n";
	char newline[] = "\r\n next";
	char empty[] = "";
	struct {
		char data[32];
		uint32_t guard;
	} escaped = {"alice%20smith", GUARD_WORD};
	struct {
		char data[2];
		uint8_t guard[4];
	} malformed = {{'%', '\0'}, {GUARD_BYTE, GUARD_BYTE,
					       GUARD_BYTE, GUARD_BYTE}};

	pj_cis_buf_init(&cis_buffer);
	CHECK_STATUS(test, pj_cis_init(&cis_buffer, &token));
	pj_cis_add_alpha(&token);
	pj_cis_add_num(&token);
	pj_cis_add_str(&token, "-._~@");

	scanner_error_count = 0;
	pj_scan_init(&scanner, request, strlen(request), PJ_SCAN_AUTOSKIP_WS,
		     scanner_error);
	pj_scan_get(&scanner, &token, &value);
	CHECK_TRUE(test, str_equals(&value, "INVITE"));
	CHECK_TRUE(test, pj_scan_stricmp_alnum(&scanner, "sip", 3) == 0);
	pj_scan_save_state(&scanner, &state);
	pj_scan_advance_n(&scanner, 4, PJ_FALSE);
	CHECK_TRUE(test, pj_scan_get_char(&scanner) == 'u');
	pj_scan_restore_state(&scanner, &state);
	pj_scan_get_until_ch(&scanner, ' ', &value);
	CHECK_TRUE(test, str_equals(&value, "sip:user@example.com"));
	CHECK_TRUE(test, pj_scan_strcmp(&scanner, "SIP/2.0", 7) == 0);
	pj_scan_get_n(&scanner, 7, &value);
	CHECK_TRUE(test, str_equals(&value, "SIP/2.0"));
	pj_scan_get_newline(&scanner);
	CHECK_TRUE(test, pj_scan_is_eof(&scanner));
	CHECK_TRUE(test, scanner.line == 2);
	CHECK_TRUE(test, scanner_error_count == 0);
	pj_scan_fini(&scanner);

	pj_scan_init(&scanner, newline, strlen(newline),
		     PJ_SCAN_AUTOSKIP_WS | PJ_SCAN_AUTOSKIP_NEWLINE,
		     scanner_error);
	CHECK_TRUE(test, scanner.line == 2);
	CHECK_TRUE(test, pj_scan_get_col(&scanner) == 1);
	CHECK_TRUE(test, pj_scan_strcmp(&scanner, "next", 4) == 0);
	pj_scan_fini(&scanner);

	pj_scan_init(&scanner, empty, 0, 0, scanner_error);
	CHECK_TRUE(test, pj_scan_peek_n(&scanner, 1, &value) == -1);
	CHECK_TRUE(test, scanner_error_count == 1);
	CHECK_TRUE(test, scanner.curptr == scanner.begin);
	pj_scan_fini(&scanner);

	pj_scan_init(&scanner, escaped.data, strlen(escaped.data), 0,
		     scanner_error);
	pj_scan_get_unescape(&scanner, &token, &value);
	CHECK_TRUE(test, str_equals(&value, "alice smith"));
	CHECK_TRUE(test, pj_scan_is_eof(&scanner));
	CHECK_TRUE(test, escaped.guard == GUARD_WORD);
	pj_scan_fini(&scanner);

	pj_scan_init(&scanner, malformed.data, 1, 0, scanner_error);
	pj_scan_get_unescape(&scanner, &token, &value);
	CHECK_TRUE(test, bytes_are(malformed.guard, sizeof(malformed.guard),
				    GUARD_BYTE));
	CHECK_TRUE(test, pj_scan_is_eof(&scanner));
	pj_scan_fini(&scanner);

	pj_cis_buf_init(&exhaustion_buffer);
	for (i = 0; i < PJ_CIS_MAX_INDEX; ++i)
		CHECK_STATUS(test, pj_cis_init(&exhaustion_buffer, &slots[i]));
	CHECK_TRUE(test, pj_cis_init(&exhaustion_buffer,
				     &slots[PJ_CIS_MAX_INDEX]) == PJ_ETOOMANY);

	printk("[Phase 3] scanner boundaries/errors: PASSED\n");
	return 0;
}

static int test_string_utilities(pj_pool_t *pool)
{
	const char *test = "string utilities";
	pj_cis_buf_t cis_buffer;
	pj_cis_t unreserved;
	pj_str_t source = pj_str("alice smith@example.com");
	pj_str_t escaped_source = pj_str("alice%20smith%40example.com");
	pj_str_t malformed_source = pj_str("user%ZZ@example.com%");
	pj_str_t plain_source = pj_str("plain-user");
	pj_str_t result;
	struct {
		uint32_t before;
		char data[64];
		uint32_t after;
	} output = {GUARD_WORD, {0}, GUARD_WORD};
	struct {
		uint8_t before[4];
		char data[5];
		uint8_t after[4];
	} small;
	struct {
		uint32_t before;
		char data[64];
		uint32_t after;
	} copied = {GUARD_WORD, {0}, GUARD_WORD};

	pj_cis_buf_init(&cis_buffer);
	CHECK_STATUS(test, pj_cis_init(&cis_buffer, &unreserved));
	pj_cis_add_alpha(&unreserved);
	pj_cis_add_num(&unreserved);
	pj_cis_add_str(&unreserved, "-._~");

	result.ptr = output.data;
	CHECK_TRUE(test, pj_strncpy_escape(&result, &source,
					   sizeof(output.data), &unreserved) != NULL);
	CHECK_TRUE(test, str_equals(&result, "alice%20smith%40example.com"));
	CHECK_TRUE(test, output.before == GUARD_WORD &&
			 output.after == GUARD_WORD);

	memset(&small, GUARD_BYTE, sizeof(small));
	result.ptr = small.data;
	CHECK_TRUE(test, pj_strncpy_escape(&result, &source,
					   sizeof(small.data), &unreserved) == NULL);
	CHECK_TRUE(test, result.slen == -1);
	CHECK_TRUE(test, bytes_are(small.before, sizeof(small.before), GUARD_BYTE));
	CHECK_TRUE(test, bytes_are(small.after, sizeof(small.after), GUARD_BYTE));

	result = pj_str_unescape(pool, &escaped_source);
	CHECK_TRUE(test, str_equals(&result, "alice smith@example.com"));
	result = pj_str_unescape(pool, &malformed_source);
	CHECK_TRUE(test, str_equals(&result, "user%ZZ@example.com%"));
	result = pj_str_unescape(pool, &plain_source);
	CHECK_TRUE(test, result.ptr == plain_source.ptr &&
			 result.slen == plain_source.slen);

	result.ptr = copied.data;
	pj_strcpy_unescape(&result, &escaped_source);
	CHECK_TRUE(test, str_equals(&result, "alice smith@example.com"));
	CHECK_TRUE(test, copied.before == GUARD_WORD &&
			 copied.after == GUARD_WORD);

	printk("[Phase 3] string escape/unescape: PASSED\n");
	return 0;
}

static void digest_to_hex(const uint8_t digest[16], char output[33])
{
	static const char hex[] = "0123456789abcdef";
	unsigned i;

	for (i = 0; i < 16; ++i) {
		output[i * 2] = hex[digest[i] >> 4];
		output[i * 2 + 1] = hex[digest[i] & 0x0f];
	}
	output[32] = '\0';
}

static int test_md5(void)
{
	const char *test = "MD5";
	static const struct {
		const char *input;
		const char *expected;
	} vectors[] = {
		{"", "d41d8cd98f00b204e9800998ecf8427e"},
		{"a", "0cc175b9c0f1b6a831c399e269772661"},
		{"abc", "900150983cd24fb0d6963f7d28e17f72"},
		{"message digest", "f96b697d7cb7938d525a2f31aaf161d0"},
		{"abcdefghijklmnopqrstuvwxyz", "c3fcd3d76192e4007dfb496cca67e13b"},
	};
	unsigned vector_index;

	for (vector_index = 0; vector_index < PJ_ARRAY_SIZE(vectors);
	     ++vector_index) {
		struct {
			uint32_t before;
			pj_md5_context context;
			uint32_t after;
		} guarded_context = {GUARD_WORD, {{0}, {0}, {0}}, GUARD_WORD};
		struct {
			uint32_t before;
			uint8_t digest[16];
			uint32_t after;
		} guarded_digest = {GUARD_WORD, {0}, GUARD_WORD};
		char actual[33];
		pj_size_t input_len = strlen(vectors[vector_index].input);
		pj_size_t offset;

		pj_md5_init(&guarded_context.context);
		pj_md5_update(&guarded_context.context,
			      (const uint8_t *)vectors[vector_index].input, 0);
		for (offset = 0; offset < input_len; ++offset) {
			pj_md5_update(&guarded_context.context,
				      (const uint8_t *)vectors[vector_index].input +
				      offset, 1);
		}
		pj_md5_final(&guarded_context.context, guarded_digest.digest);
		digest_to_hex(guarded_digest.digest, actual);
		CHECK_TRUE(test, strcmp(actual, vectors[vector_index].expected) == 0);
		CHECK_TRUE(test, guarded_context.before == GUARD_WORD &&
				 guarded_context.after == GUARD_WORD);
		CHECK_TRUE(test, guarded_digest.before == GUARD_WORD &&
				 guarded_digest.after == GUARD_WORD);
	}

	printk("[Phase 3] MD5 RFC 1321 vectors: PASSED\n");
	return 0;
}

static int run_lifecycle(int iteration)
{
	pj_caching_pool caching_pool;
	pj_pool_t *pool;
	pj_status_t status;
	int repeat;
	int result = -1;

	status = pj_init();
	if (status != PJ_SUCCESS)
		return fail_status("pj_init", __LINE__, status);

	for (repeat = 1; repeat <= PHASE3_INIT_REPEATS; ++repeat) {
		status = pjlib_util_init();
		if (status != PJ_SUCCESS) {
			fail_status("pjlib_util_init", __LINE__, status);
			goto shutdown;
		}
	}
	if (test_error_registration() != 0)
		goto shutdown;

	pj_caching_pool_init(&caching_pool, NULL, 0);
	pool = pj_pool_create(&caching_pool.factory, "phase3", 4096, 4096, NULL);
	if (pool == NULL) {
		fail_value("pool setup", __LINE__, "pool != NULL");
		goto destroy_pool_factory;
	}

	if (test_scanner() != 0 ||
	    test_string_utilities(pool) != 0 ||
	    test_md5() != 0)
		goto release_pool;

	result = 0;

release_pool:
	pj_pool_release(pool);
	if (result == 0 &&
	    (caching_pool.used_count != 0 || caching_pool.capacity != 0)) {
		fail_value("pool cleanup", __LINE__,
			   "used_count == 0 && capacity == 0");
		result = -1;
	}
	if (result == 0)
		printk("[Phase 3] lifecycle %d: PASSED\n", iteration);
destroy_pool_factory:
	pj_caching_pool_destroy(&caching_pool);
shutdown:
	pj_shutdown();
	printk("[Phase 3] lifecycle %d shutdown complete\n", iteration);
	return result;
}

int phase3_util_run(void)
{
	int iteration;

	printk("[Phase 3] PJLIB-UTIL four-source validation ");
	printk("(%d repeated lifecycles)\n", PHASE3_LIFECYCLES);
	for (iteration = 1; iteration <= PHASE3_LIFECYCLES; ++iteration) {
		if (run_lifecycle(iteration) != 0) {
			printk("PHASE 3 RESULT: FAILED at lifecycle %d\n", iteration);
			return 1;
		}
	}

	printk("PHASE 3 RESULT: PASSED (%d/%d lifecycles, %d init calls)\n",
	       PHASE3_LIFECYCLES, PHASE3_LIFECYCLES,
	       PHASE3_LIFECYCLES * PHASE3_INIT_REPEATS);
	return 0;
}
```

## src/phase4_core.c
```c
#include <zephyr/sys/printk.h>

#include <pjsip.h>

/* Configuration and pool values audited for the first embedded profile. */
_Static_assert(PJ_HAS_IPV6 == 0, "Phase 4 requires IPv6 to remain disabled");
_Static_assert(PJSIP_HAS_TLS_TRANSPORT == 0, "TLS must remain excluded");
_Static_assert(PJSIP_HAS_DIGEST_AKA_AUTH == 0, "Digest AKA must remain excluded");
_Static_assert(PJSIP_HAS_RESOLVER == 0, "full DNS/SRV resolver is deferred");
_Static_assert(PJSIP_MAX_TSX_COUNT == 31, "unexpected transaction limit");
_Static_assert(PJSIP_MAX_DIALOG_COUNT == 15, "unexpected dialog limit");
_Static_assert(PJSIP_MAX_TRANSPORTS == 16, "unexpected transport limit");
_Static_assert(PJSIP_TPMGR_HTABLE_SIZE == 15, "unexpected transport hash size");
_Static_assert(PJSIP_MAX_MODULE == 16, "unexpected module limit");
_Static_assert(PJSIP_MAX_PKT_LEN == 4000, "unexpected packet limit");
_Static_assert(PJSIP_MAX_TIMER_COUNT == 128, "unexpected timer capacity");
_Static_assert(PJSIP_MAX_NET_EVENTS == 1, "unexpected network event limit");
_Static_assert(PJSIP_MAX_TIMED_OUT_ENTRIES == 10, "unexpected timer poll limit");
_Static_assert(PJSIP_MAX_TRANSPORTS <= PJ_IOQUEUE_MAX_HANDLES,
	       "PJSIP transport count exceeds the PJLIB ioqueue capacity");

_Static_assert(PJSIP_POOL_LEN_ENDPT == 16000, "unexpected endpoint pool size");
_Static_assert(PJSIP_POOL_INC_ENDPT == 4000, "unexpected endpoint pool increment");
_Static_assert(PJSIP_POOL_RDATA_LEN == 4000, "unexpected receive pool size");
_Static_assert(PJSIP_POOL_RDATA_INC == 4000, "unexpected receive pool increment");
_Static_assert(PJSIP_POOL_LEN_TRANSPORT == 512, "unexpected transport pool size");
_Static_assert(PJSIP_POOL_INC_TRANSPORT == 512, "unexpected transport pool increment");
_Static_assert(PJSIP_POOL_LEN_TDATA == 4000, "unexpected transmit pool size");
_Static_assert(PJSIP_POOL_INC_TDATA == 4000, "unexpected transmit pool increment");
_Static_assert(PJSIP_POOL_LEN_UA == 512, "unexpected core UA pool size");
_Static_assert(PJSIP_POOL_INC_UA == 512, "unexpected core UA pool increment");
_Static_assert(PJSIP_POOL_TSX_LAYER_LEN == 512, "unexpected transaction-layer pool size");
_Static_assert(PJSIP_POOL_TSX_LAYER_INC == 512,
	       "unexpected transaction-layer pool increment");
_Static_assert(PJSIP_POOL_TSX_LEN == 1536, "unexpected transaction pool size");
_Static_assert(PJSIP_POOL_TSX_INC == 256, "unexpected transaction pool increment");
_Static_assert(PJSIP_POOL_LEN_USER_AGENT == 1024, "unexpected user-agent pool size");
_Static_assert(PJSIP_POOL_INC_USER_AGENT == 1024,
	       "unexpected user-agent pool increment");
_Static_assert(PJSIP_POOL_LEN_DIALOG == 4000, "unexpected dialog pool size");
_Static_assert(PJSIP_POOL_INC_DIALOG == 4000, "unexpected dialog pool increment");

int phase4_core_run(void)
{
	const pjsip_cfg_t *cfg = pjsip_cfg();

	/* pjsip_cfg() links the core configuration object without initializing an
	 * endpoint. Endpoint lifecycle validation starts in Phase 5.
	 */
	if (cfg->tsx.max_count != PJSIP_MAX_TSX_COUNT) {
		printk("Phase 4 FAIL: transaction limit mismatch\n");
		return 1;
	}

	printk("Phase 4 PASS: PJSIP core linked (tsx=%u dialogs=%u transports=%u pkt=%u)\n",
	       cfg->tsx.max_count, (unsigned int)PJSIP_MAX_DIALOG_COUNT,
	       (unsigned int)PJSIP_MAX_TRANSPORTS, (unsigned int)PJSIP_MAX_PKT_LEN);
	return 0;
}
```

## src/phase5_core.c
```c
#include <pjsip.h>
#include <pjlib-util.h>

#include <string.h>

#include <zephyr/sys/printk.h>

#define PHASE5_LIFECYCLES 3

static int fail_status(const char *test, int line, pj_status_t status)
{
	char text[PJ_ERR_MSG_SIZE];

	pj_strerror(status, text, sizeof(text));
	printk("[Phase 5] FAIL %s:%d status=%d (%s)\n",
	       test, line, status, text);
	return -1;
}

static int fail_value(const char *test, int line, const char *condition)
{
	printk("[Phase 5] FAIL %s:%d condition=%s\n", test, line, condition);
	return -1;
}

#define CHECK_STATUS(test_name, expression)                                  \
	do {                                                                     \
		pj_status_t check_status_ = (expression);                           \
		if (check_status_ != PJ_SUCCESS)                                    \
			return fail_status((test_name), __LINE__, check_status_);      \
	} while (0)

#define CHECK_TRUE(test_name, condition)                                     \
	do {                                                                     \
		if (!(condition))                                                  \
			return fail_value((test_name), __LINE__, #condition);         \
	} while (0)

static char *pool_copy_text(pj_pool_t *pool, const char *text)
{
	pj_size_t length = strlen(text);
	char *copy = pj_pool_alloc(pool, length + 1);

	pj_memcpy(copy, text, length + 1);
	return copy;
}

static pj_bool_t string_equals(const pj_str_t *value, const char *expected)
{
	pj_size_t length = strlen(expected);

	return value->slen == (pj_ssize_t)length &&
	       pj_memcmp(value->ptr, expected, length) == 0;
}

static pj_bool_t string_starts_with(const pj_str_t *value, const char *prefix)
{
	pj_size_t length = strlen(prefix);

	return value->slen >= (pj_ssize_t)length &&
	       pj_memcmp(value->ptr, prefix, length) == 0;
}

static int test_uri_parser(pj_pool_t *pool)
{
	const char *test = "URI parser";
	static const struct {
		const char *text;
		pj_bool_t secure;
	} valid[] = {
		{"sip:alice@example.com", PJ_FALSE},
		{"sips:alice:secret@example.com:5061;transport=tcp;lr", PJ_TRUE},
		{"\"Alice Smith\" <sip:alice%20smith@example.com;user=phone>", PJ_FALSE},
		{"sip:service@example.com;transport=udp;lr;maddr=127.0.0.1"
		 "?Subject=Hello%20There", PJ_FALSE},
	};
	static const char *const malformed[] = {
		"sip:",
		"sip :alice@example.com",
		"sip:alice@",
		"sip:alice@example.com:bad",
		" \"Rogue User\\\" <sip:localhost>",
		"",
	};
	unsigned i;

	for (i = 0; i < PJ_ARRAY_SIZE(valid); ++i) {
		pjsip_uri *uri;
		pjsip_uri *reparsed;
		void *base_uri;
		char *input = pool_copy_text(pool, valid[i].text);
		char *printed = pj_pool_alloc(pool, PJSIP_MAX_URL_SIZE + 1);
		int printed_length;

		uri = pjsip_parse_uri(pool, input, strlen(input), 0);
		CHECK_TRUE(test, uri != NULL);
		base_uri = pjsip_uri_get_uri(uri);
		CHECK_TRUE(test, valid[i].secure ? PJSIP_URI_SCHEME_IS_SIPS(base_uri) :
					       PJSIP_URI_SCHEME_IS_SIP(base_uri));

		printed_length = pjsip_uri_print(PJSIP_URI_IN_OTHER, uri, printed,
					 PJSIP_MAX_URL_SIZE);
		CHECK_TRUE(test, printed_length > 0 &&
				 printed_length <= PJSIP_MAX_URL_SIZE);
		printed[printed_length] = '\0';
		reparsed = pjsip_parse_uri(pool, printed, printed_length, 0);
		CHECK_TRUE(test, reparsed != NULL);
		CHECK_TRUE(test, pjsip_uri_cmp(PJSIP_URI_IN_OTHER, uri, reparsed) ==
				 PJ_SUCCESS);
	}

	for (i = 0; i < PJ_ARRAY_SIZE(malformed); ++i) {
		char *input = pool_copy_text(pool, malformed[i]);

		CHECK_TRUE(test, pjsip_parse_uri(pool, input, strlen(input), 0) == NULL);
	}

	printk("[Phase 5] SIP/SIPS URI parse/round-trip/rejection: PASSED\n");
	return 0;
}

static int compare_message_semantics(const pjsip_msg *first,
				     const pjsip_msg *second)
{
	const char *test = "message semantic round-trip";
	pjsip_from_hdr *first_from;
	pjsip_from_hdr *second_from;
	pjsip_to_hdr *first_to;
	pjsip_to_hdr *second_to;
	pjsip_cid_hdr *first_cid;
	pjsip_cid_hdr *second_cid;
	pjsip_cseq_hdr *first_cseq;
	pjsip_cseq_hdr *second_cseq;

	CHECK_TRUE(test, first->type == second->type);
	if (first->type == PJSIP_REQUEST_MSG) {
		CHECK_TRUE(test, pjsip_method_cmp(&first->line.req.method,
						 &second->line.req.method) == 0);
		CHECK_TRUE(test, pjsip_uri_cmp(PJSIP_URI_IN_REQ_URI,
						 first->line.req.uri,
						 second->line.req.uri) == PJ_SUCCESS);
	} else {
		CHECK_TRUE(test, first->line.status.code == second->line.status.code);
		CHECK_TRUE(test, pj_strcmp(&first->line.status.reason,
					   &second->line.status.reason) == 0);
	}

	first_from = (pjsip_from_hdr *)pjsip_msg_find_hdr(first, PJSIP_H_FROM, NULL);
	second_from = (pjsip_from_hdr *)pjsip_msg_find_hdr(second, PJSIP_H_FROM, NULL);
	first_to = (pjsip_to_hdr *)pjsip_msg_find_hdr(first, PJSIP_H_TO, NULL);
	second_to = (pjsip_to_hdr *)pjsip_msg_find_hdr(second, PJSIP_H_TO, NULL);
	first_cid = (pjsip_cid_hdr *)pjsip_msg_find_hdr(first, PJSIP_H_CALL_ID, NULL);
	second_cid = (pjsip_cid_hdr *)pjsip_msg_find_hdr(second, PJSIP_H_CALL_ID, NULL);
	first_cseq = (pjsip_cseq_hdr *)pjsip_msg_find_hdr(first, PJSIP_H_CSEQ, NULL);
	second_cseq = (pjsip_cseq_hdr *)pjsip_msg_find_hdr(second, PJSIP_H_CSEQ, NULL);
	CHECK_TRUE(test, first_from && second_from && first_to && second_to &&
			 first_cid && second_cid && first_cseq && second_cseq);
	CHECK_TRUE(test, pjsip_uri_cmp(PJSIP_URI_IN_FROMTO_HDR, first_from->uri,
				 second_from->uri) == PJ_SUCCESS);
	CHECK_TRUE(test, pjsip_uri_cmp(PJSIP_URI_IN_FROMTO_HDR, first_to->uri,
				 second_to->uri) == PJ_SUCCESS);
	CHECK_TRUE(test, pj_strcmp(&first_from->tag, &second_from->tag) == 0);
	CHECK_TRUE(test, pj_strcmp(&first_to->tag, &second_to->tag) == 0);
	CHECK_TRUE(test, pj_strcmp(&first_cid->id, &second_cid->id) == 0);
	CHECK_TRUE(test, first_cseq->cseq == second_cseq->cseq);
	CHECK_TRUE(test, pjsip_method_cmp(&first_cseq->method,
					 &second_cseq->method) == 0);
	CHECK_TRUE(test, (first->body == NULL) == (second->body == NULL));
	if (first->body) {
		CHECK_TRUE(test, first->body->len == second->body->len);
		CHECK_TRUE(test, pj_memcmp(first->body->data, second->body->data,
					    first->body->len) == 0);
	}
	return 0;
}

static int parse_print_reparse(pj_pool_t *pool, const char *wire,
			       pjsip_msg_type_e expected_type, int expected_code)
{
	const char *test = "message parse/print/reparse";
	pjsip_parser_err_report errors;
	pjsip_parser_err_report reparse_errors;
	pjsip_msg *message;
	pjsip_msg *reparsed;
	char *input = pool_copy_text(pool, wire);
	char *printed = pj_pool_alloc(pool, PJSIP_MAX_PKT_LEN + 1);
	pj_ssize_t printed_length;

	pj_list_init(&errors);
	message = pjsip_parse_msg(pool, input, strlen(input), &errors);
	CHECK_TRUE(test, message != NULL && pj_list_empty(&errors));
	CHECK_TRUE(test, message->type == expected_type);
	if (expected_type == PJSIP_REQUEST_MSG) {
		pjsip_sip_uri *uri;

		CHECK_TRUE(test, message->line.req.method.id == PJSIP_OPTIONS_METHOD);
		uri = (pjsip_sip_uri *)pjsip_uri_get_uri(message->line.req.uri);
		CHECK_TRUE(test, string_equals(&uri->user, "alice smith"));
		CHECK_TRUE(test, message->body && message->body->len == 11);
	} else {
		CHECK_TRUE(test, message->line.status.code == expected_code);
	}

	printed_length = pjsip_msg_print(message, printed, PJSIP_MAX_PKT_LEN);
	CHECK_TRUE(test, printed_length > 0 && printed_length <= PJSIP_MAX_PKT_LEN);
	printed[printed_length] = '\0';
	pj_list_init(&reparse_errors);
	reparsed = pjsip_parse_msg(pool, printed, printed_length, &reparse_errors);
	CHECK_TRUE(test, reparsed != NULL && pj_list_empty(&reparse_errors));
	return compare_message_semantics(message, reparsed);
}

static int test_messages(pj_pool_t *pool)
{
	const char *test = "malformed message rejection";
	static const char request[] =
		"OPTIONS sip:alice%20smith@example.com;transport=udp SIP/2.0\r\n"
		"Via: SIP/2.0/UDP client.example.com;branch=z9hG4bK-phase5\r\n"
		"From: \"Alice Smith\" <sip:alice@example.net>;tag=from-phase5\r\n"
		"To: <sips:service@example.com>\r\n"
		"Call-ID: phase5-request@example.net\r\n"
		"CSeq: 42 OPTIONS\r\n"
		"Contact: <sip:alice@client.example.com>\r\n"
		"Max-Forwards: 70\r\n"
		"Content-Type: text/plain\r\n"
		"Content-Length: 11\r\n\r\n"
		"hello=world";
	static const char response[] =
		"SIP/2.0 486 Busy Here\r\n"
		"Via: SIP/2.0/UDP client.example.com;branch=z9hG4bK-phase5\r\n"
		"From: \"Alice Smith\" <sip:alice@example.net>;tag=from-phase5\r\n"
		"To: <sips:service@example.com>;tag=to-phase5\r\n"
		"Call-ID: phase5-request@example.net\r\n"
		"CSeq: 42 OPTIONS\r\n"
		"Content-Length: 0\r\n\r\n";
	static const char *const malformed[] = {
		"BROKEN\r\n\r\n",
		"INVITE sip:alice@example.com SIP/3.0\r\nContent-Length: 0\r\n\r\n",
		"SIP/2.0 XX Busy\r\nContent-Length: 0\r\n\r\n",
	};
	static const char partial[] =
		"MESSAGE sip:bob@example.com SIP/2.0\r\nContent-Length: 5\r\n\r\nabc";
	unsigned i;
	pj_size_t message_size = 0;

	if (parse_print_reparse(pool, request, PJSIP_REQUEST_MSG, 0) != 0 ||
	    parse_print_reparse(pool, response, PJSIP_RESPONSE_MSG, 486) != 0)
		return -1;

	for (i = 0; i < PJ_ARRAY_SIZE(malformed); ++i) {
		pjsip_parser_err_report errors;
		char *input = pool_copy_text(pool, malformed[i]);
		pjsip_msg *message;

		pj_list_init(&errors);
		message = pjsip_parse_msg(pool, input, strlen(input), &errors);
		CHECK_TRUE(test, message == NULL || !pj_list_empty(&errors));
	}
	CHECK_TRUE(test, pjsip_find_msg(partial, strlen(partial), PJ_FALSE,
					 &message_size) == PJSIP_EPARTIALMSG);
	CHECK_TRUE(test, message_size > strlen(partial));

	printk("[Phase 5] request/response parse, semantic round-trip, rejection: PASSED\n");
	return 0;
}

static pj_bool_t body_equals(const pjsip_msg_body *body, const char *expected)
{
	pj_size_t length = strlen(expected);

	return body && body->len == length &&
	       pj_memcmp(body->data, expected, length) == 0;
}

static int validate_multipart(const pjsip_msg_body *body)
{
	const char *test = "multipart validation";
	pjsip_multipart_part *first;
	pjsip_multipart_part *second;

	first = pjsip_multipart_get_first_part(body);
	CHECK_TRUE(test, first && body_equals(first->body, "alpha"));
	second = pjsip_multipart_get_next_part(body, first);
	CHECK_TRUE(test, second && body_equals(second->body, "{\"a\":1}"));
	CHECK_TRUE(test, pjsip_multipart_get_next_part(body, second) == NULL);
	return 0;
}

static int test_multipart(pj_pool_t *pool)
{
	const char *test = "multipart parse/print";
	static const char wire[] =
		"Multipart prologue\r\n"
		"--phase5-boundary\r\n"
		"Content-Type: text/plain\r\n\r\n"
		"alpha\r\n"
		"--phase5-boundary\r\n"
		"Content-Type: application/json\r\n"
		"Content-Length: 7\r\n\r\n"
		"{\"a\":1}\r\n"
		"--phase5-boundary--\r\n"
		"Multipart epilogue";
	pjsip_media_type content_type;
	pjsip_param boundary;
	pjsip_msg_body *body;
	pjsip_msg_body *reparsed;
	pj_str_t raw_boundary;
	pj_str_t raw_data;
	char *input = pool_copy_text(pool, wire);
	char *printed = pj_pool_alloc(pool, PJSIP_MAX_PKT_LEN + 1);
	int printed_length;

	pjsip_media_type_init2(&content_type, "multipart", "mixed");
	pj_list_init(&boundary);
	boundary.name = pj_str("boundary");
	boundary.value = pj_str("phase5-boundary");
	pj_list_push_back(&content_type.param, &boundary);

	body = pjsip_multipart_parse(pool, input, strlen(input), &content_type, 0);
	CHECK_TRUE(test, body != NULL);
	if (validate_multipart(body) != 0)
		return -1;
	CHECK_STATUS(test, pjsip_multipart_get_raw(body, &raw_boundary, &raw_data));
	CHECK_TRUE(test, string_equals(&raw_boundary, "phase5-boundary"));
	CHECK_TRUE(test, raw_data.slen == (pj_ssize_t)strlen(wire));

	printed_length = body->print_body(body, printed, PJSIP_MAX_PKT_LEN);
	CHECK_TRUE(test, printed_length > 0 && printed_length <= PJSIP_MAX_PKT_LEN);
	printed[printed_length] = '\0';
	reparsed = pjsip_multipart_parse(pool, printed, printed_length,
					 &body->content_type, 0);
	CHECK_TRUE(test, reparsed != NULL);
	if (validate_multipart(reparsed) != 0)
		return -1;

	printk("[Phase 5] multipart parse/print/reparse: PASSED\n");
	return 0;
}

static unsigned module_load_count;
static unsigned module_start_count;
static unsigned module_stop_count;
static unsigned module_unload_count;
static unsigned endpoint_exit_count;
static pjsip_endpoint *expected_module_endpoint;

static pj_status_t phase5_module_load(pjsip_endpoint *endpt)
{
	if (endpt != expected_module_endpoint)
		return PJ_EINVAL;
	++module_load_count;
	return PJ_SUCCESS;
}

static pj_status_t phase5_module_start(void)
{
	++module_start_count;
	return PJ_SUCCESS;
}

static pj_status_t phase5_module_stop(void)
{
	++module_stop_count;
	return PJ_SUCCESS;
}

static pj_status_t phase5_module_unload(void)
{
	++module_unload_count;
	return PJ_SUCCESS;
}

static void phase5_endpoint_exit(pjsip_endpoint *endpt)
{
	PJ_UNUSED_ARG(endpt);
	++endpoint_exit_count;
}

static int test_module_registration(pjsip_endpoint *endpt)
{
	const char *test = "module registration";
	pjsip_module module;
	pj_status_t status;

	module_load_count = 0;
	module_start_count = 0;
	module_stop_count = 0;
	module_unload_count = 0;
	expected_module_endpoint = endpt;
	pj_bzero(&module, sizeof(module));
	pj_list_init(&module);
	module.name = pj_str("phase5-validation");
	module.id = -1;
	module.priority = PJSIP_MOD_PRIORITY_APPLICATION;
	module.load = phase5_module_load;
	module.start = phase5_module_start;
	module.stop = phase5_module_stop;
	module.unload = phase5_module_unload;

	status = pjsip_endpt_register_module(endpt, &module);
	if (status != PJ_SUCCESS)
		return fail_status(test, __LINE__, status);
	if (module.id < 0 || module_load_count != 1 || module_start_count != 1) {
		fail_value(test, __LINE__,
			   "module loaded and started exactly once");
		pjsip_endpt_unregister_module(endpt, &module);
		expected_module_endpoint = NULL;
		return -1;
	}
	status = pjsip_endpt_unregister_module(endpt, &module);
	if (status != PJ_SUCCESS) {
		expected_module_endpoint = NULL;
		return fail_status(test, __LINE__, status);
	}
	CHECK_TRUE(test, module.id == -1 && module_stop_count == 1 &&
			 module_unload_count == 1);
	expected_module_endpoint = NULL;
	printk("[Phase 5] module load/start/stop/unload: PASSED\n");
	return 0;
}

static int test_error_strings(void)
{
	const char *test = "PJSIP error registration";
	char buffer[PJ_ERR_MSG_SIZE];
	pj_str_t result;

	result = pj_strerror(PJSIP_EINVALIDURI, buffer, sizeof(buffer));
	CHECK_TRUE(test, string_starts_with(&result, "Invalid URI"));
	result = pj_strerror(PJSIP_ERRNO_FROM_SIP_STATUS(486), buffer,
			    sizeof(buffer));
	CHECK_TRUE(test, string_starts_with(&result, "Busy Here"));
	printk("[Phase 5] PJSIP error/status strings: PASSED\n");
	return 0;
}

static int test_digest(void)
{
	const char *test = "Digest authentication";
	char response_buffer[PJSIP_MD5STRLEN + 1] = {0};
	pj_str_t response = {response_buffer, PJSIP_MD5STRLEN};
	pj_str_t nonce = pj_str("dcd98b7102dd2f0e8b11d0f600bfb0c093");
	pj_str_t nc = pj_str("00000001");
	pj_str_t cnonce = pj_str("0a4f113b");
	pj_str_t qop = pj_str("auth");
	pj_str_t uri = pj_str("/dir/index.html");
	pj_str_t realm = pj_str("testrealm@host.com");
	pj_str_t method = pj_str("GET");
	pjsip_cred_info credential;

	pj_bzero(&credential, sizeof(credential));
	credential.realm = realm;
	credential.scheme = pj_str("Digest");
	credential.username = pj_str("Mufasa");
	credential.data_type = PJSIP_CRED_DATA_PLAIN_PASSWD;
	credential.data = pj_str("Circle Of Life");
	CHECK_STATUS(test, pjsip_auth_create_digest2(&response, &nonce, &nc,
						    &cnonce, &qop, &uri,
						    &realm, &credential, &method,
						    PJSIP_AUTH_ALGORITHM_MD5));
	response_buffer[response.slen] = '\0';
	CHECK_TRUE(test, string_equals(&response,
				       "6629fae49393a05397450978507c4ef1"));
	printk("[Phase 5] RFC Digest MD5 vector: PASSED\n");
	return 0;
}

static pj_bool_t has_mandatory_headers(const pjsip_msg *message)
{
	return pjsip_msg_find_hdr(message, PJSIP_H_VIA, NULL) != NULL &&
	       pjsip_msg_find_hdr(message, PJSIP_H_FROM, NULL) != NULL &&
	       pjsip_msg_find_hdr(message, PJSIP_H_TO, NULL) != NULL &&
	       pjsip_msg_find_hdr(message, PJSIP_H_CALL_ID, NULL) != NULL &&
	       pjsip_msg_find_hdr(message, PJSIP_H_CSEQ, NULL) != NULL;
}

static int release_tdata(const char *test, pjsip_tx_data **tdata)
{
	pj_status_t status;

	if (*tdata == NULL)
		return 0;
	status = pjsip_tx_data_dec_ref(*tdata);
	*tdata = NULL;
	if (status != PJSIP_EBUFDESTROYED)
		return fail_status(test, __LINE__, status);
	return 0;
}

static int test_transmit_data(pjsip_endpoint *endpt)
{
	const char *test = "request/response/ACK/CANCEL transmit data";
	pj_str_t target = pj_str("sip:bob@example.com");
	pj_str_t from = pj_str("\"Alice\" <sip:alice@example.net>");
	pj_str_t to = pj_str("Bob <sip:bob@example.com>");
	pj_str_t contact = pj_str("<sip:alice@client.example.net>");
	pj_str_t call_id = pj_str("phase5-txdata@example.net");
	pj_str_t body = pj_str("hello");
	pjsip_tx_data *invite = NULL;
	pjsip_tx_data *response = NULL;
	pjsip_tx_data *cancel = NULL;
	pjsip_tx_data *ack = NULL;
	pjsip_rx_data request_rdata;
	pjsip_rx_data response_rdata;
	pj_status_t status;
	int result = -1;

	status = pjsip_endpt_create_request(endpt, &pjsip_invite_method, &target,
					    &from, &to, &contact, &call_id,
					    42, &body, &invite);
	if (status != PJ_SUCCESS) {
		fail_status(test, __LINE__, status);
		goto cleanup;
	}
	if (invite->msg->type != PJSIP_REQUEST_MSG ||
	    invite->msg->line.req.method.id != PJSIP_INVITE_METHOD ||
	    !has_mandatory_headers(invite->msg) || invite->msg->body == NULL) {
		fail_value(test, __LINE__, "valid INVITE transmit data");
		goto cleanup;
	}

	pj_bzero(&request_rdata, sizeof(request_rdata));
	request_rdata.msg_info.msg = invite->msg;
	request_rdata.msg_info.via = (pjsip_via_hdr *)pjsip_msg_find_hdr(
		invite->msg, PJSIP_H_VIA, NULL);
	request_rdata.msg_info.from = (pjsip_from_hdr *)pjsip_msg_find_hdr(
		invite->msg, PJSIP_H_FROM, NULL);
	request_rdata.msg_info.to = (pjsip_to_hdr *)pjsip_msg_find_hdr(
		invite->msg, PJSIP_H_TO, NULL);
	request_rdata.msg_info.cid = (pjsip_cid_hdr *)pjsip_msg_find_hdr(
		invite->msg, PJSIP_H_CALL_ID, NULL);
	request_rdata.msg_info.cseq = (pjsip_cseq_hdr *)pjsip_msg_find_hdr(
		invite->msg, PJSIP_H_CSEQ, NULL);

	status = pjsip_endpt_create_response(endpt, &request_rdata, 486, NULL,
					     &response);
	if (status != PJ_SUCCESS) {
		fail_status(test, __LINE__, status);
		goto cleanup;
	}
	if (response->msg->type != PJSIP_RESPONSE_MSG ||
	    response->msg->line.status.code != 486 ||
	    !has_mandatory_headers(response->msg)) {
		fail_value(test, __LINE__, "valid response transmit data");
		goto cleanup;
	}

	status = pjsip_endpt_create_cancel(endpt, invite, &cancel);
	if (status != PJ_SUCCESS) {
		fail_status(test, __LINE__, status);
		goto cleanup;
	}
	if (cancel->msg->type != PJSIP_REQUEST_MSG ||
	    cancel->msg->line.req.method.id != PJSIP_CANCEL_METHOD ||
	    !has_mandatory_headers(cancel->msg)) {
		fail_value(test, __LINE__, "valid CANCEL transmit data");
		goto cleanup;
	}

	pj_bzero(&response_rdata, sizeof(response_rdata));
	response_rdata.msg_info.msg = response->msg;
	response_rdata.msg_info.to = (pjsip_to_hdr *)pjsip_msg_find_hdr(
		response->msg, PJSIP_H_TO, NULL);
	status = pjsip_endpt_create_ack(endpt, invite, &response_rdata, &ack);
	if (status != PJ_SUCCESS) {
		fail_status(test, __LINE__, status);
		goto cleanup;
	}
	if (ack->msg->type != PJSIP_REQUEST_MSG ||
	    ack->msg->line.req.method.id != PJSIP_ACK_METHOD ||
	    !has_mandatory_headers(ack->msg) || ack->msg->body != NULL) {
		fail_value(test, __LINE__, "valid ACK transmit data");
		goto cleanup;
	}

	result = 0;

cleanup:
	if (release_tdata(test, &ack) != 0)
		result = -1;
	if (release_tdata(test, &cancel) != 0)
		result = -1;
	if (release_tdata(test, &response) != 0)
		result = -1;
	if (release_tdata(test, &invite) != 0)
		result = -1;
	if (result == 0)
		printk("[Phase 5] request/response/ACK/CANCEL transmit data: PASSED\n");
	return result;
}

static int run_lifecycle(int iteration)
{
	pj_caching_pool caching_pool;
	pjsip_endpoint *endpoint = NULL;
	pj_pool_t *test_pool = NULL;
	pj_status_t status;
	int result = -1;

	status = pj_init();
	if (status != PJ_SUCCESS)
		return fail_status("pj_init", __LINE__, status);
	pj_log_set_level(3);
	status = pjlib_util_init();
	if (status != PJ_SUCCESS) {
		fail_status("pjlib_util_init", __LINE__, status);
		goto shutdown;
	}

	pj_caching_pool_init(&caching_pool, NULL, 0);
	status = pjsip_endpt_create(&caching_pool.factory, "phase5", &endpoint);
	if (status != PJ_SUCCESS) {
		fail_status("pjsip_endpt_create", __LINE__, status);
		goto destroy_factory;
	}
	endpoint_exit_count = 0;
	if (!string_equals(pjsip_endpt_name(endpoint), "phase5") ||
	    pjsip_endpt_get_timer_heap(endpoint) == NULL ||
	    pjsip_endpt_get_ioqueue(endpoint) == NULL ||
	    pjsip_endpt_get_tpmgr(endpoint) == NULL ||
	    pj_timer_heap_count(pjsip_endpt_get_timer_heap(endpoint)) != 0) {
		fail_value("endpoint resources", __LINE__, "endpoint resources initialized");
		goto destroy_endpoint;
	}
	status = pjsip_endpt_atexit(endpoint, phase5_endpoint_exit);
	if (status != PJ_SUCCESS) {
		fail_status("endpoint exit callback", __LINE__, status);
		goto destroy_endpoint;
	}

	test_pool = pjsip_endpt_create_pool(endpoint, "phase5-test", 32768, 32768);
	if (test_pool == NULL) {
		fail_value("test pool", __LINE__, "test_pool != NULL");
		goto destroy_endpoint;
	}

	if (test_error_strings() != 0 ||
	    test_module_registration(endpoint) != 0 ||
	    test_uri_parser(test_pool) != 0 ||
	    test_messages(test_pool) != 0 ||
	    test_multipart(test_pool) != 0 ||
	    test_digest() != 0 ||
	    test_transmit_data(endpoint) != 0)
		goto release_test_pool;
	if (pj_timer_heap_count(pjsip_endpt_get_timer_heap(endpoint)) != 0) {
		fail_value("endpoint timers", __LINE__, "timer heap empty before teardown");
		goto release_test_pool;
	}
	result = 0;

release_test_pool:
	pj_pool_release(test_pool);
	test_pool = NULL;
destroy_endpoint:
	pjsip_endpt_destroy(endpoint);
	endpoint = NULL;
	if (endpoint_exit_count != 1) {
		fail_value("endpoint exit callback", __LINE__, "endpoint_exit_count == 1");
		result = -1;
	}
	if (caching_pool.used_count != 0 || caching_pool.capacity != 0) {
		fail_value("endpoint pool cleanup", __LINE__,
			   "used_count == 0 && capacity == 0");
		result = -1;
	}
	if (result == 0)
		printk("[Phase 5] lifecycle %d endpoint teardown: PASSED\n", iteration);
destroy_factory:
	pj_caching_pool_destroy(&caching_pool);
shutdown:
	pj_shutdown();
	printk("[Phase 5] lifecycle %d shutdown complete\n", iteration);
	return result;
}

int phase5_core_run(void)
{
	int iteration;

	printk("[Phase 5] parser/message/endpoint validation (%d lifecycles)\n",
	       PHASE5_LIFECYCLES);
	for (iteration = 1; iteration <= PHASE5_LIFECYCLES; ++iteration) {
		if (run_lifecycle(iteration) != 0) {
			printk("PHASE 5 RESULT: FAILED at lifecycle %d\n", iteration);
			return 1;
		}
	}

	printk("PHASE 5 RESULT: PASSED (%d/%d lifecycles)\n",
	       PHASE5_LIFECYCLES, PHASE5_LIFECYCLES);
	return 0;
}
```
