## pjproject/Kconfig
```kconfig
menuconfig PJPROJECT
	bool "PJPROJECT"
	help
	  Enable PJPROJECT components for Zephyr applications.

if PJPROJECT

# Default PJPROJECT profile: SIP call control with SDP negotiation and the
# G.711/RTP media path. Applications can explicitly disable individual gates
# when validating a smaller boundary or building a reduced product image.

config PJLIB
	bool "PJLIB"
	default y if PJPROJECT
	help
	  Enable the PJLIB base library. It is enabled automatically when
	  PJPROJECT is selected, but remains visible for boundary-only tests.

config PJLIB_UTIL
	bool "PJLIB-UTIL"
	default y if PJPROJECT
	depends on PJLIB
	help
	  Enable the PJLIB-UTIL facilities selected for Zephyr. The source list is
	  intentionally explicit and grows only when a consumer requires another
	  facility.

config PJLIB_UTIL_DNS_RESOLVER
	bool "PJLIB-UTIL asynchronous DNS and SRV resolver"
	depends on PJLIB_UTIL && NET_SOCKETS && NET_IPV4 && NET_UDP
	help
	  Compile the PJLIB-UTIL DNS packet, asynchronous resolver, and SRV
	  resolver sources. IPv6 and DNS NAPTR remain outside this feature.

menuconfig PJMEDIA
	bool "PJMEDIA"
	default y if PJSIP
	depends on PJLIB_UTIL
	help
	  Enable the PJMEDIA configuration and public-header boundary. The standard
	  PJPROJECT profile enables this automatically for PJSIP call control.

if PJMEDIA

config PJMEDIA_SDP
	bool "PJMEDIA SDP representation and parser"
	default y if PJMEDIA
	help
	  Select the SDP representation, parser, printer, and comparison boundary.
	  The Zephyr profile also rejects malformed line endings, oversized input,
	  and data beyond its configured SDP array limits.

config PJMEDIA_SDP_NEG
	bool "PJMEDIA SDP offer/answer negotiation"
	default y if PJMEDIA
	depends on PJMEDIA_SDP
	help
	  Select SDP negotiation and its audited codec/stream helper closure. This
	  does not select a media endpoint, codec implementation, RTP/RTCP,
	  transport, stream runtime, or audio device.

config PJMEDIA_ENDPOINT
	bool "PJMEDIA endpoint and codec manager"
	default y if PJMEDIA
	depends on PJMEDIA_SDP
	help
	  Select the PJMEDIA endpoint/runtime primitives. The initial runtime will
	  share the existing PJSIP ioqueue and create no PJMEDIA worker threads.

config PJMEDIA_G711
	bool "PJMEDIA G.711 PCMU/PCMA codec"
	default y if PJMEDIA_ENDPOINT
	depends on PJMEDIA_ENDPOINT
	help
	  Select only the built-in PCMU/PCMA codec family. Other codec families
	  remain disabled by the Zephyr profile.

config PJMEDIA_RTP_RTCP
	bool "PJMEDIA RTP, RTCP, and jitter buffer primitives"
	default y if PJMEDIA_ENDPOINT
	depends on PJMEDIA_ENDPOINT
	help
	  Select the socket-free RTP/RTCP packet, feedback, session, and adaptive
	  jitter-buffer primitives. This does not select a media transport, stream,
	  SRTP, ICE, or audio device.

config PJMEDIA_LOOP_TRANSPORT
	bool "PJMEDIA loop transport"
	default y if PJMEDIA_RTP_RTCP
	depends on PJMEDIA_RTP_RTCP
	help
	  Select the socket-free PJMEDIA loop transport used to validate media
	  transport attachment, callbacks, ownership, and teardown independently
	  of network sockets or an audio stream.

config PJMEDIA_UDP_TRANSPORT
	bool "PJMEDIA IPv4 UDP transport"
	default y if PJMEDIA_LOOP_TRANSPORT && NET_SOCKETS && NET_IPV4 && NET_UDP
	depends on PJMEDIA_LOOP_TRANSPORT
	depends on NET_SOCKETS && NET_IPV4 && NET_UDP
	help
	  Select plain IPv4 UDP RTP/RTCP transport. SRTP and ICE are separate,
	  deferred features and are not selected by this option.

config PJMEDIA_STREAM
	bool "PJMEDIA G.711 audio stream"
	default y if PJMEDIA_ENDPOINT && PJMEDIA_G711 && PJMEDIA_RTP_RTCP && PJMEDIA_UDP_TRANSPORT
	depends on PJMEDIA_ENDPOINT && PJMEDIA_G711
	depends on PJMEDIA_RTP_RTCP && PJMEDIA_UDP_TRANSPORT
	help
	  Select one G.711 audio stream over the validated RTP/RTCP UDP boundary.

config PJMEDIA_SRTP
	bool "PJMEDIA bundled SRTP primitives"
	depends on PJMEDIA_RTP_RTCP
	help
	  Compile the bundled libsrtp AES-CM/HMAC-SHA1 closure. This gate alone
	  provides crypto primitives; transport wrapping and SDP keying remain
	  separate integration phases.

config PJMEDIA_SRTP_TRANSPORT
	bool "PJMEDIA SRTP media transport"
	depends on PJMEDIA_SRTP && PJMEDIA_ENDPOINT && PJMEDIA_UDP_TRANSPORT
	help
	  Build PJMEDIA's SRTP adapter transport over the bundled libsrtp packet
	  engine. This gate provides explicit-key transport operation; SDP key
	  negotiation remains a separate security increment.

config PJMEDIA_SRTP_SDES
	bool "PJMEDIA SRTP SDES negotiation"
	depends on PJMEDIA_SRTP_TRANSPORT && PJMEDIA_SDP
	help
	  Enable RFC 4568 SDP security descriptions for the single supported
	  AES_CM_128_HMAC_SHA1_80 suite. SDES exposes keys to signaling and must
	  not be used in production without authenticated SIP TLS.

config PJMEDIA_AUDIODEV
	bool "PJMEDIA audio-device core"
	depends on PJMEDIA_ENDPOINT
	help
	  Select the audio-device abstraction without selecting any backend.

config PJMEDIA_AUDIODEV_NULL
	bool "PJMEDIA null audio device"
	depends on PJMEDIA_AUDIODEV
	help
	  Select the null audio backend for lifecycle validation only. It does not
	  generate capture/playback timing and cannot validate media flow.

config PJMEDIA_AUDIODEV_ZEPHYR
	bool "PJMEDIA Zephyr audio device"
	depends on PJMEDIA_AUDIODEV && AUDIO
	help
	  Select the future Zephyr audio backend. Board, device-tree, codec, clock,
	  and DMA choices remain application/product configuration.

endif # PJMEDIA

config PJSIP
	bool "PJSIP core"
	default y if PJPROJECT
	depends on PJLIB_UTIL
	help
	  Enable the PJSIP signaling core. PJLIB-UTIL and PJLIB must be enabled
	  first. The socket-free loop transport is part of this base component.

config PJSIP_INVITE
	bool "PJSIP INVITE sessions"
	default y if PJSIP
	depends on PJMEDIA_SDP_NEG
	help
	  Select INVITE sessions, 100rel, and session timers after SDP negotiation
	  has a validated link closure. The standard PJSIP profile enables this by
	  default; phase-specific tests may explicitly disable it.

if PJSIP

menu "PJSIP resource limits"

config PJSIP_MAX_TSX_COUNT
	int "Maximum PJSIP transactions"
	range 1 255
	default 31
	help
	  Maximum entries in the transaction hash table. Values of the form
	  2^n-1 avoid upward rounding of the table size.

config PJSIP_MAX_DIALOG_COUNT
	int "Maximum PJSIP dialogs"
	range 1 127
	default 15
	help
	  Maximum entries in the dialog hash table. Values of the form 2^n-1
	  avoid upward rounding of the table size.

config PJSIP_MAX_TRANSPORTS
	int "Maximum PJSIP transports"
	range 1 32
	default 16
	help
	  Maximum transports tracked by PJSIP. The upper bound matches the
	  PJLIB Zephyr ioqueue limit.

config PJSIP_TPMGR_HTABLE_SIZE
	int "PJSIP transport hash table size"
	range 1 255
	default 15
	help
	  Transport manager hash table size. Use a value of the form 2^n-1.

config PJSIP_MAX_MODULE
	int "Maximum PJSIP modules"
	range 1 64
	default 16
	help
	  Maximum modules that may attach per-module data to PJSIP objects.

config PJSIP_MAX_PKT_LEN
	int "Maximum SIP packet length"
	range 512 65535
	default 4000
	help
	  Maximum encoded or received SIP message size in bytes.

config PJSIP_MAX_TIMER_COUNT
	int "Initial PJSIP timer capacity"
	range 16 4096
	default 128
	help
	  Number of timer entries initially allocated by the endpoint timer heap.

config PJSIP_MAX_NET_EVENTS
	int "PJSIP events per ioqueue poll"
	range 1 32
	default 1
	help
	  Maximum ioqueue event batches handled by one endpoint poll. One is the
	  recommended starting value for the select ioqueue backend.

config PJSIP_MAX_TIMED_OUT_ENTRIES
	int "PJSIP timers processed per poll"
	range 1 128
	default 10
	help
	  Maximum expired timer entries handled by one endpoint event poll.

endmenu

config PJSIP_REGC
	bool "PJSIP registration client"
	help
	  Compile the independently selectable SIP registration client. This adds
	  pjsip-ua/sip_reg.c only; PJMEDIA, INVITE sessions, PJSUA-LIB, and the
	  remaining PJSIP-UA sources stay disabled.

endif # PJSIP

config PJSIP_UDP_TRANSPORT
	bool "PJSIP UDP transport"
	default y if PJSIP && NET_SOCKETS && NET_IPV4 && NET_UDP
	depends on NET_SOCKETS && NET_IPV4 && NET_UDP
	help
	  Compile the IPv4 UDP SIP transport. Runtime validation belongs to a
	  later porting phase.

config PJSIP_TCP_TRANSPORT
	bool "PJSIP TCP transport"
	depends on NET_SOCKETS && NET_IPV4 && NET_TCP
	help
	  Compile the IPv4 TCP SIP transport. Runtime validation belongs to a
	  later porting phase.

endif # PJPROJECT
```

## voip/zephyr/Kconfig
```kconfig
menuconfig VOIP_FACADE
	bool "PJPROJECT VoIP C++ facade"
	depends on CPP
	default n
	help
	  Build the application-facing VoIP contract. The Phase 1 backend is a
	  deterministic fake and does not initialize or link PJPROJECT.

if VOIP_FACADE

config VOIP_SDK
	bool "Production VoIP SDK service"
	depends on CPP
	default n
	help
	  Build the handle-based asynchronous VoIP service contract. The service
	  keeps PJPROJECT private and delivers copied events through an application
	  supplied Zephyr work queue. The legacy facade remains available for the
	  validation applications.

config VOIP_MAX_ACCOUNTS
	int "Maximum production SDK accounts"
	depends on VOIP_SDK
	range 1 4
	default 1
	help
	  Number of account slots reserved by the production service. Raising this
	  value requires a fresh PJ pool and memory qualification.

config VOIP_MAX_CALLS
	int "Maximum production SDK calls"
	depends on VOIP_SDK
	range 1 4
	default 1
	help
	  Number of call and RTP media slots reserved by the production service.

config VOIP_SDK_EVENT_CAPACITY
	int "Production SDK event capacity"
	depends on VOIP_SDK
	range 1 16
	default 8
	help
	  Maximum copied events retained while the application work queue is busy.

config VOIP_FAKE_BACKEND
	bool "VoIP facade fake backend"
	default n
	help
	  Build the bounded Phase 1 lifecycle backend used by facade tests.

config VOIP_PJ_BACKEND
	bool "VoIP PJPROJECT runtime backend"
	depends on PJPROJECT && PJLIB_UTIL && PJSIP && PJSIP_TCP_TRANSPORT
	depends on PJMEDIA_ENDPOINT
	default n
	help
	  Build the shared PJLIB/PJSIP/PJMEDIA runtime owner. Account, call, and
	  media-session behavior is introduced by later integration phases.

config VOIP_PJ_REGISTRATION_NETWORK
	bool "VoIP PJSIP network registration"
	depends on VOIP_PJ_BACKEND && PJSIP_REGC && PJSIP_TCP_TRANSPORT
	default n
	help
	  Enable REGISTER, Digest authentication, automatic refresh, unregister,
	  and bounded reconnect through the PJPROJECT registration client.

config VOIP_PJ_CALL_CONTROL
	bool "VoIP PJSIP one-call control"
	depends on VOIP_PJ_BACKEND && VOIP_PJ_REGISTRATION_NETWORK
	depends on PJSIP_INVITE && PJMEDIA_SDP_NEG
	default n
	help
	  Enable one PJSIP dialog/INVITE session over SIP TCP. Media negotiation is
	  limited to PCMU/PCMA SDP; RTP and audio remain disabled.

config VOIP_PJ_HEADLESS_MEDIA
	bool "VoIP PJMEDIA headless G.711 media"
	depends on VOIP_PJ_BACKEND && PJMEDIA_G711 && PJMEDIA_RTP_RTCP
	depends on PJMEDIA_UDP_TRANSPORT && PJMEDIA_STREAM
	default n
	help
	  Enable generated 8 kHz mono PCM, PCMU/PCMA RTP over UDP, jitter
	  buffering, and a bounded memory sink without an audio device.

config VOIP_PJ_SRTP_KEY_LIFECYCLE
	bool "VoIP per-call SRTP key lifecycle"
	depends on VOIP_PJ_HEADLESS_MEDIA && PJMEDIA_SRTP_SDES
	default n
	help
	  Generate two distinct 30-byte AES-CM master-key/salt values from the
	  Zephyr cryptographically secure random API for every prepared call and
	  explicitly erase them at call teardown. This gate establishes key
	  ownership only; SIP SDP and the facade media transport are not secured
	  until the subsequent SRTP call-path integration is enabled.

config VOIP_PJ_SRTP_MEDIA
	bool "VoIP PJMEDIA SRTP headless media"
	depends on VOIP_PJ_SRTP_KEY_LIFECYCLE && PJMEDIA_SRTP_TRANSPORT
	default n
	help
	  Wrap the facade-owned RTP/UDP transports with PJMEDIA's mandatory SRTP
	  adapter and install the per-call AES_CM_128_HMAC_SHA1_80 keys. This gate
	  secures the media packets but does not yet signal keys through SIP/SDES.

config VOIP_PJ_SRTP_SIGNALING
	bool "VoIP mandatory SRTP/SDES call signaling"
	depends on VOIP_PJ_SRTP_MEDIA && VOIP_PJ_CALL_CONTROL
	depends on PJMEDIA_SRTP_SDES
	default n
	help
	  Route PJSIP INVITE offer/answer through PJMEDIA's strict SDES hooks,
	  require RTP/SAVP, and bind the negotiated policies to the facade-owned
	  SRTP transports. SDES reveals keys to signaling, so production use also
	  requires authenticated SIP TLS.

endif

menuconfig VOIP_SERVICE
	bool "PJ-independent VoIP core service"
	depends on CPP
	depends on !VOIP_FACADE
	depends on !VOIP_PJ_BACKEND
	depends on !VOIP_FAKE_BACKEND
	default n

if VOIP_SERVICE

choice VOIP_SERVICE_ADAPTER
	prompt "VoIP service runtime adapter"
	default VOIP_SERVICE_FAKE_ADAPTER

config VOIP_SERVICE_FAKE_ADAPTER
	bool "Deterministic fake runtime adapter"
	depends on !VOIP_PJ_BACKEND
	depends on !VOIP_FAKE_BACKEND

config VOIP_PJSUA
	bool "PJSUA service adapter"
	depends on PJSUA && PJSIP_TCP_TRANSPORT
	help
	  Build the actor-owned PJSUA registration adapter. TCP is the only
	  signaling transport in this profile; TLS and SRTP remain unsupported.

endchoice

config VOIP_MAX_AGENTS
	int "VoIP service agent capacity"
	range 5 5
	default 5

config VOIP_MAX_LOGICAL_CALLS
	int "VoIP service logical call capacity"
	range 7 7
	default 7

config VOIP_MAX_PROMOTED_CALLS
	int "VoIP service promoted call capacity"
	range 2 2
	default 2

config VOIP_PENDING_CALL_CAPACITY
	int "VoIP service pending FIFO capacity"
	range 5 5
	default 5

config VOIP_COMMAND_CAPACITY
	int "VoIP service command capacity"
	range 16 16
	default 16

config VOIP_OPERATION_CAPACITY
	int "VoIP service operation capacity"
	range 16 16
	default 16

config VOIP_EVENT_CAPACITY
	int "VoIP service event capacity"
	range 32 32
	default 32

endif

config VOIP_SIP_TLS
	bool "VoIP SIP TLS"
	depends on PJSIP
	default n
	help
	  Reserved signaling-security policy gate; TLS remains unsupported by the
	  initial PJSUA-LIB service adapter.

config VOIP_SRTP
	bool "VoIP SRTP media"
	depends on PJMEDIA
	default n
	help
	  Reserved media-security policy gate; SRTP remains unsupported by the
	  initial PJSUA-LIB service adapter.
```
